## firmware/main/Kconfig.projbuild
```kconfig
menu "TRAE Controller Board Profile"

choice TC_BOARD_PROFILE
    prompt "Target controller board"
    default TC_BOARD_LEGACY_S3
    help
        Select hardware profile. Legacy ESP32-S3 is the current production controller.
        New ESP32-P4 display module profile is added for gradual migration.

config TC_BOARD_LEGACY_S3
    bool "Legacy kiln controller (ESP32-S3, 480x320)"

config TC_BOARD_NEW_P4
    bool "New HMI module (ESP32-P4 + ESP32-C6, 800x480)"

endchoice

config TC_DISPLAY_WIDTH
    int "Display width in pixels"
    range 320 1280
    default 480 if TC_BOARD_LEGACY_S3
    default 800 if TC_BOARD_NEW_P4
    default 480

config TC_DISPLAY_HEIGHT
    int "Display height in pixels"
    range 240 1280
    default 320 if TC_BOARD_LEGACY_S3
    default 480 if TC_BOARD_NEW_P4
    default 320

endmenu
```

## firmware/sdkconfig.defaults
```kconfig
CONFIG_ESPTOOLPY_FLASHSIZE_16MB=y
CONFIG_ESPTOOLPY_FLASHMODE_QIO=y
CONFIG_ESPTOOLPY_FLASHFREQ_80M=y
CONFIG_SPI_FLASH_SUPPORT_BOYA_CHIP=y

CONFIG_SPIRAM=y
CONFIG_SPIRAM_SPEED_80M=y
CONFIG_SPIRAM_BOOT_INIT=y
CONFIG_SPIRAM_IGNORE_NOTFOUND=y
CONFIG_SPIRAM_USE_MALLOC=y
CONFIG_HEAP_ABORT_WHEN_ALLOCATION_FAILS=y
CONFIG_SPIRAM_MALLOC_ALWAYSINTERNAL=8192
CONFIG_SPIRAM_MALLOC_RESERVE_INTERNAL=131072
CONFIG_SPIRAM_TRY_ALLOCATE_WIFI_LWIP=y
CONFIG_MBEDTLS_EXTERNAL_MEM_ALLOC=y

CONFIG_ESP_DEFAULT_CPU_FREQ_MHZ_240=y
CONFIG_COMPILER_OPTIMIZATION_PERF=y
# CONFIG_COMPILER_OPTIMIZATION_SIZE is not set

CONFIG_HTTPD_WS_SUPPORT=y

CONFIG_ESP_MAIN_TASK_STACK_SIZE=12288
CONFIG_FREERTOS_USE_TIMERS=y

# Use custom partition table (includes littlefs storage)
CONFIG_PARTITION_TABLE_CUSTOM=y
CONFIG_PARTITION_TABLE_CUSTOM_FILENAME="partitions.csv"
# LCD bus arbitration and tear mitigation for Controller-P4 profile
CONFIG_LCD_RGB_RESTART_IN_VSYNC=y
CONFIG_GDMA_CTRL_FUNC_IN_IRAM=y
CONFIG_GDMA_ISR_HANDLER_IN_IRAM=y
CONFIG_GDMA_OBJ_DRAM_SAFE=y
# XPT2046: keep raw ADC coordinates (0..4095) so we can apply our own calibration / grid warp.
CONFIG_XPT2046_CONVERT_ADC_TO_COORDS=n

# Board profile defaults: current production controller
CONFIG_TC_BOARD_LEGACY_S3=y
# CONFIG_TC_BOARD_NEW_P4 is not set
CONFIG_TC_DISPLAY_WIDTH=480
CONFIG_TC_DISPLAY_HEIGHT=320
```

## firmware/sdkconfig.defaults.board_legacy_s3
```kconfig
CONFIG_TC_BOARD_LEGACY_S3=y
# CONFIG_TC_BOARD_NEW_P4 is not set
CONFIG_TC_DISPLAY_WIDTH=480
CONFIG_TC_DISPLAY_HEIGHT=320

# Legacy S3 board uses octal PSRAM mode.
CONFIG_SPIRAM_MODE_OCT=y

# LVGL performance/stability tuning for S3 (reduce long full-screen redraw time)
CONFIG_ESP_DEFAULT_CPU_FREQ_MHZ_240=y
CONFIG_COMPILER_OPTIMIZATION_PERF=y
# CONFIG_COMPILER_OPTIMIZATION_SIZE is not set

# Reserve more internal RAM for DMA-capable allocations (LVGL draw buffers)
CONFIG_SPIRAM_MALLOC_RESERVE_INTERNAL=131072
```

## firmware/sdkconfig.defaults.board_new_p4
```kconfig
# Start point for the new production HMI module (ESP32-P4 + ESP32-C6, 4.3" 800x480).
# Drivers are migrated incrementally; this file only switches board profile and UI canvas size.
# Use with: idf.py -D SDKCONFIG_DEFAULTS="sdkconfig.defaults;sdkconfig.defaults.board_new_p4" build

# CONFIG_TC_BOARD_LEGACY_S3 is not set
CONFIG_TC_BOARD_NEW_P4=y
CONFIG_TC_DISPLAY_WIDTH=800
CONFIG_TC_DISPLAY_HEIGHT=480

# Dev module on bench is ESP32-P4 rev v1.3 (pre-v3 silicon).
# For this silicon family ESP-IDF keeps support under experimental gate.
CONFIG_IDF_EXPERIMENTAL_FEATURES=y
CONFIG_ESP32P4_SELECTS_REV_LESS_V3=y
CONFIG_ESP32P4_REV_MIN_100=y

# CPU frequency (rev <3.x: keep 360 MHz for stability; 400 MHz force caused esp_clk_init assert on this board)
CONFIG_ESP_DEFAULT_CPU_FREQ_MHZ_360=y

# Flash: keep conservative and compatible with our module (avoids checksum/boot issues seen with QIO/80MHz)
CONFIG_ESPTOOLPY_FLASHMODE_DIO=y
CONFIG_ESPTOOLPY_FLASHFREQ_40M=y

# PSRAM
CONFIG_SPIRAM=y
CONFIG_SPIRAM_MODE_HEX=y
CONFIG_SPIRAM_SPEED_200M=y
CONFIG_SPIRAM_BOOT_INIT=y
CONFIG_SPIRAM_USE_MALLOC=y
CONFIG_SPIRAM_MALLOC_ALWAYSINTERNAL=4096
CONFIG_SPIRAM_ALLOW_STACK_EXTERNAL_MEMORY=y

# PSRAM bandwidth optimization (recommended for MIPI DSI frame buffer DMA)
CONFIG_SPIRAM_XIP_FROM_PSRAM=y
CONFIG_CACHE_L2_CACHE_256KB=y
CONFIG_CACHE_L2_CACHE_LINE_128B=y
CONFIG_COMPILER_OPTIMIZATION_PERF=y

# ESP-Hosted (ESP32-P4 host + ESP32-C6 slave) over SDIO.
CONFIG_ESP_HOSTED_ENABLED=y
CONFIG_ESP_HOSTED_SDIO_HOST_INTERFACE=y
# CONFIG_ESP_HOSTED_SPI_HD_HOST_INTERFACE is not set
# CONFIG_ESP_HOSTED_UART_HOST_INTERFACE is not set
CONFIG_ESP_HOSTED_IDF_SLAVE_TARGET="esp32c6"
CONFIG_ESP_HOSTED_SDIO_SLOT_1=y
CONFIG_ESP_HOSTED_SDIO_SLOT=1
CONFIG_ESP_HOSTED_SDIO_4_BIT_BUS=y
CONFIG_ESP_HOSTED_SDIO_BUS_WIDTH=4
CONFIG_ESP_HOSTED_SDIO_CLOCK_FREQ_KHZ=15000
CONFIG_ESP_HOSTED_PRIORITY=2
CONFIG_ESP_HOSTED_SDIO_RESET_ACTIVE_HIGH=y
CONFIG_ESP_HOSTED_SDIO_GPIO_RESET_SLAVE=54
CONFIG_ESP_HOSTED_SDIO_PIN_CMD=19
CONFIG_ESP_HOSTED_SDIO_PIN_CLK=18
CONFIG_ESP_HOSTED_SDIO_PIN_D0=14
CONFIG_ESP_HOSTED_SDIO_PIN_D1=15
CONFIG_ESP_HOSTED_SDIO_PIN_D2=16
CONFIG_ESP_HOSTED_SDIO_PIN_D3=17
CONFIG_ESP_HOSTED_SDIO_TX_Q_SIZE=8
CONFIG_ESP_HOSTED_SDIO_RX_Q_SIZE=8
CONFIG_ESP_HOSTED_SDIO_RESET_DELAY_MS=2000
# CONFIG_ESP_HOSTED_CLI_ENABLED is not set
# CONFIG_ESP_HOSTED_MEM_MONITOR is not set
# CONFIG_ESP_HOSTED_ENABLE_ITWT is not set
CONFIG_ESP_HOSTED_DFLT_TASK_STACK=4096
CONFIG_ESP_HOSTED_RPC_TASK_STACK=6144
CONFIG_SLAVE_IDF_TARGET_ESP32C6=y

# Keep panic text visible a bit longer before auto-reboot, so crash logs are readable.
CONFIG_ESP_SYSTEM_PANIC_REBOOT_DELAY_SECONDS=3
CONFIG_ESP_HOSTED_MAX_SIMULTANEOUS_SYNC_RPC_REQUESTS=2
CONFIG_ESP_HOSTED_MAX_SIMULTANEOUS_ASYNC_RPC_REQUESTS=2
CONFIG_WIFI_RMT_DYNAMIC_RX_BUFFER_NUM=16
CONFIG_WIFI_RMT_DYNAMIC_TX_BUFFER_NUM=16

# LVGL Backend
# CONFIG_TC_UI_BACKEND_SLINT is not set
CONFIG_TC_UI_BACKEND_LVGL=y

# LVGL Anti-flicker settings
CONFIG_BSP_LCD_DPI_BUFFER_NUMS=2
CONFIG_BSP_DISPLAY_LVGL_AVOID_TEAR=y
CONFIG_BSP_DISPLAY_LVGL_DIRECT_MODE=y
CONFIG_LV_MEM_CUSTOM=y
CONFIG_LV_MEM_CUSTOM_INCLUDE="esp_heap_caps.h"
CONFIG_LV_ATTRIBUTE_FAST_MEM_USE_IRAM=y

# FreeRTOS Stability
CONFIG_FREERTOS_TASK_CREATE_ALLOW_EXT_MEM=y
CONFIG_FREERTOS_SUPPORT_STATIC_ALLOCATION=y
CONFIG_FREERTOS_HZ=1000

# Task watchdog (LVGL full-screen rendering can block CPU for >5s)
CONFIG_ESP_TASK_WDT_TIMEOUT_S=20
# CONFIG_ESP_TASK_WDT_CHECK_IDLE_TASK_CPU0 is not set

CONFIG_ESP_WIFI_DYNAMIC_RX_BUFFER_NUM=16
CONFIG_ESP_WIFI_DYNAMIC_TX_BUFFER_NUM=16

# Fonts for LVGL
CONFIG_LV_FONT_MONTSERRAT_10=y
CONFIG_LV_FONT_MONTSERRAT_14=y
CONFIG_LV_FONT_MONTSERRAT_16=y
CONFIG_LV_FONT_MONTSERRAT_18=y
CONFIG_LV_FONT_MONTSERRAT_20=y
CONFIG_LV_FONT_MONTSERRAT_24=y
CONFIG_LV_FONT_MONTSERRAT_28=y
CONFIG_LV_FONT_MONTSERRAT_32=y
CONFIG_LV_FONT_MONTSERRAT_40=y
CONFIG_LV_FONT_MONTSERRAT_48=y
CONFIG_LV_USE_FONT_PLACEHOLDER=y

# Runtime and memory arbitration tuning for P4 display stability.
CONFIG_SPIRAM_MALLOC_RESERVE_INTERNAL=49152
CONFIG_SPIRAM_TRY_ALLOCATE_WIFI_LWIP=y
CONFIG_MBEDTLS_EXTERNAL_MEM_ALLOC=y
```
