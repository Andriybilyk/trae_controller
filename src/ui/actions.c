// Generated by PicoPixel.io — https://picopixel.io
#include "actions.h"
#include "screens.h"
#include "ui.h"
#include "fonts/fonts.h"
#include "core/lv_global.h"
#include <string.h>
#include <stdlib.h>
#include "net/wifi_connection.h"
#include "libs/qrcode/lv_qrcode.h"
#if defined(ESP_PLATFORM)
#include "esp_log.h"
#include "freertos/FreeRTOS.h"
#include "freertos/task.h"
#include "esp_task_wdt.h"
#define PP_ACTIONS_YIELD() do { (void)esp_task_wdt_reset(); taskYIELD(); } while (0)
#else
#define PP_ACTIONS_YIELD() ((void)0)
#endif

extern int kiln_ui_start_selected_program(void);
extern int kiln_ui_get_is_firing(void);
extern void kiln_ui_pause_firing(void);
extern void kiln_ui_stop_firing(void);

// #region debug-point program-delete-freeze
#if defined(ESP_PLATFORM)
static const char *s_dbg_tag_program_delete_freeze = "UI_DEL_DBG";
static const char *s_dbg_tag_start_firing = "UI_START_DBG";
static const char *s_dbg_tag_nav_race = "UI_NAV_RACE";
static const char *s_dbg_tag_program_graph = "UI_GRAPH_DBG";
static const char *s_dbg_tag_add_step = "UI_ADD_STEP";
static const char *s_dbg_tag_kb_flow = "UI_KB_FLOW";
static const bool s_dbg_nav_race_enabled = false;
#endif
// #endregion

// #region debug-point program-save-time
#if defined(ESP_PLATFORM)
static const char *s_dbg_tag_program_save_time = "UI_DBG";
static bool s_dbg_trace_programs_update = false;
#endif
// #endregion


typedef struct {
    lv_obj_t *list;
    lv_obj_t *info_sub;
} programs_ctx_t;

static programs_ctx_t s_programs_ctx = { 0 };
static char s_toast_last_text[160] = { 0 };
static uint32_t s_toast_last_show_ms = 0;
static uint32_t s_transient_close_guard_started_ms = 0;
static uint32_t s_programs_interaction_guard_started_ms = 0;
static uint32_t s_programs_interaction_guard_duration_ms = 0;
#if defined(ESP_PLATFORM)
static const char *s_dbg_tag_toast = "UI_TOAST";
#endif

static bool transient_close_guard_active(void) {
    if (s_transient_close_guard_started_ms == 0) return false;
    return lv_tick_elaps(s_transient_close_guard_started_ms) < 500;
}

static bool programs_interaction_guard_active(void) {
    if (s_programs_interaction_guard_started_ms == 0 || s_programs_interaction_guard_duration_ms == 0) return false;
    return lv_tick_elaps(s_programs_interaction_guard_started_ms) < s_programs_interaction_guard_duration_ms;
}

void action_block_programs_interaction(uint32_t duration_ms) {
    if (duration_ms == 0) duration_ms = 1200;
    s_programs_interaction_guard_started_ms = lv_tick_get();
    s_programs_interaction_guard_duration_ms = duration_ms;
}

static bool ui_programs_screen_is_active(void) {
    if (ui_get_current_screen_id() != SCREEN_ID_PROGRAMS) return false;
    if (ui_is_navigation_active() || transient_close_guard_active() || programs_interaction_guard_active()) return false;
    if (!objects.programs) return false;
    return lv_scr_act() == objects.programs;
}

#if defined(ESP_PLATFORM)
static const char *ui_debug_obj_kind(lv_obj_t *obj) {
    if (!obj) return "null";
    if (!lv_obj_is_valid(obj)) return "invalid";
    if (lv_obj_check_type(obj, &lv_arc_class)) return "arc";
    if (lv_obj_check_type(obj, &lv_slider_class)) return "slider";
    if (lv_obj_check_type(obj, &lv_bar_class)) return "bar";
    if (lv_obj_check_type(obj, &lv_keyboard_class)) return "keyboard";
    if (lv_obj_check_type(obj, &lv_buttonmatrix_class)) return "buttonmatrix";
    if (lv_obj_check_type(obj, &lv_textarea_class)) return "textarea";
    if (lv_obj_check_type(obj, &lv_button_class)) return "button";
    if (lv_obj_check_type(obj, &lv_label_class)) return "label";
    return "obj";
}

static void ui_debug_dump_overlay_tree_node(const char *origin, const char *slot, lv_obj_t *obj) {
    ESP_LOGI(s_dbg_tag_nav_race,
             "overlay_dump: origin=%s slot=%s obj=%p kind=%s hidden=%d child_count=%u parent=%p",
             origin ? origin : "(null)",
             slot ? slot : "?",
             (void *)obj,
             ui_debug_obj_kind(obj),
             (obj && lv_obj_has_flag(obj, LV_OBJ_FLAG_HIDDEN)) ? 1 : 0,
             obj ? (unsigned)lv_obj_get_child_count(obj) : 0u,
             obj ? (void *)lv_obj_get_parent(obj) : NULL);
}

static void ui_debug_dump_anim_list(const char *origin) {
    lv_anim_state_t *anim_state = &LV_GLOBAL_DEFAULT()->anim_state;
    uint32_t idx = 0;
    lv_anim_t *a;
    LV_LL_READ(&anim_state->anim_ll, a) {
        lv_obj_t *var_obj = (lv_obj_t *)(a ? a->var : NULL);
        const bool var_is_obj = var_obj && lv_obj_is_valid(var_obj);
        ESP_LOGI(s_dbg_tag_nav_race,
                 "anim_dump: origin=%s idx=%u anim=%p var=%p var_kind=%s var_parent=%p exec=%p custom=%p start=%p done=%p del=%p path=%p dur=%" PRIi32 " rev=%" PRIu32 " act=%" PRIi32 " rpt=%" PRIu32 " rev_run=%u paused=%u",
                 origin ? origin : "(null)",
                 (unsigned)idx,
                 (void *)a,
                 a ? a->var : NULL,
                 var_is_obj ? ui_debug_obj_kind(var_obj) : "raw",
                 var_is_obj ? (void *)lv_obj_get_parent(var_obj) : NULL,
                 a ? (void *)a->exec_cb : NULL,
                 a ? (void *)a->custom_exec_cb : NULL,
                 a ? (void *)a->start_cb : NULL,
                 a ? (void *)a->completed_cb : NULL,
                 a ? (void *)a->deleted_cb : NULL,
                 a ? (void *)a->path_cb : NULL,
                 a ? a->duration : 0,
                 a ? a->reverse_duration : 0U,
                 a ? a->act_time : 0,
                 a ? a->repeat_cnt : 0U,
                 a ? (unsigned)a->reverse_play_in_progress : 0U,
                 a ? (unsigned)a->is_paused : 0U);
        idx++;
        if (idx >= 6) break;
    }
}

static void ui_debug_count_tree(lv_obj_t *root, uint32_t *out_nodes, uint32_t *out_kb, uint32_t *out_bm, uint32_t *out_ta) {
    if (!root) return;
    enum { MAX_STACK = 96, MAX_NODES = 320 };
    lv_obj_t *stack[MAX_STACK];
    int sp = 0;
    stack[sp++] = root;
    while (sp > 0) {
        lv_obj_t *obj = stack[--sp];
        if (!obj) continue;

        if (out_nodes) {
            (*out_nodes)++;
            if (*out_nodes >= MAX_NODES) break;
        }

        if (lv_obj_check_type(obj, &lv_keyboard_class)) {
            if (out_kb) (*out_kb)++;
        } else if (lv_obj_check_type(obj, &lv_buttonmatrix_class)) {
            if (out_bm) (*out_bm)++;
        } else if (lv_obj_check_type(obj, &lv_textarea_class)) {
            if (out_ta) (*out_ta)++;
        }

        const uint32_t cc = lv_obj_get_child_count(obj);
        for (uint32_t i = 0; i < cc; i++) {
            lv_obj_t *child = lv_obj_get_child(obj, (int32_t)i);
            if (!child) break;
            if (sp < MAX_STACK) stack[sp++] = child;
        }
    }
}
#endif

void action_debug_dump_overlay_state(const char *origin) {
#if defined(ESP_PLATFORM)
    if (!s_dbg_nav_race_enabled) {
        (void)origin;
        return;
    }
    lv_obj_t *top = lv_layer_top();
    lv_obj_t *sys = lv_layer_sys();
    const uint32_t top_children = top ? lv_obj_get_child_count(top) : 0;
    const uint32_t sys_children = sys ? lv_obj_get_child_count(sys) : 0;
    lv_obj_t *act = lv_scr_act();
    const uint32_t act_children = act ? lv_obj_get_child_count(act) : 0;

    uint32_t nodes = 0;
    uint32_t kb = 0;
    uint32_t bm = 0;
    uint32_t ta = 0;
    ui_debug_count_tree(top, &nodes, &kb, &bm, &ta);
    ui_debug_count_tree(sys, &nodes, &kb, &bm, &ta);
    ui_debug_count_tree(act, &nodes, &kb, &bm, &ta);
    ESP_LOGI(s_dbg_tag_nav_race,
             "overlay_state: origin=%s cur=%d act=%p top=%p top_children=%u sys=%p sys_children=%u scr_children=%u anims=%u nodes=%u kb=%u bm=%u ta=%u guard=%d nav=%d",
             origin ? origin : "(null)",
             (int)ui_get_current_screen_id(),
             (void *)act,
             (void *)top,
             (unsigned)top_children,
             (void *)sys,
             (unsigned)sys_children,
             (unsigned)act_children,
             (unsigned)lv_anim_count_running(),
             (unsigned)nodes,
             (unsigned)kb,
             (unsigned)bm,
             (unsigned)ta,
             transient_close_guard_active() ? 1 : 0,
             ui_is_navigation_active() ? 1 : 0);
    if (lv_anim_count_running() > 0) {
        ui_debug_dump_anim_list(origin);
    }
    for (uint32_t i = 0; i < top_children && i < 4; i++) {
        lv_obj_t *child = lv_obj_get_child(top, i);
        char slot[32];
        lv_snprintf(slot, sizeof(slot), "top[%u]", (unsigned)i);
        ui_debug_dump_overlay_tree_node(origin, slot, child);
        const uint32_t nested_count = child ? lv_obj_get_child_count(child) : 0;
        for (uint32_t j = 0; j < nested_count && j < 4; j++) {
            lv_obj_t *nested = lv_obj_get_child(child, j);
            char nested_slot[32];
            lv_snprintf(nested_slot, sizeof(nested_slot), "top[%u].%u", (unsigned)i, (unsigned)j);
            ui_debug_dump_overlay_tree_node(origin, nested_slot, nested);
        }
    }
    for (uint32_t i = 0; i < sys_children && i < 4; i++) {
        lv_obj_t *child = lv_obj_get_child(sys, i);
        char slot[32];
        lv_snprintf(slot, sizeof(slot), "sys[%u]", (unsigned)i);
        ui_debug_dump_overlay_tree_node(origin, slot, child);
        const uint32_t nested_count = child ? lv_obj_get_child_count(child) : 0;
        for (uint32_t j = 0; j < nested_count && j < 4; j++) {
            lv_obj_t *nested = lv_obj_get_child(child, j);
            char nested_slot[32];
            lv_snprintf(nested_slot, sizeof(nested_slot), "sys[%u].%u", (unsigned)i, (unsigned)j);
            ui_debug_dump_overlay_tree_node(origin, nested_slot, nested);
        }
    }

    for (uint32_t i = 0; i < act_children && i < 4; i++) {
        lv_obj_t *child = lv_obj_get_child(act, (int32_t)i);
        char slot[32];
        lv_snprintf(slot, sizeof(slot), "scr[%u]", (unsigned)i);
        ui_debug_dump_overlay_tree_node(origin, slot, child);
        const uint32_t nested_count = child ? lv_obj_get_child_count(child) : 0;
        for (uint32_t j = 0; j < nested_count && j < 4; j++) {
            lv_obj_t *nested = lv_obj_get_child(child, (int32_t)j);
            char nested_slot[32];
            lv_snprintf(nested_slot, sizeof(nested_slot), "scr[%u].%u", (unsigned)i, (unsigned)j);
            ui_debug_dump_overlay_tree_node(origin, nested_slot, nested);
        }
    }
#else
    (void)origin;
#endif
}

static void request_fresh_screen(enum ScreensEnum screen_id) {
    action_block_programs_interaction(1200);
    action_close_transient_overlays();
    requestScreen(screen_id);
}

static void style_flat_panel(lv_obj_t *obj, lv_color_t bg, lv_color_t border, lv_coord_t border_w, lv_coord_t radius, lv_coord_t pad) {
    if (!obj) return;
    lv_obj_remove_style_all(obj);
    lv_obj_set_style_bg_color(obj, bg, LV_PART_MAIN | LV_STATE_DEFAULT);
    lv_obj_set_style_bg_opa(obj, 255, LV_PART_MAIN | LV_STATE_DEFAULT);
    lv_obj_set_style_border_color(obj, border, LV_PART_MAIN | LV_STATE_DEFAULT);
    lv_obj_set_style_border_width(obj, border_w, LV_PART_MAIN | LV_STATE_DEFAULT);
    lv_obj_set_style_radius(obj, radius, LV_PART_MAIN | LV_STATE_DEFAULT);
    lv_obj_set_style_pad_all(obj, pad, LV_PART_MAIN | LV_STATE_DEFAULT);
    lv_obj_set_style_shadow_width(obj, 0, LV_PART_MAIN | LV_STATE_DEFAULT);
    lv_obj_set_style_outline_width(obj, 0, LV_PART_MAIN | LV_STATE_DEFAULT);
    lv_obj_clear_flag(obj, LV_OBJ_FLAG_SCROLLABLE);
}

static void style_flat_button(lv_obj_t *obj, lv_color_t bg, lv_opa_t bg_opa, lv_color_t border, lv_coord_t border_w, lv_coord_t radius) {
    if (!obj) return;
    lv_obj_remove_style_all(obj);
    lv_obj_set_style_bg_color(obj, bg, LV_PART_MAIN | LV_STATE_DEFAULT);
    lv_obj_set_style_bg_opa(obj, bg_opa, LV_PART_MAIN | LV_STATE_DEFAULT);
    lv_obj_set_style_border_color(obj, border, LV_PART_MAIN | LV_STATE_DEFAULT);
    lv_obj_set_style_border_width(obj, border_w, LV_PART_MAIN | LV_STATE_DEFAULT);
    lv_obj_set_style_radius(obj, radius, LV_PART_MAIN | LV_STATE_DEFAULT);
    lv_obj_set_style_pad_all(obj, 0, LV_PART_MAIN | LV_STATE_DEFAULT);
    lv_obj_set_style_shadow_width(obj, 0, LV_PART_MAIN | LV_STATE_DEFAULT);
    lv_obj_set_style_outline_width(obj, 0, LV_PART_MAIN | LV_STATE_DEFAULT);
    lv_obj_clear_flag(obj, LV_OBJ_FLAG_SCROLLABLE);
}

static void programs_reindex(void);

static int16_t programs_step_temp_or_default(uint8_t pid, uint32_t idx) {
    int16_t temp_c = (pid != 255) ? ui_get_program_step_temp(pid, (uint16_t)idx) : 0;
    if (temp_c == 0) temp_c = (idx == 0) ? 200 : (idx == 1) ? 600 : (idx == 2) ? 900 : 1100;
    return temp_c;
}

static uint16_t programs_step_rate_or_default(uint8_t pid, uint32_t idx) {
    uint16_t rate_x10 = (pid != 255) ? ui_get_program_step_rate_c_per_h_x10(pid, (uint16_t)idx) : 0;
    if (rate_x10 == 0) rate_x10 = (idx == 0) ? 1500 : (idx == 1) ? 2000 : (idx == 2) ? 1800 : 1500;
    return rate_x10;
}

static uint32_t programs_step_hold_or_default(uint8_t pid, uint32_t idx) {
    uint32_t hold_s = (pid != 255) ? ui_get_program_step_hold_s(pid, (uint16_t)idx) : 0;
    if (hold_s == 0) hold_s = (idx == 0) ? 600 : (idx == 1) ? 1200 : (idx == 2) ? 900 : 1200;
    return hold_s;
}

static void pp_obj_delete_async_safe(lv_obj_t **obj) {
    if (!obj || !*obj) return;
    if (!lv_obj_is_valid(*obj)) {
        *obj = NULL;
        return;
    }
    lv_indev_reset(NULL, NULL);
    lv_obj_delete_async(*obj);
    *obj = NULL;
}

static void pp_obj_delete_async_safe_event(lv_event_t *e, lv_obj_t **obj) {
    if (!obj || !*obj) return;
    if (!lv_obj_is_valid(*obj)) {
        *obj = NULL;
        return;
    }
    lv_indev_t *indev = e ? lv_event_get_indev(e) : NULL;
    if (indev) lv_indev_reset(indev, NULL);
    lv_indev_reset(NULL, NULL);
    lv_obj_delete_async(*obj);
    *obj = NULL;
}

static void programs_reindex_async_cb(void *user_data) {
    (void)user_data;
    programs_reindex();
}

typedef struct {
    void (*delete_fn)(void);
    enum ScreensEnum screen_id;
} nav_delete_ctx_t;

static void nav_delete_and_request_async_cb(void *user_data) {
    nav_delete_ctx_t *ctx = (nav_delete_ctx_t *)user_data;
    if (!ctx) return;
    if (ctx->delete_fn) ctx->delete_fn();
    if (ctx->screen_id) requestScreen(ctx->screen_id);
    lv_free(ctx);
}

static void nav_delete_and_request_async(void (*delete_fn)(void), enum ScreensEnum screen_id) {
    nav_delete_ctx_t *ctx = (nav_delete_ctx_t *)lv_malloc(sizeof(nav_delete_ctx_t));
    if (!ctx) {
        if (delete_fn) delete_fn();
        requestScreen(screen_id);
        return;
    }
    ctx->delete_fn = delete_fn;
    ctx->screen_id = screen_id;
    (void)lv_async_call(nav_delete_and_request_async_cb, ctx);
}

static const char *temp_unit_short(void) {
    return (ui_get_temp_unit() == UI_TEMP_UNIT_F) ? "°F" : "°C";
}

typedef struct {
    uint8_t id;
    const char *name;
    uint16_t steps_total;
} program_brief_t;

// Animation timeline helpers
void pp_anim_stop_timelines_for_deleted_tree(lv_obj_t * root) {
    (void)root;
}

static void toast_show_ex(const char *text, uint32_t min_repeat_ms) {
    if (!text) text = "";
    const uint32_t now = lv_tick_get();
    const bool same_text = (strncmp(s_toast_last_text, text, sizeof(s_toast_last_text) - 1) == 0);

    if (same_text && min_repeat_ms > 0 && (uint32_t)(now - s_toast_last_show_ms) < min_repeat_ms) {
        return;
    }
    strncpy(s_toast_last_text, text, sizeof(s_toast_last_text) - 1);
    s_toast_last_text[sizeof(s_toast_last_text) - 1] = '\0';
    s_toast_last_show_ms = now;
#if defined(ESP_PLATFORM)
    ESP_LOGI(s_dbg_tag_toast, "%s", text);
#endif
}

static void toast_show(const char *text) {
    toast_show_ex(text, 0);
}

static void wifi_show_portal_hint(void) {
    char ssid[40] = {0};
    char url[48] = {0};
    wifi_get_ap_ssid_c(ssid, (int32_t)sizeof(ssid));
    wifi_get_server_url_c(url, (int32_t)sizeof(url));

    char msg[140] = {0};
    if (ui_is_english()) {
        lv_snprintf(msg, sizeof(msg), "Connect to %s and open %s", ssid, url);
    } else {
        lv_snprintf(msg, sizeof(msg), "Підключись до %s і відкрий %s", ssid, url);
    }
    toast_show_ex(msg, 4000);
}

static void make_default_new_program_name(char *out, size_t out_sz) {
    if (!out || out_sz == 0) return;
    const char *base = ui_is_english() ? "New program" : "Нова програма";

    uint8_t used_nums[16] = { 0 };
    uint8_t used_cnt = 0;

    const uint8_t pc = ui_get_program_count();
    const size_t base_len = strlen(base);
    for (uint8_t i = 0; i < pc; i++) {
        const char *nm = ui_get_program_name(i);
        if (!nm) continue;
        if (strcmp(nm, base) == 0) {
            bool exists = false;
            for (uint8_t k = 0; k < used_cnt; k++) {
                if (used_nums[k] == 1u) {
                    exists = true;
                    break;
                }
            }
            if (!exists && used_cnt < (uint8_t)(sizeof(used_nums) / sizeof(used_nums[0]))) {
                used_nums[used_cnt++] = 1u;
            }
            continue;
        }
        if (strncmp(nm, base, base_len) != 0) continue;
        if (nm[base_len] != ' ') continue;
        const char *p = nm + base_len + 1;
        if (*p == '\0') continue;
        char *end = NULL;
        long v = strtol(p, &end, 10);
        if (!end || *end != '\0') continue;
        if (v < 1 || v > 255) continue;
        bool exists = false;
        for (uint8_t k = 0; k < used_cnt; k++) {
            if (used_nums[k] == (uint8_t)v) {
                exists = true;
                break;
            }
        }
        if (!exists && used_cnt < (uint8_t)(sizeof(used_nums) / sizeof(used_nums[0]))) {
            used_nums[used_cnt++] = (uint8_t)v;
        }
    }

    uint8_t n = 1;
    for (;;) {
        bool taken = false;
        for (uint8_t k = 0; k < used_cnt; k++) {
            if (used_nums[k] == n) {
                taken = true;
                break;
            }
        }
        if (!taken) break;
        n++;
        if (n == 0) break;
    }
    lv_snprintf(out, out_sz, "%s %u", base, (unsigned)n);
}

static bool program_name_exists(const char *name) {
    if (!name || name[0] == '\0') return false;
    const uint8_t pc = ui_get_program_count();
    for (uint8_t i = 0; i < pc; i++) {
        const char *nm = ui_get_program_name(i);
        if (nm && strcmp(nm, name) == 0) return true;
    }
    return false;
}

static lv_obj_t *s_kb_overlay = NULL;
static lv_obj_t *s_kb_ta = NULL;
static lv_obj_t *s_kb = NULL;
static lv_obj_t *s_wifi_kb_overlay = NULL;
static lv_obj_t *s_wifi_setup_popup = NULL;
static lv_obj_t *s_kb_target = NULL;
static lv_obj_t *s_kb_back_lbl = NULL;
static bool s_kb_target_is_program_name = false;
static bool s_kb_use_affixes = false;
static bool s_kb_manual_input = false;
static char s_kb_prefix[32] = { 0 };
static char s_kb_suffix[32] = { 0 };
static bool s_kb_layout_ua = false;
static lv_font_t s_kb_items_font;
static bool s_kb_items_font_inited = false;

#define PP_KB_BTN(width) (LV_BUTTONMATRIX_CTRL_POPOVER | (width))
static char s_kb_lang_key_text[6] = "UA";

static const char * const s_kb_map_ua_lc[] = {
    "1#", "й", "ц", "у", "к", "е", "н", "г", "ш", "щ", "з", "х", LV_SYMBOL_BACKSPACE, "\n",
    "ABC", "ф", "і", "в", "а", "п", "р", "о", "л", "д", "ж", "є", LV_SYMBOL_NEW_LINE, "\n",
    "_", "-", "ґ", "ї", "я", "ч", "с", "м", "и", "т", "ь", "б", "ю", "\n",
    s_kb_lang_key_text,
#if LV_USE_ARABIC_PERSIAN_CHARS == 1
    "أب",
#endif
    LV_SYMBOL_LEFT, " ", LV_SYMBOL_RIGHT, LV_SYMBOL_OK, ""
};

static const char * const s_kb_map_ua_uc[] = {
    "1#", "Й", "Ц", "У", "К", "Е", "Н", "Г", "Ш", "Щ", "З", "Х", LV_SYMBOL_BACKSPACE, "\n",
    "abc", "Ф", "І", "В", "А", "П", "Р", "О", "Л", "Д", "Ж", "Є", LV_SYMBOL_NEW_LINE, "\n",
    "_", "-", "Ґ", "Ї", "Я", "Ч", "С", "М", "И", "Т", "Ь", "Б", "Ю", "\n",
    s_kb_lang_key_text,
#if LV_USE_ARABIC_PERSIAN_CHARS == 1
    "أب",
#endif
    LV_SYMBOL_LEFT, " ", LV_SYMBOL_RIGHT, LV_SYMBOL_OK, ""
};

static const lv_buttonmatrix_ctrl_t s_kb_ctrl_ua_lc[] = {
    LV_KEYBOARD_CTRL_BUTTON_FLAGS | 5,
    PP_KB_BTN(4), PP_KB_BTN(4), PP_KB_BTN(4), PP_KB_BTN(4), PP_KB_BTN(4), PP_KB_BTN(4),
    PP_KB_BTN(4), PP_KB_BTN(4), PP_KB_BTN(4), PP_KB_BTN(4), PP_KB_BTN(4),
    LV_BUTTONMATRIX_CTRL_CHECKED | 7,

    LV_KEYBOARD_CTRL_BUTTON_FLAGS | 6,
    PP_KB_BTN(3), PP_KB_BTN(3), PP_KB_BTN(3), PP_KB_BTN(3), PP_KB_BTN(3), PP_KB_BTN(3),
    PP_KB_BTN(3), PP_KB_BTN(3), PP_KB_BTN(3), PP_KB_BTN(3), PP_KB_BTN(3),
    LV_BUTTONMATRIX_CTRL_CHECKED | 7,

    LV_BUTTONMATRIX_CTRL_CHECKED | PP_KB_BTN(1),
    LV_BUTTONMATRIX_CTRL_CHECKED | PP_KB_BTN(1),
    PP_KB_BTN(1), PP_KB_BTN(1), PP_KB_BTN(1), PP_KB_BTN(1), PP_KB_BTN(1), PP_KB_BTN(1),
    PP_KB_BTN(1), PP_KB_BTN(1), PP_KB_BTN(1), PP_KB_BTN(1), PP_KB_BTN(1),

    LV_KEYBOARD_CTRL_BUTTON_FLAGS | 2,
#if LV_USE_ARABIC_PERSIAN_CHARS == 1
    LV_KEYBOARD_CTRL_BUTTON_FLAGS | 2,
#endif
    LV_BUTTONMATRIX_CTRL_CHECKED | 2, 6, LV_BUTTONMATRIX_CTRL_CHECKED | 2, LV_KEYBOARD_CTRL_BUTTON_FLAGS | 2
};

static const lv_buttonmatrix_ctrl_t s_kb_ctrl_ua_uc[] = {
    LV_KEYBOARD_CTRL_BUTTON_FLAGS | 5,
    PP_KB_BTN(4), PP_KB_BTN(4), PP_KB_BTN(4), PP_KB_BTN(4), PP_KB_BTN(4), PP_KB_BTN(4),
    PP_KB_BTN(4), PP_KB_BTN(4), PP_KB_BTN(4), PP_KB_BTN(4), PP_KB_BTN(4),
    LV_BUTTONMATRIX_CTRL_CHECKED | 7,

    LV_KEYBOARD_CTRL_BUTTON_FLAGS | 6,
    PP_KB_BTN(3), PP_KB_BTN(3), PP_KB_BTN(3), PP_KB_BTN(3), PP_KB_BTN(3), PP_KB_BTN(3),
    PP_KB_BTN(3), PP_KB_BTN(3), PP_KB_BTN(3), PP_KB_BTN(3), PP_KB_BTN(3),
    LV_BUTTONMATRIX_CTRL_CHECKED | 7,

    LV_BUTTONMATRIX_CTRL_CHECKED | PP_KB_BTN(1),
    LV_BUTTONMATRIX_CTRL_CHECKED | PP_KB_BTN(1),
    PP_KB_BTN(1), PP_KB_BTN(1), PP_KB_BTN(1), PP_KB_BTN(1), PP_KB_BTN(1), PP_KB_BTN(1),
    PP_KB_BTN(1), PP_KB_BTN(1), PP_KB_BTN(1), PP_KB_BTN(1), PP_KB_BTN(1),

    LV_KEYBOARD_CTRL_BUTTON_FLAGS | 2,
#if LV_USE_ARABIC_PERSIAN_CHARS == 1
    LV_KEYBOARD_CTRL_BUTTON_FLAGS | 2,
#endif
    LV_BUTTONMATRIX_CTRL_CHECKED | 2, 6, LV_BUTTONMATRIX_CTRL_CHECKED | 2, LV_KEYBOARD_CTRL_BUTTON_FLAGS | 2
};

static const char * const s_kb_map_text_lc[] = {
    "1#", "q", "w", "e", "r", "t", "y", "u", "i", "o", "p", LV_SYMBOL_BACKSPACE, "\n",
    "ABC", "a", "s", "d", "f", "g", "h", "j", "k", "l", LV_SYMBOL_NEW_LINE, "\n",
    "_", "-", "z", "x", "c", "v", "b", "n", "m", ".", ",", ":", "\n",
    s_kb_lang_key_text,
#if LV_USE_ARABIC_PERSIAN_CHARS == 1
    "أب",
#endif
    LV_SYMBOL_LEFT, " ", LV_SYMBOL_RIGHT, LV_SYMBOL_OK, ""
};

static const lv_buttonmatrix_ctrl_t s_kb_ctrl_text_lc[] = {
    LV_KEYBOARD_CTRL_BUTTON_FLAGS | 5, PP_KB_BTN(4), PP_KB_BTN(4), PP_KB_BTN(4), PP_KB_BTN(4), PP_KB_BTN(4), PP_KB_BTN(4), PP_KB_BTN(4), PP_KB_BTN(4), PP_KB_BTN(4), PP_KB_BTN(4), LV_BUTTONMATRIX_CTRL_CHECKED | 7,
    LV_KEYBOARD_CTRL_BUTTON_FLAGS | 6, PP_KB_BTN(3), PP_KB_BTN(3), PP_KB_BTN(3), PP_KB_BTN(3), PP_KB_BTN(3), PP_KB_BTN(3), PP_KB_BTN(3), PP_KB_BTN(3), PP_KB_BTN(3), LV_BUTTONMATRIX_CTRL_CHECKED | 7,
    LV_BUTTONMATRIX_CTRL_CHECKED | PP_KB_BTN(1), LV_BUTTONMATRIX_CTRL_CHECKED | PP_KB_BTN(1), PP_KB_BTN(1), PP_KB_BTN(1), PP_KB_BTN(1), PP_KB_BTN(1), PP_KB_BTN(1), PP_KB_BTN(1), PP_KB_BTN(1), LV_BUTTONMATRIX_CTRL_CHECKED | PP_KB_BTN(1), LV_BUTTONMATRIX_CTRL_CHECKED | PP_KB_BTN(1), LV_BUTTONMATRIX_CTRL_CHECKED | PP_KB_BTN(1),
    LV_KEYBOARD_CTRL_BUTTON_FLAGS | 2,
#if LV_USE_ARABIC_PERSIAN_CHARS == 1
    LV_KEYBOARD_CTRL_BUTTON_FLAGS | 2,
#endif
    LV_BUTTONMATRIX_CTRL_CHECKED | 2, 6, LV_BUTTONMATRIX_CTRL_CHECKED | 2, LV_KEYBOARD_CTRL_BUTTON_FLAGS | 2
};

static const char * const s_kb_map_text_uc[] = {
    "1#", "Q", "W", "E", "R", "T", "Y", "U", "I", "O", "P", LV_SYMBOL_BACKSPACE, "\n",
    "abc", "A", "S", "D", "F", "G", "H", "J", "K", "L", LV_SYMBOL_NEW_LINE, "\n",
    "_", "-", "Z", "X", "C", "V", "B", "N", "M", ".", ",", ":", "\n",
    s_kb_lang_key_text,
#if LV_USE_ARABIC_PERSIAN_CHARS == 1
    "أب",
#endif
    LV_SYMBOL_LEFT, " ", LV_SYMBOL_RIGHT, LV_SYMBOL_OK, ""
};

static const lv_buttonmatrix_ctrl_t s_kb_ctrl_text_uc[] = {
    LV_KEYBOARD_CTRL_BUTTON_FLAGS | 5, PP_KB_BTN(4), PP_KB_BTN(4), PP_KB_BTN(4), PP_KB_BTN(4), PP_KB_BTN(4), PP_KB_BTN(4), PP_KB_BTN(4), PP_KB_BTN(4), PP_KB_BTN(4), PP_KB_BTN(4), LV_BUTTONMATRIX_CTRL_CHECKED | 7,
    LV_KEYBOARD_CTRL_BUTTON_FLAGS | 6, PP_KB_BTN(3), PP_KB_BTN(3), PP_KB_BTN(3), PP_KB_BTN(3), PP_KB_BTN(3), PP_KB_BTN(3), PP_KB_BTN(3), PP_KB_BTN(3), PP_KB_BTN(3), LV_BUTTONMATRIX_CTRL_CHECKED | 7,
    LV_BUTTONMATRIX_CTRL_CHECKED | PP_KB_BTN(1), LV_BUTTONMATRIX_CTRL_CHECKED | PP_KB_BTN(1), PP_KB_BTN(1), PP_KB_BTN(1), PP_KB_BTN(1), PP_KB_BTN(1), PP_KB_BTN(1), PP_KB_BTN(1), PP_KB_BTN(1), LV_BUTTONMATRIX_CTRL_CHECKED | PP_KB_BTN(1), LV_BUTTONMATRIX_CTRL_CHECKED | PP_KB_BTN(1), LV_BUTTONMATRIX_CTRL_CHECKED | PP_KB_BTN(1),
    LV_KEYBOARD_CTRL_BUTTON_FLAGS | 2,
#if LV_USE_ARABIC_PERSIAN_CHARS == 1
    LV_KEYBOARD_CTRL_BUTTON_FLAGS | 2,
#endif
    LV_BUTTONMATRIX_CTRL_CHECKED | 2, 6, LV_BUTTONMATRIX_CTRL_CHECKED | 2, LV_KEYBOARD_CTRL_BUTTON_FLAGS | 2
};

static const char * const s_kb_map_spec[] = {
    "1", "2", "3", "4", "5", "6", "7", "8", "9", "0", LV_SYMBOL_BACKSPACE, "\n",
    "abc", "+", "&", "/", "*", "=", "%", "!", "?", "#", "<", ">", "\n",
    "\\", "@", "$", "(", ")", "{", "}", "[", "]", ";", "\"", "'", "\n",
    s_kb_lang_key_text,
#if LV_USE_ARABIC_PERSIAN_CHARS == 1
    "أب",
#endif
    LV_SYMBOL_LEFT, " ", LV_SYMBOL_RIGHT, LV_SYMBOL_OK, ""
};

static const lv_buttonmatrix_ctrl_t s_kb_ctrl_spec[] = {
    PP_KB_BTN(1), PP_KB_BTN(1), PP_KB_BTN(1), PP_KB_BTN(1), PP_KB_BTN(1), PP_KB_BTN(1), PP_KB_BTN(1), PP_KB_BTN(1), PP_KB_BTN(1), PP_KB_BTN(1), LV_BUTTONMATRIX_CTRL_CHECKED | 2,
    LV_KEYBOARD_CTRL_BUTTON_FLAGS | 2, PP_KB_BTN(1), PP_KB_BTN(1), PP_KB_BTN(1), PP_KB_BTN(1), PP_KB_BTN(1), PP_KB_BTN(1), PP_KB_BTN(1), PP_KB_BTN(1), PP_KB_BTN(1), PP_KB_BTN(1), PP_KB_BTN(1), PP_KB_BTN(1),
    PP_KB_BTN(1), PP_KB_BTN(1), PP_KB_BTN(1), PP_KB_BTN(1), PP_KB_BTN(1), PP_KB_BTN(1), PP_KB_BTN(1), PP_KB_BTN(1), PP_KB_BTN(1), PP_KB_BTN(1), PP_KB_BTN(1),
    LV_KEYBOARD_CTRL_BUTTON_FLAGS | 2,
#if LV_USE_ARABIC_PERSIAN_CHARS == 1
    LV_KEYBOARD_CTRL_BUTTON_FLAGS | 2,
#endif
    LV_BUTTONMATRIX_CTRL_CHECKED | 2, 6, LV_BUTTONMATRIX_CTRL_CHECKED | 2, LV_KEYBOARD_CTRL_BUTTON_FLAGS | 2
};

static const char * const s_kb_map_num[] = {
    "1", "2", "3", s_kb_lang_key_text, "\n",
    "4", "5", "6", LV_SYMBOL_OK, "\n",
    "7", "8", "9", LV_SYMBOL_BACKSPACE, "\n",
    "+/-", "0", ".", LV_SYMBOL_LEFT, LV_SYMBOL_RIGHT, ""
};

static const lv_buttonmatrix_ctrl_t s_kb_ctrl_num[] = {
    1, 1, 1, LV_KEYBOARD_CTRL_BUTTON_FLAGS | 2,
    1, 1, 1, LV_KEYBOARD_CTRL_BUTTON_FLAGS | 2,
    1, 1, 1, 2,
    1, 1, 1, 1, 1
};

enum {
    KB_KIND_SPEED = 0,
    KB_KIND_NUMBER = 1,
    KB_KIND_PROGRAM_NAME = 2,
    KB_KIND_TEMP = 3,
    KB_KIND_HOLD = 5,
};

static const char *const s_kb_map_time[] = {
    "1", "2", "3", "\n",
    "4", "5", "6", "\n",
    "7", "8", "9", "\n",
    ":", "0", "DEL", "\n",
    "OK", "X", ""
};

static const char *const s_kb_map_number[] = {
    "1", "2", "3", "\n",
    "4", "5", "6", "\n",
    "7", "8", "9", "\n",
    "0", "DEL", "\n",
    "OK", "X", ""
};

static const char *const s_kb_map_decimal[] = {
    "1", "2", "3", "\n",
    "4", "5", "6", "\n",
    "7", "8", "9", "\n",
    ".", "0", "DEL", "\n",
    "OK", "X", ""
};

static const lv_buttonmatrix_ctrl_t s_kb_ctrl_time[] = {
    LV_KEYBOARD_CTRL_BUTTON_FLAGS, LV_KEYBOARD_CTRL_BUTTON_FLAGS, LV_KEYBOARD_CTRL_BUTTON_FLAGS,
    LV_KEYBOARD_CTRL_BUTTON_FLAGS, LV_KEYBOARD_CTRL_BUTTON_FLAGS, LV_KEYBOARD_CTRL_BUTTON_FLAGS,
    LV_KEYBOARD_CTRL_BUTTON_FLAGS, LV_KEYBOARD_CTRL_BUTTON_FLAGS, LV_KEYBOARD_CTRL_BUTTON_FLAGS,
    LV_KEYBOARD_CTRL_BUTTON_FLAGS, LV_KEYBOARD_CTRL_BUTTON_FLAGS, LV_KEYBOARD_CTRL_BUTTON_FLAGS,
    LV_KEYBOARD_CTRL_BUTTON_FLAGS, LV_KEYBOARD_CTRL_BUTTON_FLAGS
};

static const lv_buttonmatrix_ctrl_t s_kb_ctrl_number[] = {
    LV_KEYBOARD_CTRL_BUTTON_FLAGS, LV_KEYBOARD_CTRL_BUTTON_FLAGS, LV_KEYBOARD_CTRL_BUTTON_FLAGS,
    LV_KEYBOARD_CTRL_BUTTON_FLAGS, LV_KEYBOARD_CTRL_BUTTON_FLAGS, LV_KEYBOARD_CTRL_BUTTON_FLAGS,
    LV_KEYBOARD_CTRL_BUTTON_FLAGS, LV_KEYBOARD_CTRL_BUTTON_FLAGS, LV_KEYBOARD_CTRL_BUTTON_FLAGS,
    LV_KEYBOARD_CTRL_BUTTON_FLAGS, LV_KEYBOARD_CTRL_BUTTON_FLAGS,
    LV_KEYBOARD_CTRL_BUTTON_FLAGS, LV_KEYBOARD_CTRL_BUTTON_FLAGS
};

static const lv_buttonmatrix_ctrl_t s_kb_ctrl_decimal[] = {
    LV_KEYBOARD_CTRL_BUTTON_FLAGS, LV_KEYBOARD_CTRL_BUTTON_FLAGS, LV_KEYBOARD_CTRL_BUTTON_FLAGS,
    LV_KEYBOARD_CTRL_BUTTON_FLAGS, LV_KEYBOARD_CTRL_BUTTON_FLAGS, LV_KEYBOARD_CTRL_BUTTON_FLAGS,
    LV_KEYBOARD_CTRL_BUTTON_FLAGS, LV_KEYBOARD_CTRL_BUTTON_FLAGS, LV_KEYBOARD_CTRL_BUTTON_FLAGS,
    LV_KEYBOARD_CTRL_BUTTON_FLAGS, LV_KEYBOARD_CTRL_BUTTON_FLAGS, LV_KEYBOARD_CTRL_BUTTON_FLAGS,
    LV_KEYBOARD_CTRL_BUTTON_FLAGS, LV_KEYBOARD_CTRL_BUTTON_FLAGS
};

static void programs_update_info();
static void programs_update_info_from_model(uint16_t step_count);
static void action_programs_add_step_async(void *user_data);
static int32_t parse_int_prefix(const char *s);
static float parse_float_prefix(const char *s);
static uint32_t parse_time_s_hms(const char *s);
static void wifi_setup_open_popup(void);
static void wifi_kb_close(void);
static void wifi_setup_close_cb(lv_event_t *e);
static void wifi_setup_connect_cb(lv_event_t *e);
static bool s_programs_add_step_pending = false;
static uint8_t s_programs_add_step_queued = 0;
static uint32_t s_programs_add_step_press_ms = 0;
static uint32_t s_programs_add_step_async_ms = 0;

static bool s_kb_step_active = false;
static uint16_t s_kb_step_idx = 0;
static uint8_t s_kb_step_kind = 0;

static void ui_keyboard_target_size(lv_coord_t *w, lv_coord_t *h) {
    lv_coord_t tw = 480;
    lv_coord_t th = 320;
    lv_display_t *disp = lv_display_get_default();
    if (disp) {
        const lv_coord_t dw = (lv_coord_t)lv_display_get_horizontal_resolution(disp);
        const lv_coord_t dh = (lv_coord_t)lv_display_get_vertical_resolution(disp);
        if (dw > 0) tw = dw;
        if (dh > 0) th = dh;
    }
    if (w) *w = tw;
    if (h) *h = th;
}

static void keyboard_close() {
    lv_obj_t *overlay = s_kb_overlay;
    lv_obj_t *kb = s_kb;
#if defined(ESP_PLATFORM)
    // #region debug-point settings-history-wdt-kb-close
    ESP_LOGI(s_dbg_tag_kb_flow,
             "keyboard_close: cur=%d nav=%d guard=%d overlay=%p ta=%p kb=%p target=%p step_active=%d step_idx=%u kind=%u programs_active=%d act=%p programs=%p",
             (int)ui_get_current_screen_id(),
             ui_is_navigation_active() ? 1 : 0,
             transient_close_guard_active() ? 1 : 0,
             (void *)s_kb_overlay,
             (void *)s_kb_ta,
             (void *)s_kb,
             (void *)s_kb_target,
             s_kb_step_active ? 1 : 0,
             (unsigned)s_kb_step_idx,
             (unsigned)s_kb_step_kind,
             ui_programs_screen_is_active() ? 1 : 0,
             (void *)lv_scr_act(),
             (void *)objects.programs);
    // #endregion
    action_debug_dump_overlay_state("keyboard_close:entry");
#endif
    s_kb_overlay = NULL;
    s_kb_ta = NULL;
    s_kb = NULL;
    s_kb_target = NULL;
    s_kb_back_lbl = NULL;
    s_kb_target_is_program_name = false;
    s_kb_use_affixes = false;
    s_kb_manual_input = false;
    s_kb_prefix[0] = '\0';
    s_kb_suffix[0] = '\0';
    s_kb_step_active = false;
    s_kb_step_idx = 0;
    s_kb_step_kind = 0;
    s_kb_lang_key_text[0] = '\0';
    s_kb_layout_ua = false;
#if defined(ESP_PLATFORM)
    // #region debug-point settings-history-panic-kb-pre-delete
    ESP_LOGI(s_dbg_tag_kb_flow,
             "keyboard_close: pre_delete overlay=%p kb=%p act=%p cur=%d nav=%d guard=%d programs=%p info=%p",
             (void *)overlay,
             (void *)kb,
             (void *)lv_scr_act(),
             (int)ui_get_current_screen_id(),
             ui_is_navigation_active() ? 1 : 0,
             transient_close_guard_active() ? 1 : 0,
             (void *)objects.programs,
             (void *)s_programs_ctx.info_sub);
    // #endregion
#endif
    if (kb && lv_obj_is_valid(kb)) {
        lv_keyboard_set_textarea(kb, NULL);
    }
    if (overlay && lv_obj_is_valid(overlay)) {
        lv_indev_reset(NULL, NULL);
        lv_obj_add_flag(overlay, LV_OBJ_FLAG_HIDDEN);
        lv_obj_delete(overlay);
    }
#if defined(ESP_PLATFORM)
    // #region debug-point settings-history-panic-kb-post-delete
    ESP_LOGI(s_dbg_tag_kb_flow,
             "keyboard_close: post_delete overlay=%p kb=%p act=%p cur=%d nav=%d guard=%d programs=%p info=%p",
             (void *)overlay,
             (void *)kb,
             (void *)lv_scr_act(),
             (int)ui_get_current_screen_id(),
             ui_is_navigation_active() ? 1 : 0,
             transient_close_guard_active() ? 1 : 0,
             (void *)objects.programs,
             (void *)s_programs_ctx.info_sub);
    // #endregion
    action_debug_dump_overlay_state("keyboard_close:post_delete");
#endif
}

void action_close_transient_overlays(void) {
#if defined(ESP_PLATFORM)
    // #region debug-point settings-history-wdt-close-overlays
    ESP_LOGI(s_dbg_tag_nav_race,
             "close_transient_overlays: nav=%d guard=%d kb_overlay=%p wifi_kb=%p wifi_popup=%p step_active=%d",
             ui_is_navigation_active() ? 1 : 0,
             transient_close_guard_active() ? 1 : 0,
             (void *)s_kb_overlay,
             (void *)s_wifi_kb_overlay,
             (void *)s_wifi_setup_popup,
             s_kb_step_active ? 1 : 0);
    // #endregion
    action_debug_dump_overlay_state("close_transient_overlays:entry");
#endif
    s_transient_close_guard_started_ms = lv_tick_get();
    action_block_programs_interaction(1200);
    if (s_kb_overlay) keyboard_close();
    if (s_wifi_kb_overlay) wifi_kb_close();
    if (s_wifi_setup_popup) wifi_setup_close_cb(NULL);
#if defined(ESP_PLATFORM)
    action_debug_dump_overlay_state("close_transient_overlays:exit");
#endif
}

static void keyboard_commit(void) {
    if (ui_is_navigation_active() || transient_close_guard_active()) {
        keyboard_close();
        return;
    }
    const bool on_programs_screen = ui_programs_screen_is_active();
    if (s_kb_ta) {
        const char *txt = lv_textarea_get_text(s_kb_ta);
        if (!txt) txt = "";
        if (s_kb_target_is_program_name) {
            ui_set_selected_program_name(txt);
            if (s_kb_target) lv_label_set_text(s_kb_target, ui_get_selected_program_name());
        } else if (s_kb_target) {
            if (s_kb_use_affixes) {
                char buf[128];
                lv_snprintf(buf, sizeof(buf), "%s%s%s", s_kb_prefix, txt, s_kb_suffix);
                lv_label_set_text(s_kb_target, buf);
            } else {
                lv_label_set_text(s_kb_target, txt);
            }
        }
    }
    if (on_programs_screen && s_kb_step_active && s_kb_target) {
        const uint8_t pid = ui_get_selected_program_id();
        const uint8_t id = (pid == 255) ? 255 : pid;

        const char *cur = lv_label_get_text(s_kb_target);
        if (!cur) cur = "";

        int16_t temp = ui_get_program_step_temp(id, s_kb_step_idx);
        uint16_t rate_x10 = ui_get_program_step_rate_c_per_h_x10(id, s_kb_step_idx);
        uint32_t hold_s = ui_get_program_step_hold_s(id, s_kb_step_idx);

        if (s_kb_step_kind == KB_KIND_TEMP) {
            temp = (int16_t)parse_int_prefix(cur);
        } else if (s_kb_step_kind == KB_KIND_NUMBER || s_kb_step_kind == KB_KIND_SPEED) {
            const float rate = parse_float_prefix(cur);
            const bool per_min = (strstr(cur, "/хв") != NULL) || (strstr(cur, "/min") != NULL) || (strstr(cur, "/m") != NULL);
            float per_h = per_min ? (rate * 60.0f) : rate;
            if (per_h < 0.0f) per_h = 0.0f;
            rate_x10 = (uint16_t)(per_h * 10.0f + 0.5f);
        } else if (s_kb_step_kind == KB_KIND_HOLD) {
            hold_s = parse_time_s_hms(cur);
        }

        ui_set_program_step(id, s_kb_step_idx, temp, rate_x10, hold_s);
    }
    if (on_programs_screen) programs_update_info();
    keyboard_close();
}

static void keyboard_event_cb(lv_event_t *e) {
    const lv_event_code_t code = lv_event_get_code(e);
    if (code == LV_EVENT_CANCEL) {
        keyboard_close();
        return;
    }
    if (code != LV_EVENT_READY) return;
    keyboard_commit();
}

static void keyboard_value_changed_cb(lv_event_t *e) {
    lv_obj_t *kb = lv_event_get_target(e);
    if (!kb) return;
    if (ui_is_navigation_active() || transient_close_guard_active()) {
        keyboard_close();
        return;
    }

    const uint32_t btn_id = lv_buttonmatrix_get_selected_button(kb);
    if (btn_id == LV_BUTTONMATRIX_BUTTON_NONE) return;

    const char *txt = lv_buttonmatrix_get_button_text(kb, btn_id);
    if (!txt || txt[0] == '\0') return;
    if (strcmp(txt, "\n") == 0) return;

    if (strcmp(txt, "UA") == 0 || strcmp(txt, "EN") == 0) {
        const lv_keyboard_mode_t cur_mode = lv_keyboard_get_mode(kb);
        s_kb_layout_ua = !s_kb_layout_ua;
        lv_snprintf(s_kb_lang_key_text, sizeof(s_kb_lang_key_text), "%s", s_kb_layout_ua ? "EN" : "UA");

        lv_keyboard_set_map(kb, LV_KEYBOARD_MODE_TEXT_LOWER, s_kb_layout_ua ? s_kb_map_ua_lc : s_kb_map_text_lc,
                            s_kb_layout_ua ? s_kb_ctrl_ua_lc : s_kb_ctrl_text_lc);
        lv_keyboard_set_map(kb, LV_KEYBOARD_MODE_TEXT_UPPER, s_kb_layout_ua ? s_kb_map_ua_uc : s_kb_map_text_uc,
                            s_kb_layout_ua ? s_kb_ctrl_ua_uc : s_kb_ctrl_text_uc);
        lv_keyboard_set_mode(kb, cur_mode);
        lv_event_stop_processing(e);
        return;
    }

    if (!s_kb_manual_input || !s_kb_ta) return;

    if (strcmp(txt, "DEL") == 0) {
        lv_textarea_delete_char(s_kb_ta);
        lv_event_stop_processing(e);
        return;
    }
    if (strcmp(txt, "X") == 0) {
        lv_textarea_set_text(s_kb_ta, "");
        lv_event_stop_processing(e);
        return;
    }
    if (strcmp(txt, "OK") == 0) {
        keyboard_commit();
        lv_event_stop_processing(e);
        return;
    }

    lv_textarea_add_text(s_kb_ta, txt);
    lv_event_stop_processing(e);
}

static void kb_back_cb(lv_event_t *e) {
    (void)e;
#if defined(ESP_PLATFORM)
    ESP_LOGI(s_dbg_tag_nav_race,
             "kb_back_cb: nav=%d guard=%d overlay=%p target=%p step_active=%d",
             ui_is_navigation_active() ? 1 : 0, transient_close_guard_active() ? 1 : 0,
             (void *)s_kb_overlay, (void *)s_kb_target, s_kb_step_active ? 1 : 0);
#endif
    keyboard_close();
}

static void split_value_text(const char *src, const char *allowed, char *prefix, size_t prefix_sz, char *value, size_t value_sz,
                             char *suffix, size_t suffix_sz) {
    if (!src) src = "";
    if (!allowed) allowed = "0123456789";
    if (prefix && prefix_sz) prefix[0] = '\0';
    if (value && value_sz) value[0] = '\0';
    if (suffix && suffix_sz) suffix[0] = '\0';

    size_t i = 0;
    while (src[i] != '\0') {
        const char c = src[i];
        bool ok = false;
        for (size_t k = 0; allowed[k] != '\0'; k++) {
            if (c == allowed[k]) {
                ok = true;
                break;
            }
        }
        if (ok) break;
        i++;
    }

    size_t j = i;
    while (src[j] != '\0') {
        const char c = src[j];
        bool ok = false;
        for (size_t k = 0; allowed[k] != '\0'; k++) {
            if (c == allowed[k]) {
                ok = true;
                break;
            }
        }
        if (!ok) break;
        j++;
    }

    if (prefix && prefix_sz) {
        const size_t n = (i < prefix_sz - 1) ? i : (prefix_sz - 1);
        memcpy(prefix, src, n);
        prefix[n] = '\0';
    }
    if (value && value_sz) {
        const size_t n = ((j - i) < value_sz - 1) ? (j - i) : (value_sz - 1);
        memcpy(value, src + i, n);
        value[n] = '\0';
    }
    if (suffix && suffix_sz) {
        const size_t len = strlen(src);
        if (j < len) {
            const size_t n = ((len - j) < suffix_sz - 1) ? (len - j) : (suffix_sz - 1);
            memcpy(suffix, src + j, n);
            suffix[n] = '\0';
        }
    }
}

static void keyboard_open_for_label(lv_obj_t *label, bool is_program_name, lv_keyboard_mode_t mode, const char *accepted_chars,
                                    bool use_affixes) {
    if (!label) return;
    if (!ui_programs_screen_is_active()) {
#if defined(ESP_PLATFORM)
        ESP_LOGI(s_dbg_tag_kb_flow,
                 "keyboard_open_for_label: skip reason=programs_inactive cur=%d nav=%d guard=%d programs_guard=%d label=%p act=%p programs=%p",
                 (int)ui_get_current_screen_id(),
                 ui_is_navigation_active() ? 1 : 0,
                 transient_close_guard_active() ? 1 : 0,
                 programs_interaction_guard_active() ? 1 : 0,
                 (void *)label,
                 (void *)lv_scr_act(),
                 (void *)objects.programs);
#endif
        return;
    }
#if defined(ESP_PLATFORM)
    const uint32_t dbg_begin_ms = lv_tick_get();
    ESP_LOGI(s_dbg_tag_kb_flow,
             "keyboard_open_for_label: cur=%d nav=%d guard=%d label=%p label_parent=%p label_parent_kind=%s prog_name=%d mode=%d affixes=%d overlay=%p accepted=%s",
             (int)ui_get_current_screen_id(),
             ui_is_navigation_active() ? 1 : 0,
             transient_close_guard_active() ? 1 : 0,
             (void *)label,
             (void *)lv_obj_get_parent(label),
             ui_debug_obj_kind(lv_obj_get_parent(label)),
             is_program_name ? 1 : 0,
             (int)mode,
             use_affixes ? 1 : 0,
             (void *)s_kb_overlay,
             accepted_chars ? accepted_chars : "(null)");
#endif
    if (s_kb_overlay) keyboard_close();

    lv_coord_t sw = 480;
    lv_coord_t sh = 320;
    ui_keyboard_target_size(&sw, &sh);
    if (sw < 320) sw = 320;
    if (sh < 240) sh = 240;
    const lv_coord_t margin = 10;
    const lv_coord_t gap = 8;
    const lv_coord_t header_h = 44;
    const lv_coord_t back_w = 110;
    const lv_coord_t ta_w = (lv_coord_t)(sw - 2 * margin - gap - back_w);
    const lv_coord_t kb_y = (lv_coord_t)(margin + header_h + gap);

    s_kb_target = label;
    s_kb_target_is_program_name = is_program_name;
    s_kb_use_affixes = use_affixes;

    s_kb_overlay = lv_obj_create(lv_layer_top());
    lv_obj_remove_style_all(s_kb_overlay);
    lv_obj_set_size(s_kb_overlay, lv_pct(100), lv_pct(100));
    lv_obj_set_style_bg_color(s_kb_overlay, lv_color_hex(0xff090c10), LV_PART_MAIN | LV_STATE_DEFAULT);
    lv_obj_set_style_bg_opa(s_kb_overlay, 255, LV_PART_MAIN | LV_STATE_DEFAULT);
    lv_obj_clear_flag(s_kb_overlay, LV_OBJ_FLAG_SCROLLABLE);

    lv_obj_t *panel = lv_obj_create(s_kb_overlay);
    lv_obj_set_pos(panel, 0, 0);
    lv_obj_set_size(panel, sw, sh);
    lv_obj_set_style_bg_opa(panel, LV_OPA_TRANSP, LV_PART_MAIN | LV_STATE_DEFAULT);
    lv_obj_set_style_border_width(panel, 0, LV_PART_MAIN | LV_STATE_DEFAULT);
    lv_obj_set_style_pad_all(panel, 0, LV_PART_MAIN | LV_STATE_DEFAULT);
    lv_obj_clear_flag(panel, LV_OBJ_FLAG_SCROLLABLE);

    const bool compact = (mode == LV_KEYBOARD_MODE_USER_1) || (mode == LV_KEYBOARD_MODE_USER_2) || (mode == LV_KEYBOARD_MODE_USER_3);
    s_kb_manual_input = compact;
    s_kb_layout_ua = !ui_is_english();

    lv_obj_t *btn_back = lv_btn_create(panel);
    lv_obj_set_pos(btn_back, (lv_coord_t)(sw - margin - back_w), margin);
    lv_obj_set_size(btn_back, back_w, header_h);
    lv_obj_set_style_bg_color(btn_back, lv_color_hex(0xff0e131f), LV_PART_MAIN | LV_STATE_DEFAULT);
    lv_obj_set_style_bg_opa(btn_back, 255, LV_PART_MAIN | LV_STATE_DEFAULT);
    lv_obj_set_style_border_color(btn_back, lv_color_hex(0xff1c2538), LV_PART_MAIN | LV_STATE_DEFAULT);
    lv_obj_set_style_border_width(btn_back, 1, LV_PART_MAIN | LV_STATE_DEFAULT);
    lv_obj_set_style_radius(btn_back, 10, LV_PART_MAIN | LV_STATE_DEFAULT);
    lv_obj_add_event_cb(btn_back, kb_back_cb, LV_EVENT_CLICKED, NULL);
    {
        lv_obj_t *lbl = lv_label_create(btn_back);
        lv_obj_set_style_text_font(lbl, &font_4305a60a491c803d80080d015637c7d0, LV_PART_MAIN | LV_STATE_DEFAULT);
        lv_obj_set_style_text_color(lbl, lv_color_hex(0xff7a8b9e), LV_PART_MAIN | LV_STATE_DEFAULT);
        lv_label_set_text(lbl, ui_is_english() ? "BACK" : "НАЗАД");
        lv_obj_center(lbl);
        s_kb_back_lbl = lbl;
    }

    s_kb_ta = lv_textarea_create(panel);
    lv_obj_set_align(s_kb_ta, LV_ALIGN_TOP_LEFT);
    lv_obj_set_pos(s_kb_ta, margin, margin);
    lv_obj_set_size(s_kb_ta, ta_w, header_h);
    lv_obj_set_style_text_font(s_kb_ta, &font_4305a60a491c803d80080d0337447350, LV_PART_MAIN | LV_STATE_DEFAULT);
    lv_obj_set_style_text_color(s_kb_ta, lv_color_hex(0xffffffff), LV_PART_MAIN | LV_STATE_DEFAULT);
    lv_obj_set_style_bg_color(s_kb_ta, lv_color_hex(0xff090c10), LV_PART_MAIN | LV_STATE_DEFAULT);
    lv_obj_set_style_bg_opa(s_kb_ta, 255, LV_PART_MAIN | LV_STATE_DEFAULT);
    lv_obj_set_style_border_color(s_kb_ta, lv_color_hex(0xff1c2538), LV_PART_MAIN | LV_STATE_DEFAULT);
    lv_obj_set_style_border_width(s_kb_ta, 1, LV_PART_MAIN | LV_STATE_DEFAULT);
    lv_obj_set_style_radius(s_kb_ta, 10, LV_PART_MAIN | LV_STATE_DEFAULT);
    lv_textarea_set_one_line(s_kb_ta, true);
    lv_textarea_set_max_length(s_kb_ta, 64);
    if (accepted_chars) lv_textarea_set_accepted_chars(s_kb_ta, accepted_chars);
    if (use_affixes) {
        char val[64];
        split_value_text(lv_label_get_text(label), accepted_chars, s_kb_prefix, sizeof(s_kb_prefix), val, sizeof(val), s_kb_suffix,
                         sizeof(s_kb_suffix));
        lv_textarea_set_text(s_kb_ta, val);
    } else {
        lv_textarea_set_text(s_kb_ta, lv_label_get_text(label));
    }

    s_kb = lv_keyboard_create(panel);
    lv_obj_set_align(s_kb, LV_ALIGN_TOP_LEFT);
    if (compact) {
        lv_obj_set_pos(s_kb, margin, kb_y);
        lv_obj_set_size(s_kb, (lv_coord_t)(sw - 2 * margin), (lv_coord_t)(sh - kb_y - margin));
        if (!s_kb_items_font_inited) {
            memcpy(&s_kb_items_font, LV_FONT_DEFAULT, sizeof(s_kb_items_font));
            s_kb_items_font.fallback = &font_4305a60a491c803d80080d015637c7d0;
            s_kb_items_font_inited = true;
        }
        lv_obj_set_style_text_font(s_kb, &s_kb_items_font, LV_PART_ITEMS | LV_STATE_DEFAULT);
        lv_obj_set_style_pad_row(s_kb, 4, LV_PART_MAIN | LV_STATE_DEFAULT);
        lv_obj_set_style_pad_column(s_kb, 4, LV_PART_MAIN | LV_STATE_DEFAULT);
    } else {
        lv_obj_set_pos(s_kb, margin, kb_y);
        lv_obj_set_size(s_kb, (lv_coord_t)(sw - 2 * margin), (lv_coord_t)(sh - kb_y - margin));
        if (!s_kb_items_font_inited) {
            memcpy(&s_kb_items_font, LV_FONT_DEFAULT, sizeof(s_kb_items_font));
            s_kb_items_font.fallback = &font_4305a60a491c803d80080d015637c7d0;
            s_kb_items_font_inited = true;
        }
        lv_obj_set_style_text_font(s_kb, &s_kb_items_font, LV_PART_ITEMS | LV_STATE_DEFAULT);
        lv_obj_set_style_pad_row(s_kb, 3, LV_PART_MAIN | LV_STATE_DEFAULT);
        lv_obj_set_style_pad_column(s_kb, 3, LV_PART_MAIN | LV_STATE_DEFAULT);
    }
    if (!compact) {
        lv_keyboard_set_textarea(s_kb, s_kb_ta);
    }
    lv_snprintf(s_kb_lang_key_text, sizeof(s_kb_lang_key_text), "%s", s_kb_layout_ua ? "EN" : "UA");
    lv_keyboard_set_mode(s_kb, mode);
    lv_keyboard_set_popovers(s_kb, false);
    lv_keyboard_set_map(s_kb, LV_KEYBOARD_MODE_TEXT_LOWER, s_kb_layout_ua ? s_kb_map_ua_lc : s_kb_map_text_lc,
                        s_kb_layout_ua ? s_kb_ctrl_ua_lc : s_kb_ctrl_text_lc);
    lv_keyboard_set_map(s_kb, LV_KEYBOARD_MODE_TEXT_UPPER, s_kb_layout_ua ? s_kb_map_ua_uc : s_kb_map_text_uc,
                        s_kb_layout_ua ? s_kb_ctrl_ua_uc : s_kb_ctrl_text_uc);
    lv_keyboard_set_map(s_kb, LV_KEYBOARD_MODE_SPECIAL, s_kb_map_spec, s_kb_ctrl_spec);
    lv_keyboard_set_map(s_kb, LV_KEYBOARD_MODE_NUMBER, s_kb_map_num, s_kb_ctrl_num);
    lv_keyboard_set_map(s_kb, LV_KEYBOARD_MODE_USER_1, s_kb_map_time, s_kb_ctrl_time);
    lv_keyboard_set_map(s_kb, LV_KEYBOARD_MODE_USER_2, s_kb_map_number, s_kb_ctrl_number);
    lv_keyboard_set_map(s_kb, LV_KEYBOARD_MODE_USER_3, s_kb_map_decimal, s_kb_ctrl_decimal);
    lv_obj_add_event_cb(s_kb, keyboard_value_changed_cb, (lv_event_code_t)(LV_EVENT_VALUE_CHANGED | LV_EVENT_PREPROCESS), NULL);
    lv_obj_add_event_cb(s_kb, keyboard_event_cb, LV_EVENT_READY, NULL);
    lv_obj_add_event_cb(s_kb, keyboard_event_cb, LV_EVENT_CANCEL, NULL);
#if defined(ESP_PLATFORM)
    // #region debug-point calibration-nav-keyboard-open
    ESP_LOGI(s_dbg_tag_nav_race,
             "keyboard_open_for_label: done dt_ms=%lu overlay=%p ta=%p kb=%p manual=%d",
             (unsigned long)lv_tick_elaps(dbg_begin_ms),
             (void *)s_kb_overlay,
             (void *)s_kb_ta,
             (void *)s_kb,
             s_kb_manual_input ? 1 : 0);
    // #endregion
    action_debug_dump_overlay_state("keyboard_open:done");
#endif
}

void action_programs_choose(lv_event_t *e) {
    (void)e;
    requestScreen(SCREEN_ID__1);
}

static lv_obj_t *get_user_obj(lv_event_t *e) {
    return (lv_obj_t *)lv_event_get_user_data(e);
}

static int32_t parse_int_prefix(const char *s) {
    if (!s) return 0;
    int32_t sign = 1;
    while (*s == ' ') s++;
    if (*s == '-') {
        sign = -1;
        s++;
    }
    int32_t v = 0;
    bool any = false;
    while (*s) {
        if (*s >= '0' && *s <= '9') {
            any = true;
            v = (v * 10) + (*s - '0');
        } else if (any) {
            break;
        }
        s++;
    }
    return v * sign;
}

static float parse_float_prefix(const char *s) {
    if (!s) return 0.0f;
    while (*s == ' ') s++;
    float sign = 1.0f;
    if (*s == '-') {
        sign = -1.0f;
        s++;
    }
    float v = 0.0f;
    bool any = false;
    while (*s) {
        if (*s >= '0' && *s <= '9') {
            any = true;
            v = (v * 10.0f) + (float)(*s - '0');
        } else if (*s == '.' || *s == ',') {
            s++;
            float mul = 0.1f;
            while (*s >= '0' && *s <= '9') {
                any = true;
                v += (float)(*s - '0') * mul;
                mul *= 0.1f;
                s++;
            }
            break;
        } else if (any) {
            break;
        }
        s++;
    }
    return v * sign;
}

static uint32_t parse_time_s_hms(const char *s) {
    if (!s) return 0;
    int parts[3] = { 0, 0, 0 };
    int p = 0;
    const char *cur = s;
    while (*cur && p < 3) {
        if ((*cur >= '0' && *cur <= '9') || *cur == '-') {
            parts[p] = (int)parse_int_prefix(cur);
            while (*cur && *cur != ':') cur++;
            if (*cur == ':') cur++;
            p++;
        } else {
            cur++;
        }
    }
    if (p == 0) return 0;
    int h = 0, m = 0, sec = 0;
    if (p == 1) {
        m = parts[0];
    } else if (p == 2) {
        h = parts[0];
        m = parts[1];
    } else {
        h = parts[0];
        m = parts[1];
        sec = parts[2];
    }
    if (h < 0) h = 0;
    if (m < 0) m = 0;
    if (sec < 0) sec = 0;
    return (uint32_t)(h * 3600 + m * 60 + sec);
}

static void fmt_hms(uint32_t sec, char *out, size_t out_sz) {
    const uint32_t h = sec / 3600;
    const uint32_t m = (sec % 3600) / 60;
    const uint32_t s2 = sec % 60;
    lv_snprintf(out, out_sz, "%u:%02u:%02u", (unsigned)h, (unsigned)m, (unsigned)s2);
}

static void programs_capture_selected(uint8_t dst_program_id, uint8_t src_program_id) {
    const uint16_t steps = ui_get_selected_program_steps_total();
    const uint16_t capped = (steps > 50) ? 50 : steps;
    for (uint16_t i = 0; i < capped; i++) {
        ui_set_program_step(dst_program_id,
                            i,
                            ui_get_program_step_temp(src_program_id, i),
                            ui_get_program_step_rate_c_per_h_x10(src_program_id, i),
                            ui_get_program_step_hold_s(src_program_id, i));
    }
    for (uint16_t i = capped; i < 50; i++) {
        ui_set_program_step(dst_program_id, i, 0, 0, 0);
    }
    ui_set_program_total_time_s(dst_program_id, ui_get_selected_program_total_time_s());
}

static void programs_update_info() {
    if (!ui_programs_screen_is_active()) {
#if defined(ESP_PLATFORM)
        // #region debug-point settings-calibration-programs-info
        ESP_LOGI(s_dbg_tag_kb_flow,
                 "programs_update_info: skip reason=screen_inactive cur=%d nav=%d guard=%d programs_guard=%d act=%p programs=%p info=%p",
                 (int)ui_get_current_screen_id(),
                 ui_is_navigation_active() ? 1 : 0,
                 transient_close_guard_active() ? 1 : 0,
                 programs_interaction_guard_active() ? 1 : 0,
                 (void *)lv_scr_act(),
                 (void *)objects.programs,
                 (void *)s_programs_ctx.info_sub);
        // #endregion
#endif
        return;
    }
    if (!s_programs_ctx.info_sub) {
#if defined(ESP_PLATFORM)
        // #region debug-point settings-calibration-programs-info
        ESP_LOGI(s_dbg_tag_kb_flow, "programs_update_info: skip reason=no_info_sub cur=%d act=%p programs=%p",
                 (int)ui_get_current_screen_id(), (void *)lv_scr_act(), (void *)objects.programs);
        // #endregion
#endif
        return;
    }
    if (!lv_obj_is_valid(s_programs_ctx.info_sub)) {
#if defined(ESP_PLATFORM)
        // #region debug-point settings-calibration-programs-info
        ESP_LOGI(s_dbg_tag_kb_flow, "programs_update_info: invalid info_sub=%p list=%p",
                 (void *)s_programs_ctx.info_sub, (void *)s_programs_ctx.list);
        // #endregion
#endif
        s_programs_ctx.list = NULL;
        s_programs_ctx.info_sub = NULL;
        return;
    }
#if defined(ESP_PLATFORM)
    // #region debug-point add-step-info
    const uint32_t info_begin_ms = lv_tick_get();
    // #endregion
#endif
    programs_update_info_from_model(ui_get_selected_program_steps_total());
#if defined(ESP_PLATFORM)
    // #region debug-point add-step-info
    ESP_LOGI(s_dbg_tag_add_step,
             "info done dt=%lu since_press=%lu since_async=%lu",
             (unsigned long)(lv_tick_get() - info_begin_ms),
             (unsigned long)(s_programs_add_step_press_ms ? (lv_tick_get() - s_programs_add_step_press_ms) : 0),
             (unsigned long)(s_programs_add_step_async_ms ? (lv_tick_get() - s_programs_add_step_async_ms) : 0));
    // #endregion
#endif
}

static void programs_reindex() {
    if (!s_programs_ctx.list) return;
    if (!lv_obj_is_valid(s_programs_ctx.list)) {
        s_programs_ctx.list = NULL;
        s_programs_ctx.info_sub = NULL;
        return;
    }
    const uint32_t cnt = lv_obj_get_child_count(s_programs_ctx.list);
    if (cnt == 0) return;
    for (uint32_t i = 0; i < cnt; i++) {
        if ((i % 4) == 0) PP_ACTIONS_YIELD();
        lv_obj_t *row = lv_obj_get_child(s_programs_ctx.list, i);
        if (!row) continue;
        lv_obj_t *idx = lv_obj_get_child(row, 1);
        if (!idx) continue;
        char buf[8];
        lv_snprintf(buf, sizeof(buf), "%u", (unsigned)(i + 1));
        const char *cur = lv_label_get_text(idx);
        if (!cur || strcmp(cur, buf) != 0) {
            lv_label_set_text(idx, buf);
        }
    }
    PP_ACTIONS_YIELD();
    programs_update_info();
    ui_set_selected_program_steps_total((uint16_t)cnt);
    const uint8_t pid = ui_get_selected_program_id();
    if (pid != 255) ui_set_program_steps_total(pid, (uint16_t)cnt);
}

static lv_obj_t *programs_create_row(lv_obj_t *list, const char *temp, const char *speed, const char *hold) {
    lv_obj_t *row = lv_obj_create(list);
    lv_coord_t rw = list ? lv_obj_get_width(list) : 0;
    if (rw <= 0) rw = 780;
    lv_obj_set_size(row, rw, 56);
    lv_obj_set_style_bg_color(row, lv_color_hex(0xff0e131f), LV_PART_MAIN | LV_STATE_DEFAULT);
    lv_obj_set_style_bg_opa(row, 255, LV_PART_MAIN | LV_STATE_DEFAULT);
    lv_obj_set_style_border_width(row, 0, LV_PART_MAIN | LV_STATE_DEFAULT);
    lv_obj_set_style_radius(row, 0, LV_PART_MAIN | LV_STATE_DEFAULT);
    lv_obj_set_style_pad_all(row, 12, LV_PART_MAIN | LV_STATE_DEFAULT);
    lv_obj_set_style_pad_column(row, 12, LV_PART_MAIN | LV_STATE_DEFAULT);
    lv_obj_clear_flag(row, LV_OBJ_FLAG_SCROLLABLE);
    lv_obj_set_flex_flow(row, LV_FLEX_FLOW_ROW);
    lv_obj_set_flex_align(row, LV_FLEX_ALIGN_START, LV_FLEX_ALIGN_CENTER, LV_FLEX_ALIGN_CENTER);
    lv_obj_add_flag(row, LV_OBJ_FLAG_CLICKABLE);
    lv_obj_add_event_cb(row, action_programs_row_click, LV_EVENT_CLICKED, row);

    PP_ACTIONS_YIELD();
    lv_obj_t *drag = lv_label_create(row);
    lv_obj_set_width(drag, 28);
    lv_obj_set_style_text_align(drag, LV_TEXT_ALIGN_CENTER, LV_PART_MAIN | LV_STATE_DEFAULT);
    lv_obj_set_style_text_font(drag, &font_4305a60a491c803d80080d015637c7d0, LV_PART_MAIN | LV_STATE_DEFAULT);
    lv_obj_set_style_text_color(drag, lv_color_hex(0xff7a8b9e), LV_PART_MAIN | LV_STATE_DEFAULT);
    lv_label_set_text(drag, "||");

    PP_ACTIONS_YIELD();
    lv_obj_t *idx = lv_label_create(row);
    lv_obj_set_width(idx, 52);
    lv_obj_set_style_text_align(idx, LV_TEXT_ALIGN_CENTER, LV_PART_MAIN | LV_STATE_DEFAULT);
    lv_obj_set_style_text_font(idx, &font_4305a60a491c803d80080d015637c7d0, LV_PART_MAIN | LV_STATE_DEFAULT);
    lv_obj_set_style_text_color(idx, lv_color_hex(0xffffffff), LV_PART_MAIN | LV_STATE_DEFAULT);
    lv_label_set_text(idx, "?");

    PP_ACTIONS_YIELD();
    lv_obj_t *t = lv_label_create(row);
    lv_obj_set_width(t, 190);
    lv_label_set_long_mode(t, LV_LABEL_LONG_DOT);
    lv_obj_set_style_text_align(t, LV_TEXT_ALIGN_CENTER, LV_PART_MAIN | LV_STATE_DEFAULT);
    lv_obj_set_style_text_font(t, &font_4305a60a491c803d80080d015637c7d0, LV_PART_MAIN | LV_STATE_DEFAULT);
    lv_obj_set_style_text_color(t, lv_color_hex(0xff00b761), LV_PART_MAIN | LV_STATE_DEFAULT);
    lv_label_set_text(t, temp);
    lv_obj_add_flag(t, LV_OBJ_FLAG_CLICKABLE);
    lv_obj_add_event_cb(t, action_open_keyboard, LV_EVENT_CLICKED, (void *)3);

    PP_ACTIONS_YIELD();
    lv_obj_t *s = lv_label_create(row);
    lv_obj_set_width(s, 190);
    lv_label_set_long_mode(s, LV_LABEL_LONG_DOT);
    lv_obj_set_style_text_align(s, LV_TEXT_ALIGN_CENTER, LV_PART_MAIN | LV_STATE_DEFAULT);
    lv_obj_set_style_text_font(s, &font_4305a60a491c803d80080d015637c7d0, LV_PART_MAIN | LV_STATE_DEFAULT);
    lv_obj_set_style_text_color(s, lv_color_hex(0xff00b761), LV_PART_MAIN | LV_STATE_DEFAULT);
    lv_label_set_text(s, speed);
    lv_obj_add_flag(s, LV_OBJ_FLAG_CLICKABLE);
    lv_obj_add_event_cb(s, action_open_keyboard, LV_EVENT_CLICKED, (void *)0);

    PP_ACTIONS_YIELD();
    lv_obj_t *h = lv_label_create(row);
    lv_obj_set_width(h, 140);
    lv_label_set_long_mode(h, LV_LABEL_LONG_DOT);
    lv_obj_set_style_text_align(h, LV_TEXT_ALIGN_CENTER, LV_PART_MAIN | LV_STATE_DEFAULT);
    lv_obj_set_style_text_font(h, &font_4305a60a491c803d80080d015637c7d0, LV_PART_MAIN | LV_STATE_DEFAULT);
    lv_obj_set_style_text_color(h, lv_color_hex(0xff00b761), LV_PART_MAIN | LV_STATE_DEFAULT);
    lv_label_set_text(h, hold);
    lv_obj_add_flag(h, LV_OBJ_FLAG_CLICKABLE);
    lv_obj_add_event_cb(h, action_open_keyboard, LV_EVENT_CLICKED, (void *)5);

    PP_ACTIONS_YIELD();
    lv_obj_t *trash = lv_btn_create(row);
    lv_obj_set_size(trash, 56, 48);
    lv_obj_set_style_bg_color(trash, lv_color_hex(0xff421212), LV_PART_MAIN | LV_STATE_DEFAULT);
    lv_obj_set_style_bg_opa(trash, 255, LV_PART_MAIN | LV_STATE_DEFAULT);
    lv_obj_set_style_border_width(trash, 0, LV_PART_MAIN | LV_STATE_DEFAULT);
    lv_obj_set_style_radius(trash, 0, LV_PART_MAIN | LV_STATE_DEFAULT);
    lv_obj_add_event_cb(trash, action_programs_delete_row, LV_EVENT_CLICKED, row);
    lv_obj_t *lbl = lv_label_create(trash);
    lv_obj_set_style_text_font(lbl, &font_4305a60a491c803d80080d015637c7d0, LV_PART_MAIN | LV_STATE_DEFAULT);
    lv_obj_set_style_text_color(lbl, lv_color_hex(0xffff3b30), LV_PART_MAIN | LV_STATE_DEFAULT);
    lv_label_set_text(lbl, LV_SYMBOL_TRASH);
    lv_obj_center(lbl);

    return row;
}

typedef struct {
    lv_obj_t *overlay;
    lv_obj_t *row;
} confirm_ctx_t;

typedef struct {
    lv_obj_t *overlay;
    uint8_t program_id;
} confirm_prog_ctx_t;

typedef struct {
    lv_obj_t *overlay;
    uint16_t step;
} confirm_step_ctx_t;

static void confirm_overlay_fullscreen(lv_obj_t *overlay) {
    if (!overlay) return;
    lv_coord_t sw = 480;
    lv_coord_t sh = 320;
    lv_display_t *disp = lv_display_get_default();
    if (disp) {
        const lv_coord_t dw = (lv_coord_t)lv_display_get_horizontal_resolution(disp);
        const lv_coord_t dh = (lv_coord_t)lv_display_get_vertical_resolution(disp);
        if (dw > 0) sw = dw;
        if (dh > 0) sh = dh;
    }
    lv_obj_set_pos(overlay, 0, 0);
    lv_obj_set_size(overlay, sw, sh);
    lv_obj_update_layout(overlay);
}

static void confirm_panel_layout(lv_obj_t *panel, lv_obj_t *txt, lv_obj_t *btn_cancel, lv_obj_t *btn_ok) {
    if (!panel) return;

    lv_obj_t *parent = lv_obj_get_parent(panel);
    lv_coord_t sw = parent ? lv_obj_get_width(parent) : 0;
    lv_coord_t sh = parent ? lv_obj_get_height(parent) : 0;
    if (sw <= 0 || sh <= 0) {
        lv_display_t *disp = lv_display_get_default();
        if (disp) {
            const lv_coord_t dw = (lv_coord_t)lv_display_get_horizontal_resolution(disp);
            const lv_coord_t dh = (lv_coord_t)lv_display_get_vertical_resolution(disp);
            if (dw > 0) sw = dw;
            if (dh > 0) sh = dh;
        }
    }
    if (sw <= 0) sw = 480;
    if (sh <= 0) sh = 320;

    style_flat_panel(panel, lv_color_hex(0xff0e131f), lv_color_hex(0xff1c2538), 1, 16, 16);
    lv_coord_t margin_x = (lv_coord_t)LV_MAX(24, (lv_coord_t)(sw / 12));
    lv_coord_t margin_y = (lv_coord_t)LV_MAX(24, (lv_coord_t)(sh / 10));
    if ((lv_coord_t)(margin_x * 2) > (lv_coord_t)(sw - 40)) margin_x = (lv_coord_t)LV_MAX(20, (lv_coord_t)((sw - 40) / 2));
    if ((lv_coord_t)(margin_y * 2) > (lv_coord_t)(sh - 40)) margin_y = (lv_coord_t)LV_MAX(20, (lv_coord_t)((sh - 40) / 2));
    const lv_coord_t panel_w = (lv_coord_t)LV_MAX(220, (lv_coord_t)(sw - (margin_x * 2)));
    const lv_coord_t panel_h = (lv_coord_t)LV_MAX(160, (lv_coord_t)(sh - (margin_y * 2)));
    lv_obj_set_size(panel, panel_w, panel_h);
    lv_obj_set_pos(panel, (lv_coord_t)((sw - panel_w) / 2), (lv_coord_t)((sh - panel_h) / 2));
    const lv_coord_t side_pad = (lv_coord_t)LV_MAX(16, panel_w / 18);
    const lv_coord_t top_pad = (lv_coord_t)LV_MAX(18, panel_h / 10);
    const lv_coord_t bottom_pad = (lv_coord_t)LV_MAX(14, panel_h / 12);
    const lv_coord_t btn_gap = (lv_coord_t)LV_MAX(12, panel_w / 22);
    const lv_coord_t btn_h = (lv_coord_t)LV_MAX(54, panel_h / 5);
    const lv_coord_t btn_w = (lv_coord_t)((panel_w - (side_pad * 2) - btn_gap) / 2);
    const lv_coord_t btn_y = (lv_coord_t)(panel_h - bottom_pad - btn_h);

    if (txt) {
        lv_obj_set_pos(txt, side_pad, top_pad);
        lv_obj_set_size(txt, (lv_coord_t)(panel_w - side_pad * 2), (lv_coord_t)LV_MAX(52, btn_y - top_pad - 10));
        lv_obj_set_style_text_color(txt, lv_color_hex(0xffffffff), LV_PART_MAIN | LV_STATE_DEFAULT);
        lv_obj_set_style_text_align(txt, LV_TEXT_ALIGN_CENTER, LV_PART_MAIN | LV_STATE_DEFAULT);
        lv_obj_set_style_text_font(txt, &font_4305a60a491c803d80080d015637c7d0, LV_PART_MAIN | LV_STATE_DEFAULT);
        lv_obj_set_style_text_line_space(txt, 3, LV_PART_MAIN | LV_STATE_DEFAULT);
        lv_label_set_long_mode(txt, LV_LABEL_LONG_WRAP);
        lv_obj_clear_flag(txt, LV_OBJ_FLAG_HIDDEN);
    }

    if (btn_cancel) {
        lv_obj_set_pos(btn_cancel, side_pad, btn_y);
        lv_obj_set_size(btn_cancel, btn_w, btn_h);
        lv_obj_clear_flag(btn_cancel, LV_OBJ_FLAG_HIDDEN);
    }

    if (btn_ok) {
        lv_obj_set_pos(btn_ok, (lv_coord_t)(side_pad + btn_w + btn_gap), btn_y);
        lv_obj_set_size(btn_ok, btn_w, btn_h);
        lv_obj_clear_flag(btn_ok, LV_OBJ_FLAG_HIDDEN);
    }
}

static void start_firing_now(void) {
    const int code = kiln_ui_start_selected_program();
#if defined(ESP_PLATFORM)
    ESP_LOGI(s_dbg_tag_start_firing, "start_result: code=%d sel_id=%u sel_name='%s'",
             code, (unsigned)ui_get_selected_program_id(), ui_get_selected_program_name());
#endif
    if (code == 0) {
        toast_show(ui_is_english() ? "Started" : "Запущено");
        requestScreen(SCREEN_ID__1);
        return;
    }
    if (code == 13) {
        toast_show(ui_is_english() ? "No program selected" : "Не вибрано програму");
        return;
    }
    if (code == 14) {
        toast_show(ui_is_english() ? "Thermocouple error" : "Помилка термопари");
        return;
    }
    if (code == 16) {
        toast_show(ui_is_english() ? "Fault active" : "Активна помилка");
        return;
    }
    if (code == 17) {
        toast_show(ui_is_english() ? "Fan settings unsafe" : "Небезпечні налаштування вентилятора");
        return;
    }
    if (code == 18) {
        toast_show(ui_is_english() ? "Schedule exceeds max temp" : "Програма перевищує максимум температури");
        return;
    }
    if (code == 19) {
        toast_show(ui_is_english() ? "Clock not set" : "Годинник не налаштований");
        return;
    }
    if (code == 15) {
        toast_show(ui_is_english() ? "Touch not calibrated" : "Тач не відкалібрований");
        return;
    }
    toast_show(ui_is_english() ? "Start failed" : "Не вдалося запустити");
}

static void confirm_close(confirm_ctx_t *ctx) {
    if (!ctx) return;
    pp_obj_delete_async_safe(&ctx->overlay);
    lv_free(ctx);
}

static void confirm_prog_close(confirm_prog_ctx_t *ctx) {
    if (!ctx) return;
    pp_obj_delete_async_safe(&ctx->overlay);
    lv_free(ctx);
}

static void confirm_cancel_cb(lv_event_t *e) {
    confirm_ctx_t *ctx = (confirm_ctx_t *)lv_event_get_user_data(e);
    confirm_close(ctx);
}

static void confirm_prog_cancel_cb(lv_event_t *e) {
    confirm_prog_ctx_t *ctx = (confirm_prog_ctx_t *)lv_event_get_user_data(e);
#if defined(ESP_PLATFORM)
    // #region debug-point settings-history-wdt-confirm-prog-cancel
    ESP_LOGI(s_dbg_tag_nav_race,
             "confirm_prog_cancel_cb: nav=%d guard=%d overlay=%p program_id=%u",
             ui_is_navigation_active() ? 1 : 0, transient_close_guard_active() ? 1 : 0,
             ctx ? (void *)ctx->overlay : NULL, ctx ? (unsigned)ctx->program_id : 0U);
    // #endregion
#endif
    confirm_prog_close(ctx);
}

static void confirm_step_cancel_cb(lv_event_t *e) {
    confirm_step_ctx_t *ctx = (confirm_step_ctx_t *)lv_event_get_user_data(e);
    if (!ctx) return;
    pp_obj_delete_async_safe(&ctx->overlay);
    lv_free(ctx);
}

static void confirm_ok_cb(lv_event_t *e) {
    confirm_ctx_t *ctx = (confirm_ctx_t *)lv_event_get_user_data(e);
    if (ctx && ctx->row) {
        pp_obj_delete_async_safe_event(e, &ctx->row);
    }
    if (ctx) {
        pp_obj_delete_async_safe_event(e, &ctx->overlay);
    }
    (void)lv_async_call(programs_reindex_async_cb, NULL);
    if (ctx) lv_free(ctx);
}

static void confirm_prog_ok_cb(lv_event_t *e) {
    confirm_prog_ctx_t *ctx = (confirm_prog_ctx_t *)lv_event_get_user_data(e);
    if (!ctx) return;
    // #region debug-point program-delete-freeze
#if defined(ESP_PLATFORM)
    ESP_LOGI(s_dbg_tag_program_delete_freeze, "confirm_prog_ok_cb: id=%u count(before)=%u",
             (unsigned)ctx->program_id, (unsigned)ui_get_program_count());
#endif
    // #endregion
    const bool ok = ui_delete_program(ctx->program_id);
    // #region debug-point program-delete-freeze
#if defined(ESP_PLATFORM)
    ESP_LOGI(s_dbg_tag_program_delete_freeze, "ui_delete_program: ok=%d count(after)=%u sel=%u",
             (int)ok, (unsigned)ui_get_program_count(), (unsigned)ui_get_selected_program_id());
#endif
    // #endregion
    if (ok) {
        // #region debug-point program-delete-freeze
#if defined(ESP_PLATFORM)
        ESP_LOGI(s_dbg_tag_program_delete_freeze, "persist_save: begin");
#endif
        // #endregion
        ui_programs_persist_save();
        // #region debug-point program-delete-freeze
#if defined(ESP_PLATFORM)
        ESP_LOGI(s_dbg_tag_program_delete_freeze, "persist_save: end");
#endif
        // #endregion
        if (objects.programs_list != NULL) {
            screen_programs_list_refresh();
        } else {
            request_fresh_screen(SCREEN_ID_PROGRAMS_LIST);
        }
    }
    pp_obj_delete_async_safe_event(e, &ctx->overlay);
    lv_free(ctx);
}

static void confirm_step_ok_cb(lv_event_t *e) {
    confirm_step_ctx_t *ctx = (confirm_step_ctx_t *)lv_event_get_user_data(e);
    if (!ctx) return;

    const uint8_t pid = ui_get_selected_program_id();
    const uint8_t id = (pid == 255) ? 255 : pid;
    if (ui_program_delete_step(id, ctx->step)) {
        screen_programs_refresh_rows();
        programs_update_info();
    }

    pp_obj_delete_async_safe_event(e, &ctx->overlay);
    lv_free(ctx);
}

static void confirm_delete_row(lv_obj_t *row) {
    confirm_ctx_t *ctx = lv_malloc(sizeof(confirm_ctx_t));
    if (!ctx) return;
    ctx->row = row;
    ctx->overlay = lv_obj_create(lv_layer_top());
    lv_obj_remove_style_all(ctx->overlay);
    confirm_overlay_fullscreen(ctx->overlay);
    lv_obj_set_style_bg_color(ctx->overlay, lv_color_hex(0x000000), LV_PART_MAIN | LV_STATE_DEFAULT);
    lv_obj_set_style_bg_opa(ctx->overlay, 160, LV_PART_MAIN | LV_STATE_DEFAULT);
    lv_obj_clear_flag(ctx->overlay, LV_OBJ_FLAG_SCROLLABLE);

    lv_obj_t *panel = lv_obj_create(ctx->overlay);
    lv_obj_center(panel);

    lv_obj_t *txt = lv_label_create(panel);
    lv_label_set_text(txt, ui_is_english() ? "Delete this step?" : "Видалити цей крок?");

    lv_obj_t *btn_cancel = lv_btn_create(panel);
    style_flat_button(btn_cancel, lv_color_hex(0xff0e131f), 255, lv_color_hex(0xff1c2538), 1, 10);
    lv_obj_add_event_cb(btn_cancel, confirm_cancel_cb, LV_EVENT_CLICKED, ctx);
    lv_obj_t *lc = lv_label_create(btn_cancel);
    lv_obj_set_style_text_color(lc, lv_color_hex(0xffffffff), LV_PART_MAIN | LV_STATE_DEFAULT);
    lv_obj_set_style_text_font(lc, &font_4305a60a491c803d80080d05cbb3cac2, LV_PART_MAIN | LV_STATE_DEFAULT);
    lv_label_set_text(lc, ui_is_english() ? "Cancel" : "Скасувати");
    lv_obj_center(lc);

    lv_obj_t *btn_ok = lv_btn_create(panel);
    style_flat_button(btn_ok, lv_color_hex(0xff00b761), 255, lv_color_hex(0xff00b761), 0, 10);
    lv_obj_add_event_cb(btn_ok, confirm_ok_cb, LV_EVENT_CLICKED, ctx);
    lv_obj_t *lo = lv_label_create(btn_ok);
    lv_obj_set_style_text_color(lo, lv_color_hex(0xffffffff), LV_PART_MAIN | LV_STATE_DEFAULT);
    lv_obj_set_style_text_font(lo, &font_4305a60a491c803d80080d05cbb3cac2, LV_PART_MAIN | LV_STATE_DEFAULT);
    lv_label_set_text(lo, ui_is_english() ? "Confirm" : "Підтвердити");
    lv_obj_center(lo);

    confirm_panel_layout(panel, txt, btn_cancel, btn_ok);
}

static void confirm_delete_obj(lv_obj_t *obj, const char *text) {
    confirm_ctx_t *ctx = lv_malloc(sizeof(confirm_ctx_t));
    if (!ctx) return;
    ctx->row = obj;
    ctx->overlay = lv_obj_create(lv_layer_top());
    lv_obj_remove_style_all(ctx->overlay);
    confirm_overlay_fullscreen(ctx->overlay);
    lv_obj_set_style_bg_color(ctx->overlay, lv_color_hex(0x000000), LV_PART_MAIN | LV_STATE_DEFAULT);
    lv_obj_set_style_bg_opa(ctx->overlay, 160, LV_PART_MAIN | LV_STATE_DEFAULT);
    lv_obj_clear_flag(ctx->overlay, LV_OBJ_FLAG_SCROLLABLE);

    lv_obj_t *panel = lv_obj_create(ctx->overlay);
    lv_obj_center(panel);

    lv_obj_t *txt = lv_label_create(panel);
    lv_label_set_text(txt, text);

    lv_obj_t *btn_cancel = lv_btn_create(panel);
    style_flat_button(btn_cancel, lv_color_hex(0xff0e131f), 255, lv_color_hex(0xff1c2538), 1, 10);
    lv_obj_add_event_cb(btn_cancel, confirm_cancel_cb, LV_EVENT_CLICKED, ctx);
    lv_obj_t *lc = lv_label_create(btn_cancel);
    lv_obj_set_style_text_color(lc, lv_color_hex(0xffffffff), LV_PART_MAIN | LV_STATE_DEFAULT);
    lv_obj_set_style_text_font(lc, &font_4305a60a491c803d80080d05cbb3cac2, LV_PART_MAIN | LV_STATE_DEFAULT);
    lv_label_set_text(lc, ui_is_english() ? "Cancel" : "Скасувати");
    lv_obj_center(lc);

    lv_obj_t *btn_ok = lv_btn_create(panel);
    style_flat_button(btn_ok, lv_color_hex(0xffff3b30), 255, lv_color_hex(0xffff3b30), 0, 10);
    lv_obj_add_event_cb(btn_ok, confirm_ok_cb, LV_EVENT_CLICKED, ctx);
    lv_obj_t *lo = lv_label_create(btn_ok);
    lv_obj_set_style_text_color(lo, lv_color_hex(0xffffffff), LV_PART_MAIN | LV_STATE_DEFAULT);
    lv_obj_set_style_text_font(lo, &font_4305a60a491c803d80080d05cbb3cac2, LV_PART_MAIN | LV_STATE_DEFAULT);
    lv_label_set_text(lo, ui_is_english() ? "Confirm" : "Підтвердити");
    lv_obj_center(lo);

    confirm_panel_layout(panel, txt, btn_cancel, btn_ok);
}

void confirm_delete_program(uint8_t id) {
    confirm_prog_ctx_t *ctx = lv_malloc(sizeof(confirm_prog_ctx_t));
    if (!ctx) return;
    ctx->program_id = id;
    ctx->overlay = lv_obj_create(lv_layer_top());
    lv_obj_remove_style_all(ctx->overlay);
    confirm_overlay_fullscreen(ctx->overlay);
    lv_obj_set_style_bg_color(ctx->overlay, lv_color_hex(0x000000), LV_PART_MAIN | LV_STATE_DEFAULT);
    lv_obj_set_style_bg_opa(ctx->overlay, 160, LV_PART_MAIN | LV_STATE_DEFAULT);
    lv_obj_clear_flag(ctx->overlay, LV_OBJ_FLAG_SCROLLABLE);

    lv_obj_t *panel = lv_obj_create(ctx->overlay);
    lv_obj_center(panel);

    lv_obj_t *txt = lv_label_create(panel);
    lv_label_set_text(txt, ui_is_english() ? "Delete this program?" : "Видалити цю програму?");

    lv_obj_t *btn_cancel = lv_btn_create(panel);
    style_flat_button(btn_cancel, lv_color_hex(0xff0e131f), 255, lv_color_hex(0xff1c2538), 1, 10);
    lv_obj_add_event_cb(btn_cancel, confirm_prog_cancel_cb, LV_EVENT_CLICKED, ctx);
    lv_obj_t *lc = lv_label_create(btn_cancel);
    lv_obj_set_style_text_color(lc, lv_color_hex(0xffffffff), LV_PART_MAIN | LV_STATE_DEFAULT);
    lv_obj_set_style_text_font(lc, &font_4305a60a491c803d80080d05cbb3cac2, LV_PART_MAIN | LV_STATE_DEFAULT);
    lv_label_set_text(lc, ui_is_english() ? "Cancel" : "Скасувати");
    lv_obj_center(lc);

    lv_obj_t *btn_ok = lv_btn_create(panel);
    style_flat_button(btn_ok, lv_color_hex(0xffff3b30), 255, lv_color_hex(0xffff3b30), 0, 10);
    lv_obj_add_event_cb(btn_ok, confirm_prog_ok_cb, LV_EVENT_CLICKED, ctx);
    lv_obj_t *lo = lv_label_create(btn_ok);
    lv_obj_set_style_text_color(lo, lv_color_hex(0xffffffff), LV_PART_MAIN | LV_STATE_DEFAULT);
    lv_obj_set_style_text_font(lo, &font_4305a60a491c803d80080d05cbb3cac2, LV_PART_MAIN | LV_STATE_DEFAULT);
    lv_label_set_text(lo, ui_is_english() ? "Confirm" : "Підтвердити");
    lv_obj_center(lo);

    confirm_panel_layout(panel, txt, btn_cancel, btn_ok);
}

static void confirm_delete_step(uint16_t step) {
    confirm_step_ctx_t *ctx = lv_malloc(sizeof(confirm_step_ctx_t));
    if (!ctx) return;
    ctx->step = step;
    ctx->overlay = lv_obj_create(lv_layer_top());
    lv_obj_remove_style_all(ctx->overlay);
    confirm_overlay_fullscreen(ctx->overlay);
    lv_obj_set_style_bg_color(ctx->overlay, lv_color_hex(0x000000), LV_PART_MAIN | LV_STATE_DEFAULT);
    lv_obj_set_style_bg_opa(ctx->overlay, 160, LV_PART_MAIN | LV_STATE_DEFAULT);
    lv_obj_clear_flag(ctx->overlay, LV_OBJ_FLAG_SCROLLABLE);

    lv_obj_t *panel = lv_obj_create(ctx->overlay);
    lv_obj_center(panel);

    lv_obj_t *txt = lv_label_create(panel);
    lv_label_set_text(txt, ui_is_english() ? "Delete this step?" : "Видалити цей крок?");

    lv_obj_t *btn_cancel = lv_btn_create(panel);
    style_flat_button(btn_cancel, lv_color_hex(0xff0e131f), 255, lv_color_hex(0xff1c2538), 1, 10);
    lv_obj_add_event_cb(btn_cancel, confirm_step_cancel_cb, LV_EVENT_CLICKED, ctx);
    lv_obj_t *lc = lv_label_create(btn_cancel);
    lv_obj_set_style_text_color(lc, lv_color_hex(0xffffffff), LV_PART_MAIN | LV_STATE_DEFAULT);
    lv_obj_set_style_text_font(lc, &font_4305a60a491c803d80080d05cbb3cac2, LV_PART_MAIN | LV_STATE_DEFAULT);
    lv_label_set_text(lc, ui_is_english() ? "Cancel" : "Скасувати");
    lv_obj_center(lc);

    lv_obj_t *btn_ok = lv_btn_create(panel);
    style_flat_button(btn_ok, lv_color_hex(0xffff3b30), 255, lv_color_hex(0xffff3b30), 0, 10);
    lv_obj_add_event_cb(btn_ok, confirm_step_ok_cb, LV_EVENT_CLICKED, ctx);
    lv_obj_t *lo = lv_label_create(btn_ok);
    lv_obj_set_style_text_color(lo, lv_color_hex(0xffffffff), LV_PART_MAIN | LV_STATE_DEFAULT);
    lv_obj_set_style_text_font(lo, &font_4305a60a491c803d80080d05cbb3cac2, LV_PART_MAIN | LV_STATE_DEFAULT);
    lv_label_set_text(lo, ui_is_english() ? "Confirm" : "Підтвердити");
    lv_obj_center(lo);

    confirm_panel_layout(panel, txt, btn_cancel, btn_ok);
}


// Event callback implementations

void action_goto_programs(lv_event_t *e) {
    (void)e;
    request_fresh_screen(SCREEN_ID_PROGRAMS_LIST);
}

void action_goto_program_edit(lv_event_t *e) {
    const uint8_t id = (e) ? (uint8_t)(intptr_t)lv_event_get_user_data(e) : 255;
    if (id != 255 && id < ui_get_program_count()) {
        ui_set_selected_program_id(id);
        ui_set_selected_program_name(ui_get_program_name(id));
        ui_set_selected_program_steps_total(ui_get_program_steps_total(id));
    }
    request_fresh_screen(SCREEN_ID_PROGRAMS);
}

void action_goto_settings(lv_event_t *e) {
    (void)e;
    action_close_transient_overlays();
    requestScreen(SCREEN_ID_SETTINGS);
}

void action_goto_wifi_settings(lv_event_t *e) {
    (void)e;
    action_close_transient_overlays();
    requestScreen(SCREEN_ID_WIFI_SETTINGS);
}

void action_goto_main(lv_event_t *e) {
    (void)e;
    action_close_transient_overlays();
    requestScreen(SCREEN_ID__1);
}

void action_toggle_language(lv_event_t *e) {
    (void)e;
    ui_request_toggle_language();
}

void action_wifi_choose_network(lv_event_t *e) {
    (void)e;
    wifi_set_user_enabled(true);
    tick_screen_by_id(SCREEN_ID_WIFI_SETTINGS);
    if (!wifi_backend_available()) {
        wifi_init_softap();
        wifi_show_portal_hint();
        return;
    }
    wifi_setup_open_popup();
}

void action_wifi_enable_on(lv_event_t *e) {
    (void)e;
    wifi_set_user_enabled(true);
    if (wifi_is_configured()) {
        (void)wifi_init_sta();
        tick_screen_by_id(SCREEN_ID_WIFI_SETTINGS);
        toast_show_ex(ui_is_english() ? "Connecting..." : "Підключення...", 3000);
        return;
    }
    wifi_init_softap();
    tick_screen_by_id(SCREEN_ID_WIFI_SETTINGS);
    wifi_show_portal_hint();
}

void action_wifi_enable_off(lv_event_t *e) {
    (void)e;
    wifi_set_user_enabled(false);
    wifi_disconnect_sta();
    wifi_init_softap();
    tick_screen_by_id(SCREEN_ID_WIFI_SETTINGS);
    wifi_show_portal_hint();
}

void action_wifi_toggle(lv_event_t *e) {
    if (wifi_is_user_enabled()) {
        action_wifi_enable_off(e);
    } else {
        action_wifi_enable_on(e);
    }
}

static void programs_update_info_from_model(uint16_t step_count) {
    if (!ui_programs_screen_is_active()) {
#if defined(ESP_PLATFORM)
        // #region debug-point settings-history-wdt-programs-info
        ESP_LOGI(s_dbg_tag_kb_flow,
                 "programs_update_info_from_model: skip reason=screen_inactive cur=%d nav=%d guard=%d act=%p programs=%p info=%p",
                 (int)ui_get_current_screen_id(),
                 ui_is_navigation_active() ? 1 : 0,
                 transient_close_guard_active() ? 1 : 0,
                 (void *)lv_scr_act(),
                 (void *)objects.programs,
                 (void *)s_programs_ctx.info_sub);
        // #endregion
#endif
        return;
    }
    if (ui_is_navigation_active() || transient_close_guard_active()) {
#if defined(ESP_PLATFORM)
        // #region debug-point settings-history-wdt-programs-info
        ESP_LOGI(s_dbg_tag_kb_flow,
                 "programs_update_info_from_model: skip reason=nav_or_guard cur=%d nav=%d guard=%d steps=%u act=%p programs=%p info=%p",
                 (int)ui_get_current_screen_id(),
                 ui_is_navigation_active() ? 1 : 0,
                 transient_close_guard_active() ? 1 : 0,
                 (unsigned)step_count,
                 (void *)lv_scr_act(),
                 (void *)objects.programs,
                 (void *)s_programs_ctx.info_sub);
        // #endregion
#endif
        return;
    }
    if (!s_programs_ctx.info_sub) {
#if defined(ESP_PLATFORM)
        // #region debug-point settings-history-wdt-programs-info
        ESP_LOGI(s_dbg_tag_kb_flow,
                 "programs_update_info_from_model: skip reason=no_info_sub cur=%d steps=%u act=%p programs=%p",
                 (int)ui_get_current_screen_id(),
                 (unsigned)step_count,
                 (void *)lv_scr_act(),
                 (void *)objects.programs);
        // #endregion
#endif
        return;
    }
    if (!lv_obj_is_valid(s_programs_ctx.info_sub)) {
#if defined(ESP_PLATFORM)
        // #region debug-point settings-history-wdt-programs-info
        ESP_LOGI(s_dbg_tag_kb_flow,
                 "programs_update_info_from_model: invalid info_sub=%p cur=%d act=%p programs=%p",
                 (void *)s_programs_ctx.info_sub,
                 (int)ui_get_current_screen_id(),
                 (void *)lv_scr_act(),
                 (void *)objects.programs);
        // #endregion
#endif
        s_programs_ctx.info_sub = NULL;
        return;
    }
#if defined(ESP_PLATFORM)
    // #region debug-point settings-history-wdt-programs-info
    ESP_LOGI(s_dbg_tag_kb_flow,
             "programs_update_info_from_model: enter cur=%d nav=%d guard=%d programs_active=%d steps=%u act=%p programs=%p info=%p",
             (int)ui_get_current_screen_id(),
             ui_is_navigation_active() ? 1 : 0,
             transient_close_guard_active() ? 1 : 0,
             ui_programs_screen_is_active() ? 1 : 0,
             (unsigned)step_count,
             (void *)lv_scr_act(),
             (void *)objects.programs,
             (void *)s_programs_ctx.info_sub);
    // #endregion
#endif

    const uint8_t pid = ui_get_selected_program_id();
    uint16_t cnt = step_count;
    if (pid != 255) {
        cnt = ui_get_program_steps_total(pid);
    }
    if (cnt > 50) cnt = 50;

    uint16_t max_temp = 0;
    uint32_t total_s = 0;
    int16_t bp_temps[8] = { 0 };
    uint32_t bp_times[8] = { 0 };
    uint8_t bp_cnt = 0;
    int32_t prev_temp = 25;

    for (uint32_t i = 0; i < cnt; i++) {
        if ((i % 4) == 0) PP_ACTIONS_YIELD();
        const int32_t target = programs_step_temp_or_default(pid, i);
        const uint16_t rate_x10 = programs_step_rate_or_default(pid, i);
        const uint32_t hold_s = programs_step_hold_or_default(pid, i);

        if (target > max_temp) max_temp = (uint16_t)target;

        uint32_t ramp_s = 0;
        if (rate_x10 > 0) {
            const int32_t diff = (target >= prev_temp) ? (target - prev_temp) : (prev_temp - target);
            ramp_s = (uint32_t)(((uint32_t)diff * 36000u) / (uint32_t)rate_x10);
        }
        total_s += ramp_s;

        if (bp_cnt < 8) {
            bp_temps[bp_cnt] = (int16_t)target;
            bp_times[bp_cnt] = total_s;
            bp_cnt++;
        }

        if (hold_s > 0) {
            total_s += hold_s;
            if (bp_cnt < 8) {
                bp_temps[bp_cnt] = (int16_t)target;
                bp_times[bp_cnt] = total_s;
                bp_cnt++;
            }
        }
        prev_temp = target;
    }

    ui_set_selected_program_total_time_s(total_s);
    ui_set_selected_program_max_temp_c(max_temp);
    ui_set_selected_program_breakpoints(bp_temps, bp_times, bp_cnt);

    char tbuf[24];
    fmt_hms(total_s, tbuf, sizeof(tbuf));
    char buf[96];
    if (ui_is_english()) {
        lv_snprintf(buf, sizeof(buf), "%u steps   %u%s   %s", (unsigned)cnt, (unsigned)max_temp, temp_unit_short(), tbuf);
    } else {
        lv_snprintf(buf, sizeof(buf), "%u кроків   %u%s   %s", (unsigned)cnt, (unsigned)max_temp, temp_unit_short(), tbuf);
    }

    const char *cur = lv_label_get_text(s_programs_ctx.info_sub);
    if (!cur || strcmp(cur, buf) != 0) {
        lv_label_set_text(s_programs_ctx.info_sub, buf);
    }
}

static lv_obj_t *s_wifi_web_popup = NULL;

static void wifi_web_popup_close_cb(lv_event_t *e) {
    pp_obj_delete_async_safe_event(e, &s_wifi_web_popup);
}

static void wifi_web_popup_panel_cb(lv_event_t *e) {
    lv_event_stop_bubbling(e);
}

static lv_obj_t *s_wifi_setup_panel = NULL;
static lv_obj_t *s_wifi_setup_list = NULL;
static lv_obj_t *s_wifi_setup_scan_btn = NULL;
static lv_obj_t *s_wifi_setup_scan_lbl = NULL;
static lv_obj_t *s_wifi_setup_ssid_val = NULL;
static lv_obj_t *s_wifi_setup_pass_val = NULL;
static lv_obj_t *s_wifi_setup_connect_btn = NULL;
static lv_timer_t *s_wifi_setup_timer = NULL;

static char s_wifi_setup_ssid[33] = { 0 };
static char s_wifi_setup_pass[65] = { 0 };
static int s_wifi_setup_auth = -1;
static bool s_wifi_setup_scanning = false;
static bool s_wifi_setup_connecting = false;
static bool s_wifi_setup_auto_connect_after_pass = false;
static uint32_t s_wifi_setup_connect_started_ms = 0;
static uint32_t s_wifi_setup_close_at_ms = 0;
static int s_wifi_setup_selected_idx = -1;
static lv_obj_t *s_wifi_setup_selected_btn = NULL;

enum { WIFI_SCAN_MAX = 24 };
static int s_wifi_scan_count = 0;
static char s_wifi_scan_ssids[WIFI_SCAN_MAX][33];
static int s_wifi_scan_rssi[WIFI_SCAN_MAX];
static int s_wifi_scan_auth[WIFI_SCAN_MAX];

static lv_obj_t *s_wifi_kb_ta = NULL;
static lv_obj_t *s_wifi_kb = NULL;
static int s_wifi_kb_kind = 0;

static void wifi_setup_update_connect_enabled(void) {
    if (!s_wifi_setup_connect_btn) return;
    const bool has_selection = (s_wifi_setup_selected_idx >= 0 && s_wifi_setup_ssid[0] != '\0');
    const bool ok = has_selection && !s_wifi_setup_connecting && !s_wifi_setup_scanning;
    lv_obj_set_style_bg_color(s_wifi_setup_connect_btn, lv_color_hex(ok ? 0xff00b761 : 0xff27272a), LV_PART_MAIN | LV_STATE_DEFAULT);
    if (ok) {
        lv_obj_clear_state(s_wifi_setup_connect_btn, LV_STATE_DISABLED);
    } else {
        lv_obj_add_state(s_wifi_setup_connect_btn, LV_STATE_DISABLED);
    }
}

static void wifi_setup_update_ssid_label(void) {
    if (!s_wifi_setup_ssid_val) return;
    lv_label_set_text(s_wifi_setup_ssid_val, s_wifi_setup_ssid[0] ? s_wifi_setup_ssid : (ui_is_english() ? "(select network)" : "(оберіть мережу)"));
}

static void wifi_setup_update_pass_label(void) {
    if (!s_wifi_setup_pass_val) return;
    if (!s_wifi_setup_pass[0]) {
        lv_label_set_text(s_wifi_setup_pass_val, ui_is_english() ? "(not set)" : "(не вказано)");
        return;
    }
    const size_t n = strlen(s_wifi_setup_pass);
    static char mask[70];
    const size_t m = (n < sizeof(mask) - 1) ? n : (sizeof(mask) - 1);
    for (size_t i = 0; i < m; i++) mask[i] = '*';
    mask[m] = '\0';
    lv_label_set_text(s_wifi_setup_pass_val, mask);
}

static void wifi_kb_close_event(lv_event_t *e) {
    lv_obj_t *overlay = s_wifi_kb_overlay;
    lv_obj_t *kb = s_wifi_kb;
#if defined(ESP_PLATFORM)
    action_debug_dump_overlay_state("wifi_kb_close:entry");
#endif
    s_wifi_kb_overlay = NULL;
    s_wifi_kb_ta = NULL;
    s_wifi_kb = NULL;
    s_wifi_kb_kind = 0;
    if (kb && lv_obj_is_valid(kb)) {
        lv_keyboard_set_textarea(kb, NULL);
    }
    if (overlay && lv_obj_is_valid(overlay)) {
        lv_indev_reset(NULL, NULL);
        lv_obj_add_flag(overlay, LV_OBJ_FLAG_HIDDEN);
        if (e) pp_obj_delete_async_safe_event(e, &overlay);
        else lv_obj_delete(overlay);
    }
#if defined(ESP_PLATFORM)
    action_debug_dump_overlay_state("wifi_kb_close:exit");
#endif
}

static void wifi_kb_close(void) {
    wifi_kb_close_event(NULL);
}

static void wifi_kb_event_cb(lv_event_t *e) {
    const lv_event_code_t code = lv_event_get_code(e);
    if (code == LV_EVENT_CANCEL) {
        wifi_kb_close_event(e);
        return;
    }
    if (code != LV_EVENT_READY) return;
    const int kb_kind = s_wifi_kb_kind;
    const char *txt = (s_wifi_kb_ta) ? lv_textarea_get_text(s_wifi_kb_ta) : "";
    if (!txt) txt = "";
    if (s_wifi_kb_kind == 1) {
        strncpy(s_wifi_setup_pass, txt, sizeof(s_wifi_setup_pass) - 1);
        s_wifi_setup_pass[sizeof(s_wifi_setup_pass) - 1] = '\0';
        wifi_setup_update_pass_label();
    } else {
        strncpy(s_wifi_setup_ssid, txt, sizeof(s_wifi_setup_ssid) - 1);
        s_wifi_setup_ssid[sizeof(s_wifi_setup_ssid) - 1] = '\0';
        s_wifi_setup_auth = -1;
        wifi_setup_update_ssid_label();
    }
    wifi_setup_update_connect_enabled();
    wifi_kb_close_event(e);
    if (kb_kind == 1 && s_wifi_setup_auto_connect_after_pass) {
        s_wifi_setup_auto_connect_after_pass = false;
        wifi_setup_connect_cb(NULL);
    }
}

static void wifi_kb_back_cb(lv_event_t *e) {
    wifi_kb_close_event(e);
}

static void wifi_kb_open(int kind) {
    if (s_wifi_kb_overlay) wifi_kb_close();
    s_wifi_kb_kind = kind;

    s_wifi_kb_overlay = lv_obj_create(lv_layer_top());
    lv_obj_remove_style_all(s_wifi_kb_overlay);
    lv_obj_set_size(s_wifi_kb_overlay, lv_pct(100), lv_pct(100));
    lv_obj_set_style_bg_color(s_wifi_kb_overlay, lv_color_hex(0xff090c10), LV_PART_MAIN | LV_STATE_DEFAULT);
    lv_obj_set_style_bg_opa(s_wifi_kb_overlay, 255, LV_PART_MAIN | LV_STATE_DEFAULT);
    lv_obj_clear_flag(s_wifi_kb_overlay, LV_OBJ_FLAG_SCROLLABLE);

    lv_obj_t *panel = lv_obj_create(s_wifi_kb_overlay);
    lv_obj_set_pos(panel, 0, 0);
    lv_obj_set_size(panel, 800, 480);
    lv_obj_set_style_bg_opa(panel, LV_OPA_TRANSP, LV_PART_MAIN | LV_STATE_DEFAULT);
    lv_obj_set_style_border_width(panel, 0, LV_PART_MAIN | LV_STATE_DEFAULT);
    lv_obj_set_style_pad_all(panel, 0, LV_PART_MAIN | LV_STATE_DEFAULT);
    lv_obj_clear_flag(panel, LV_OBJ_FLAG_SCROLLABLE);

    lv_obj_t *btn_back = lv_btn_create(panel);
    lv_obj_set_pos(btn_back, 680, 10);
    lv_obj_set_size(btn_back, 110, 50);
    style_flat_button(btn_back, lv_color_hex(0xff0e131f), 255, lv_color_hex(0xff1c2538), 1, 10);
    lv_obj_add_event_cb(btn_back, wifi_kb_back_cb, LV_EVENT_CLICKED, NULL);
    {
        lv_obj_t *lbl = lv_label_create(btn_back);
        lv_obj_set_style_text_font(lbl, &font_4305a60a491c803d80080d015637c7d0, LV_PART_MAIN | LV_STATE_DEFAULT);
        lv_obj_set_style_text_color(lbl, lv_color_hex(0xff7a8b9e), LV_PART_MAIN | LV_STATE_DEFAULT);
        lv_label_set_text(lbl, ui_is_english() ? "BACK" : "НАЗАД");
        lv_obj_center(lbl);
    }

    s_wifi_kb_ta = lv_textarea_create(panel);
    lv_obj_set_align(s_wifi_kb_ta, LV_ALIGN_TOP_LEFT);
    lv_obj_set_pos(s_wifi_kb_ta, 10, 10);
    lv_obj_set_size(s_wifi_kb_ta, 660, 50);
    lv_obj_set_style_text_font(s_wifi_kb_ta, &font_4305a60a491c803d80080d0337447350, LV_PART_MAIN | LV_STATE_DEFAULT);
    lv_obj_set_style_text_color(s_wifi_kb_ta, lv_color_hex(0xffffffff), LV_PART_MAIN | LV_STATE_DEFAULT);
    lv_obj_set_style_bg_color(s_wifi_kb_ta, lv_color_hex(0xff090c10), LV_PART_MAIN | LV_STATE_DEFAULT);
    lv_obj_set_style_bg_opa(s_wifi_kb_ta, 255, LV_PART_MAIN | LV_STATE_DEFAULT);
    lv_obj_set_style_border_color(s_wifi_kb_ta, lv_color_hex(0xff1c2538), LV_PART_MAIN | LV_STATE_DEFAULT);
    lv_obj_set_style_border_width(s_wifi_kb_ta, 1, LV_PART_MAIN | LV_STATE_DEFAULT);
    lv_obj_set_style_radius(s_wifi_kb_ta, 10, LV_PART_MAIN | LV_STATE_DEFAULT);
    lv_textarea_set_one_line(s_wifi_kb_ta, true);
    if (kind == 1) {
        lv_textarea_set_max_length(s_wifi_kb_ta, 64);
        lv_textarea_set_password_mode(s_wifi_kb_ta, true);
        lv_textarea_set_text(s_wifi_kb_ta, s_wifi_setup_pass);
    } else {
        lv_textarea_set_max_length(s_wifi_kb_ta, 32);
        lv_textarea_set_password_mode(s_wifi_kb_ta, false);
        lv_textarea_set_text(s_wifi_kb_ta, s_wifi_setup_ssid);
    }

    s_wifi_kb = lv_keyboard_create(panel);
    lv_obj_set_align(s_wifi_kb, LV_ALIGN_TOP_LEFT);
    lv_obj_set_pos(s_wifi_kb, 10, 70);
    lv_obj_set_size(s_wifi_kb, 780, 400);
    lv_keyboard_set_textarea(s_wifi_kb, s_wifi_kb_ta);
    lv_keyboard_set_mode(s_wifi_kb, LV_KEYBOARD_MODE_TEXT_LOWER);
    lv_keyboard_set_popovers(s_wifi_kb, false);
    lv_obj_add_event_cb(s_wifi_kb, wifi_kb_event_cb, LV_EVENT_READY, NULL);
    lv_obj_add_event_cb(s_wifi_kb, wifi_kb_event_cb, LV_EVENT_CANCEL, NULL);
#if defined(ESP_PLATFORM)
    action_debug_dump_overlay_state("wifi_kb_open:done");
#endif
}

static void wifi_setup_parse_scan_json(const char *json) {
    s_wifi_scan_count = 0;
    if (!json) return;
    const char *p = json;
    while (s_wifi_scan_count < WIFI_SCAN_MAX) {
        const char *k = strstr(p, "\"ssid\"");
        if (!k) break;
        const char *colon = strchr(k, ':');
        if (!colon) break;
        const char *q1 = strchr(colon, '"');
        if (!q1) break;
        q1++;
        const char *q2 = strchr(q1, '"');
        if (!q2) break;

        char ssid[33] = { 0 };
        const size_t ssid_len = (size_t)(q2 - q1);
        const size_t copy_len = (ssid_len < sizeof(ssid) - 1) ? ssid_len : (sizeof(ssid) - 1);
        memcpy(ssid, q1, copy_len);
        ssid[copy_len] = '\0';

        if (ssid[0] != '\0') {
            bool dup = false;
            for (int i = 0; i < s_wifi_scan_count; i++) {
                if (strcmp(s_wifi_scan_ssids[i], ssid) == 0) {
                    dup = true;
                    break;
                }
            }
            if (!dup) {
                int rssi = 0;
                int auth = -1;
                const char *end_obj = strchr(q2, '}');
                if (!end_obj) end_obj = q2;

                const char *kr = strstr(k, "\"rssi\"");
                if (kr && kr < end_obj) {
                    const char *cr = strchr(kr, ':');
                    if (cr) rssi = (int)strtol(cr + 1, NULL, 10);
                }
                const char *ka = strstr(k, "\"auth\"");
                if (ka && ka < end_obj) {
                    const char *ca = strchr(ka, ':');
                    if (ca) auth = (int)strtol(ca + 1, NULL, 10);
                }

                const size_t max_sz = sizeof(s_wifi_scan_ssids[s_wifi_scan_count]);
                size_t n = strlen(ssid);
                if (n >= max_sz) n = max_sz - 1;
                memcpy(s_wifi_scan_ssids[s_wifi_scan_count], ssid, n);
                s_wifi_scan_ssids[s_wifi_scan_count][n] = '\0';
                s_wifi_scan_rssi[s_wifi_scan_count] = rssi;
                s_wifi_scan_auth[s_wifi_scan_count] = auth;
                s_wifi_scan_count++;
            }
        }

        p = q2 + 1;
    }
}

static void wifi_setup_close_cb(lv_event_t *e) {
    lv_obj_t *popup = s_wifi_setup_popup;
    wifi_kb_close();
    if (s_wifi_setup_timer) {
        lv_timer_del(s_wifi_setup_timer);
        s_wifi_setup_timer = NULL;
    }
    s_wifi_setup_popup = NULL;
    s_wifi_setup_panel = NULL;
    s_wifi_setup_list = NULL;
    s_wifi_setup_scan_btn = NULL;
    s_wifi_setup_scan_lbl = NULL;
    s_wifi_setup_ssid_val = NULL;
    s_wifi_setup_pass_val = NULL;
    s_wifi_setup_connect_btn = NULL;
    s_wifi_setup_ssid[0] = '\0';
    s_wifi_setup_pass[0] = '\0';
    s_wifi_setup_auth = -1;
    s_wifi_scan_count = 0;
    s_wifi_setup_scanning = false;
    s_wifi_setup_connecting = false;
    s_wifi_setup_auto_connect_after_pass = false;
    s_wifi_setup_connect_started_ms = 0;
    s_wifi_setup_close_at_ms = 0;
    s_wifi_setup_selected_idx = -1;
    s_wifi_setup_selected_btn = NULL;
    if (popup && lv_obj_is_valid(popup)) {
        lv_indev_reset(NULL, NULL);
        if (e) pp_obj_delete_async_safe_event(e, &popup);
        else lv_obj_delete(popup);
    }
}

static void wifi_setup_panel_cb(lv_event_t *e) {
#if defined(ESP_PLATFORM)
    ESP_LOGI(s_dbg_tag_nav_race,
             "wifi_setup_panel_cb: nav=%d guard=%d popup=%p panel=%p target=%p code=%d",
             ui_is_navigation_active() ? 1 : 0, transient_close_guard_active() ? 1 : 0,
             (void *)s_wifi_setup_popup, (void *)s_wifi_setup_panel,
             lv_event_get_target(e), (int)lv_event_get_code(e));
#endif
    lv_event_stop_bubbling(e);
}

static void wifi_setup_select_network_cb(lv_event_t *e) {
    const intptr_t idx = (intptr_t)lv_event_get_user_data(e);
    if (idx < 0 || idx >= s_wifi_scan_count) return;

    lv_obj_t *btn = lv_event_get_target(e);
    if (s_wifi_setup_selected_btn && s_wifi_setup_selected_btn != btn) {
        lv_obj_set_style_bg_color(s_wifi_setup_selected_btn, lv_color_hex(0xff0e131f), LV_PART_MAIN | LV_STATE_DEFAULT);
        lv_obj_set_style_border_color(s_wifi_setup_selected_btn, lv_color_hex(0xff1c2538), LV_PART_MAIN | LV_STATE_DEFAULT);
        lv_obj_set_style_border_width(s_wifi_setup_selected_btn, 1, LV_PART_MAIN | LV_STATE_DEFAULT);
    }
    s_wifi_setup_selected_btn = btn;
    s_wifi_setup_selected_idx = (int)idx;
    if (btn) {
        lv_obj_set_style_bg_color(btn, lv_color_hex(0xff12301d), LV_PART_MAIN | LV_STATE_DEFAULT);
        lv_obj_set_style_border_color(btn, lv_color_hex(0xff00b761), LV_PART_MAIN | LV_STATE_DEFAULT);
        lv_obj_set_style_border_width(btn, 2, LV_PART_MAIN | LV_STATE_DEFAULT);
    }

    strncpy(s_wifi_setup_ssid, s_wifi_scan_ssids[idx], sizeof(s_wifi_setup_ssid) - 1);
    s_wifi_setup_ssid[sizeof(s_wifi_setup_ssid) - 1] = '\0';
    s_wifi_setup_auth = s_wifi_scan_auth[idx];
    s_wifi_setup_pass[0] = '\0';
    wifi_setup_update_pass_label();
    wifi_setup_update_connect_enabled();
}

static void wifi_setup_password_cb(lv_event_t *e) {
    (void)e;
    wifi_kb_open(1);
}

static void wifi_setup_fill_list_from_last_scan(void) {
    if (!s_wifi_setup_list) return;
    lv_obj_clean(s_wifi_setup_list);

    s_wifi_setup_selected_idx = -1;
    s_wifi_setup_selected_btn = NULL;
    s_wifi_setup_ssid[0] = '\0';
    s_wifi_setup_pass[0] = '\0';
    s_wifi_setup_auth = -1;
    wifi_setup_update_connect_enabled();

    for (int i = 0; i < s_wifi_scan_count; i++) {
        lv_obj_t *btn = lv_btn_create(s_wifi_setup_list);
        lv_obj_set_width(btn, lv_pct(100));
        lv_obj_set_height(btn, 60);
        lv_obj_set_style_bg_color(btn, lv_color_hex(0xff0e131f), LV_PART_MAIN | LV_STATE_DEFAULT);
        lv_obj_set_style_bg_opa(btn, 255, LV_PART_MAIN | LV_STATE_DEFAULT);
        lv_obj_set_style_border_color(btn, lv_color_hex(0xff1c2538), LV_PART_MAIN | LV_STATE_DEFAULT);
        lv_obj_set_style_border_width(btn, 1, LV_PART_MAIN | LV_STATE_DEFAULT);
        lv_obj_set_style_radius(btn, 12, LV_PART_MAIN | LV_STATE_DEFAULT);
        lv_obj_set_style_pad_all(btn, 10, LV_PART_MAIN | LV_STATE_DEFAULT);
        lv_obj_clear_flag(btn, LV_OBJ_FLAG_SCROLLABLE);
        lv_obj_add_event_cb(btn, wifi_setup_select_network_cb, LV_EVENT_CLICKED, (void *)(intptr_t)i);

        lv_obj_t *ssid = lv_label_create(btn);
        lv_obj_set_width(ssid, 230);
        lv_label_set_long_mode(ssid, LV_LABEL_LONG_DOT);
        lv_obj_set_style_text_font(ssid, &font_4305a60a491c803d80080d0337447350, LV_PART_MAIN | LV_STATE_DEFAULT);
        lv_obj_set_style_text_color(ssid, lv_color_hex(0xffffffff), LV_PART_MAIN | LV_STATE_DEFAULT);
        lv_label_set_text(ssid, s_wifi_scan_ssids[i]);
        lv_obj_align(ssid, LV_ALIGN_LEFT_MID, 0, -10);

        char rssi[20];
        lv_snprintf(rssi, sizeof(rssi), "%d dBm", s_wifi_scan_rssi[i]);
        lv_obj_t *r = lv_label_create(btn);
        lv_obj_set_style_text_font(r, &font_4305a60a491c803d80080d05cbb3cac2, LV_PART_MAIN | LV_STATE_DEFAULT);
        lv_obj_set_style_text_color(r, lv_color_hex(0xff7a8b9e), LV_PART_MAIN | LV_STATE_DEFAULT);
        lv_label_set_text(r, rssi);
        lv_obj_align(r, LV_ALIGN_RIGHT_MID, 0, -12);

        lv_obj_t *sec = lv_label_create(btn);
        lv_obj_set_style_text_font(sec, &font_4305a60a491c803d80080d05cbb3cac2, LV_PART_MAIN | LV_STATE_DEFAULT);
        lv_obj_set_style_text_color(sec, lv_color_hex((s_wifi_scan_auth[i] <= 0) ? 0xff00b761 : 0xffffb300),
                                   LV_PART_MAIN | LV_STATE_DEFAULT);
        lv_label_set_text(sec, (s_wifi_scan_auth[i] <= 0) ? (ui_is_english() ? "OPEN" : "ВІДКРИТА") : (ui_is_english() ? "SEC" : "ЗАХИСТ"));
        lv_obj_align(sec, LV_ALIGN_LEFT_MID, 0, 14);
    }
}

static void wifi_setup_start_scan(void) {
    s_wifi_setup_scanning = true;
    if (s_wifi_setup_scan_btn) lv_obj_add_state(s_wifi_setup_scan_btn, LV_STATE_DISABLED);
    if (s_wifi_setup_scan_lbl) lv_label_set_text(s_wifi_setup_scan_lbl, "...");
    wifi_setup_update_connect_enabled();
    if (s_wifi_setup_list) {
        lv_obj_clean(s_wifi_setup_list);
        lv_obj_t *l = lv_label_create(s_wifi_setup_list);
        lv_obj_set_width(l, lv_pct(100));
        lv_label_set_long_mode(l, LV_LABEL_LONG_WRAP);
        lv_obj_set_style_text_align(l, LV_TEXT_ALIGN_CENTER, LV_PART_MAIN | LV_STATE_DEFAULT);
        lv_obj_set_style_text_font(l, &font_4305a60a491c803d80080d0337447350, LV_PART_MAIN | LV_STATE_DEFAULT);
        lv_obj_set_style_text_color(l, lv_color_hex(0xff7a8b9e), LV_PART_MAIN | LV_STATE_DEFAULT);
        lv_label_set_text(l, ui_is_english() ? "Scanning..." : "Сканую мережі...");
        lv_obj_center(l);
    }
    wifi_start_scan();
}

static void wifi_setup_scan_btn_cb(lv_event_t *e) {
    (void)e;
    wifi_setup_start_scan();
}

static void wifi_setup_timer_cb(lv_timer_t *t) {
    (void)t;
    if (!s_wifi_setup_popup) {
        if (s_wifi_setup_timer) {
            lv_timer_del(s_wifi_setup_timer);
            s_wifi_setup_timer = NULL;
        }
        return;
    }

    if (s_wifi_setup_scanning && wifi_is_scan_done()) {
        char json[2200];
        wifi_get_scanned_networks_c(json, (int32_t)sizeof(json));
        wifi_setup_parse_scan_json(json);
        wifi_setup_fill_list_from_last_scan();
        s_wifi_setup_scanning = false;

        if (s_wifi_setup_scan_lbl) lv_label_set_text(s_wifi_setup_scan_lbl, ui_is_english() ? "Scan" : "Сканувати");
        if (s_wifi_setup_scan_btn) lv_obj_clear_state(s_wifi_setup_scan_btn, LV_STATE_DISABLED);
        wifi_setup_update_connect_enabled();
    }

    if (s_wifi_setup_connecting) {
        if (wifi_is_connected()) {
            tick_screen_by_id(SCREEN_ID_WIFI_SETTINGS);
            if (s_wifi_setup_close_at_ms == 0) {
                toast_show_ex(ui_is_english() ? "Connected" : "Підключено", 1500);
                s_wifi_setup_close_at_ms = lv_tick_get() + 700;
            } else if ((uint32_t)(lv_tick_get() - s_wifi_setup_close_at_ms) < 0x80000000u) {
                wifi_setup_close_cb(NULL);
            }
        } else {
            const uint32_t now = lv_tick_get();
            const uint32_t elapsed = now - s_wifi_setup_connect_started_ms;
            const bool in_progress = wifi_sta_connect_in_progress();
            if (!in_progress && elapsed > 8000) {
                s_wifi_setup_connecting = false;
                s_wifi_setup_pass[0] = '\0';
                toast_show_ex(ui_is_english() ? "Wrong password" : "Невірний пароль", 5000);
                if (s_wifi_setup_scan_btn) lv_obj_clear_state(s_wifi_setup_scan_btn, LV_STATE_DISABLED);
                wifi_setup_update_connect_enabled();
            } else if (elapsed > 25000) {
                s_wifi_setup_connecting = false;
                s_wifi_setup_pass[0] = '\0';
                toast_show_ex(ui_is_english() ? "Connect timeout" : "Таймаут підключення", 5000);
                if (s_wifi_setup_scan_btn) lv_obj_clear_state(s_wifi_setup_scan_btn, LV_STATE_DISABLED);
                wifi_setup_update_connect_enabled();
            }
        }
    }
}

static void wifi_setup_connect_cb(lv_event_t *e) {
    (void)e;
    if (s_wifi_setup_selected_idx < 0 || !s_wifi_setup_ssid[0]) {
        toast_show_ex(ui_is_english() ? "Select a network" : "Оберіть мережу", 1500);
        return;
    }
    if (s_wifi_setup_auth > 0 && !s_wifi_setup_pass[0]) {
        s_wifi_setup_auto_connect_after_pass = true;
        wifi_kb_open(1);
        return;
    }

    wifi_set_user_enabled(true);
    wifi_disconnect_sta();
    wifi_save_creds(s_wifi_setup_ssid, s_wifi_setup_pass);
    const bool ok = wifi_connect_with_credentials(s_wifi_setup_ssid, s_wifi_setup_pass);
    tick_screen_by_id(SCREEN_ID_WIFI_SETTINGS);
    if (ok) {
        s_wifi_setup_connecting = true;
        s_wifi_setup_connect_started_ms = lv_tick_get();
        s_wifi_setup_close_at_ms = 0;
        if (s_wifi_setup_scan_btn) lv_obj_add_state(s_wifi_setup_scan_btn, LV_STATE_DISABLED);
        toast_show_ex(ui_is_english() ? "Connecting..." : "Підключення...", 3000);
        wifi_setup_update_connect_enabled();
    } else {
        s_wifi_setup_connecting = false;
        toast_show_ex(ui_is_english() ? "Connect failed" : "Помилка підключення", 5000);
        wifi_setup_update_connect_enabled();
    }
}

static void wifi_setup_open_popup(void) {
    if (s_wifi_setup_popup) wifi_setup_close_cb(NULL);

    s_wifi_setup_popup = lv_obj_create(lv_layer_top());
    lv_obj_remove_style_all(s_wifi_setup_popup);
    lv_obj_set_size(s_wifi_setup_popup, lv_pct(100), lv_pct(100));
    lv_obj_set_style_bg_color(s_wifi_setup_popup, lv_color_hex(0x000000), LV_PART_MAIN | LV_STATE_DEFAULT);
    lv_obj_set_style_bg_opa(s_wifi_setup_popup, 160, LV_PART_MAIN | LV_STATE_DEFAULT);
    lv_obj_clear_flag(s_wifi_setup_popup, LV_OBJ_FLAG_SCROLLABLE);
    lv_obj_add_event_cb(s_wifi_setup_popup, wifi_setup_close_cb, LV_EVENT_CLICKED, NULL);

    s_wifi_setup_panel = lv_obj_create(s_wifi_setup_popup);
    lv_obj_set_size(s_wifi_setup_panel, 720, 440);
    style_flat_panel(s_wifi_setup_panel, lv_color_hex(0xff0e131f), lv_color_hex(0xff00b761), 2, 16, 0);
    lv_obj_center(s_wifi_setup_panel);
    lv_obj_add_event_cb(s_wifi_setup_panel, wifi_setup_panel_cb, LV_EVENT_CLICKED, NULL);

    const int inset = 14;
    const int btn_h = 56;
    const int btn_gap = 14;
    const int btn_w = (720 - inset * 2 - btn_gap) / 2;
    const int btn_y = 440 - inset - btn_h;

    lv_obj_t *title = lv_label_create(s_wifi_setup_panel);
    lv_obj_set_width(title, 600);
    lv_obj_set_style_text_align(title, LV_TEXT_ALIGN_CENTER, LV_PART_MAIN | LV_STATE_DEFAULT);
    lv_obj_set_style_text_font(title, &font_4305a60a491c803d80080d0337447350, LV_PART_MAIN | LV_STATE_DEFAULT);
    lv_obj_set_style_text_color(title, lv_color_hex(0xffffffff), LV_PART_MAIN | LV_STATE_DEFAULT);
    lv_label_set_text(title, ui_is_english() ? "CONNECT TO WI-FI" : "ПІДКЛЮЧЕННЯ ДО WI-FI");
    lv_obj_align(title, LV_ALIGN_TOP_MID, 0, inset);
    lv_obj_update_layout(title);
    const int title_h = (int)lv_obj_get_height(title);

    lv_obj_t *btn_x = lv_btn_create(s_wifi_setup_panel);
    lv_obj_set_size(btn_x, 38, 38);
    style_flat_button(btn_x, lv_color_hex(0xff0e131f), LV_OPA_TRANSP, lv_color_hex(0xff0e131f), 0, 8);
    lv_obj_add_event_cb(btn_x, wifi_setup_close_cb, LV_EVENT_CLICKED, NULL);
    lv_obj_align(btn_x, LV_ALIGN_TOP_RIGHT, -inset, inset);
    lv_obj_t *lbl_x = lv_label_create(btn_x);
    lv_obj_set_style_text_font(lbl_x, &font_4305a60a491c803d80080d0337447350, LV_PART_MAIN | LV_STATE_DEFAULT);
    lv_obj_set_style_text_color(lbl_x, lv_color_hex(0xff7a8b9e), LV_PART_MAIN | LV_STATE_DEFAULT);
    lv_label_set_text(lbl_x, "X");
    lv_obj_center(lbl_x);

    lv_obj_t *subtitle = lv_label_create(s_wifi_setup_panel);
    lv_obj_set_width(subtitle, 692);
    lv_obj_set_style_text_align(subtitle, LV_TEXT_ALIGN_LEFT, LV_PART_MAIN | LV_STATE_DEFAULT);
    lv_obj_set_style_text_font(subtitle, &font_4305a60a491c803d80080d0337447350, LV_PART_MAIN | LV_STATE_DEFAULT);
    lv_obj_set_style_text_color(subtitle, lv_color_hex(0xff7a8b9e), LV_PART_MAIN | LV_STATE_DEFAULT);
    lv_label_set_text(subtitle, ui_is_english() ? "Available networks" : "Доступні мережі");
    const int subtitle_y = inset + title_h + 10;
    lv_obj_set_pos(subtitle, inset, subtitle_y);
    lv_obj_update_layout(subtitle);
    const int subtitle_h = (int)lv_obj_get_height(subtitle);
    const int list_y = subtitle_y + subtitle_h + 8;

    s_wifi_setup_list = lv_obj_create(s_wifi_setup_panel);
    lv_obj_set_pos(s_wifi_setup_list, inset, list_y);
    int list_h = btn_y - btn_gap - list_y;
    if (list_h < 80) list_h = 80;
    lv_obj_set_size(s_wifi_setup_list, 692, list_h);
    lv_obj_set_style_bg_color(s_wifi_setup_list, lv_color_hex(0xff090c10), LV_PART_MAIN | LV_STATE_DEFAULT);
    lv_obj_set_style_bg_opa(s_wifi_setup_list, 255, LV_PART_MAIN | LV_STATE_DEFAULT);
    lv_obj_set_style_border_color(s_wifi_setup_list, lv_color_hex(0xff1c2538), LV_PART_MAIN | LV_STATE_DEFAULT);
    lv_obj_set_style_border_width(s_wifi_setup_list, 1, LV_PART_MAIN | LV_STATE_DEFAULT);
    lv_obj_set_style_radius(s_wifi_setup_list, 12, LV_PART_MAIN | LV_STATE_DEFAULT);
    lv_obj_set_style_pad_all(s_wifi_setup_list, 10, LV_PART_MAIN | LV_STATE_DEFAULT);
    lv_obj_set_style_pad_row(s_wifi_setup_list, 10, LV_PART_MAIN | LV_STATE_DEFAULT);
    lv_obj_set_flex_flow(s_wifi_setup_list, LV_FLEX_FLOW_COLUMN);
    lv_obj_set_flex_align(s_wifi_setup_list, LV_FLEX_ALIGN_START, LV_FLEX_ALIGN_START, LV_FLEX_ALIGN_START);
    lv_obj_set_scroll_dir(s_wifi_setup_list, LV_DIR_VER);
    lv_obj_set_scrollbar_mode(s_wifi_setup_list, LV_SCROLLBAR_MODE_AUTO);

    s_wifi_setup_scan_btn = lv_btn_create(s_wifi_setup_panel);
    lv_obj_set_pos(s_wifi_setup_scan_btn, inset, btn_y);
    lv_obj_set_size(s_wifi_setup_scan_btn, btn_w, btn_h);
    style_flat_button(s_wifi_setup_scan_btn, lv_color_hex(0xff27272a), 255, lv_color_hex(0xff1c2538), 1, 12);
    lv_obj_add_event_cb(s_wifi_setup_scan_btn, wifi_setup_scan_btn_cb, LV_EVENT_CLICKED, NULL);
    s_wifi_setup_scan_lbl = lv_label_create(s_wifi_setup_scan_btn);
    lv_obj_set_style_text_font(s_wifi_setup_scan_lbl, &font_4305a60a491c803d80080d015637c7d0, LV_PART_MAIN | LV_STATE_DEFAULT);
    lv_obj_set_style_text_color(s_wifi_setup_scan_lbl, lv_color_hex(0xffffffff), LV_PART_MAIN | LV_STATE_DEFAULT);
    lv_label_set_text(s_wifi_setup_scan_lbl, ui_is_english() ? "Scan" : "Сканувати");
    lv_obj_center(s_wifi_setup_scan_lbl);

    s_wifi_setup_connect_btn = lv_btn_create(s_wifi_setup_panel);
    lv_obj_set_pos(s_wifi_setup_connect_btn, inset + btn_w + btn_gap, btn_y);
    lv_obj_set_size(s_wifi_setup_connect_btn, btn_w, btn_h);
    style_flat_button(s_wifi_setup_connect_btn, lv_color_hex(0xff00b761), 255, lv_color_hex(0xff00b761), 0, 12);
    lv_obj_add_event_cb(s_wifi_setup_connect_btn, wifi_setup_connect_cb, LV_EVENT_CLICKED, NULL);
    lv_obj_t *lbl_conn = lv_label_create(s_wifi_setup_connect_btn);
    lv_obj_set_style_text_font(lbl_conn, &font_4305a60a491c803d80080d015637c7d0, LV_PART_MAIN | LV_STATE_DEFAULT);
    lv_obj_set_style_text_color(lbl_conn, lv_color_hex(0xffffffff), LV_PART_MAIN | LV_STATE_DEFAULT);
    lv_label_set_text(lbl_conn, ui_is_english() ? "Connect" : "Підключити");
    lv_obj_center(lbl_conn);

    wifi_setup_update_connect_enabled();

    if (s_wifi_setup_timer) lv_timer_del(s_wifi_setup_timer);
    s_wifi_setup_timer = lv_timer_create(wifi_setup_timer_cb, 250, NULL);
    wifi_setup_start_scan();
}

void action_wifi_open_web_popup(lv_event_t *e) {
    if (s_wifi_web_popup) {
        pp_obj_delete_async_safe_event(e, &s_wifi_web_popup);
    }

    char url[64] = {0};
    wifi_get_server_url_c(url, (int32_t)sizeof(url));

    lv_obj_t *overlay = lv_obj_create(lv_layer_top());
    s_wifi_web_popup = overlay;
    lv_obj_remove_style_all(overlay);
    lv_obj_set_size(overlay, lv_pct(100), lv_pct(100));
    lv_obj_set_style_bg_color(overlay, lv_color_hex(0x000000), LV_PART_MAIN | LV_STATE_DEFAULT);
    lv_obj_set_style_bg_opa(overlay, 160, LV_PART_MAIN | LV_STATE_DEFAULT);
    lv_obj_clear_flag(overlay, LV_OBJ_FLAG_SCROLLABLE);
    lv_obj_add_event_cb(overlay, wifi_web_popup_close_cb, LV_EVENT_CLICKED, NULL);

    lv_obj_t *panel = lv_obj_create(overlay);
    lv_obj_set_size(panel, 520, 420);
    style_flat_panel(panel, lv_color_hex(0xff0e131f), lv_color_hex(0xff00b761), 2, 16, 14);
    lv_obj_center(panel);
    lv_obj_add_event_cb(panel, wifi_web_popup_panel_cb, LV_EVENT_CLICKED, NULL);

    lv_obj_t *title = lv_label_create(panel);
    lv_obj_set_width(title, 460);
    lv_obj_set_style_text_align(title, LV_TEXT_ALIGN_CENTER, LV_PART_MAIN | LV_STATE_DEFAULT);
    lv_obj_set_style_text_font(title, &font_4305a60a491c803d80080d0337447350, LV_PART_MAIN | LV_STATE_DEFAULT);
    lv_obj_set_style_text_color(title, lv_color_hex(0xffffffff), LV_PART_MAIN | LV_STATE_DEFAULT);
    lv_label_set_text(title, ui_is_english() ? "WEB INTERFACE" : "ВХІД У ВЕБ-ІНТЕРФЕЙС");
    lv_obj_align(title, LV_ALIGN_TOP_MID, 0, 10);

#if defined(LV_USE_QRCODE) && (LV_USE_QRCODE)
    lv_obj_t *qr = lv_qrcode_create(panel);
    lv_qrcode_set_size(qr, 240);
    lv_qrcode_set_dark_color(qr, lv_color_hex(0xff090c10));
    lv_qrcode_set_light_color(qr, lv_color_hex(0xffffffff));
    lv_obj_set_pos(qr, 140, 70);
    if (url[0]) {
        lv_qrcode_update(qr, url, strlen(url));
    }
#endif

    lv_obj_t *u = lv_label_create(panel);
    lv_obj_set_width(u, 480);
    lv_obj_set_style_text_align(u, LV_TEXT_ALIGN_CENTER, LV_PART_MAIN | LV_STATE_DEFAULT);
    lv_obj_set_style_text_font(u, &font_4305a60a491c803d80080d0337447350, LV_PART_MAIN | LV_STATE_DEFAULT);
    lv_obj_set_style_text_color(u, lv_color_hex(0xffffffff), LV_PART_MAIN | LV_STATE_DEFAULT);
    lv_label_set_long_mode(u, LV_LABEL_LONG_WRAP);
    lv_label_set_text(u, url);
    lv_obj_set_pos(u, 20, 328);

}

void action_wifi_clear_logs(lv_event_t *e) {
    (void)e;
    toast_show(ui_is_english() ? "Logs cleared" : "Логи очищено");
}

void action_wifi_save_changes(lv_event_t *e) {
    (void)e;
    toast_show(ui_is_english() ? "Saved" : "Збережено");
}

void action_programs_graph(lv_event_t *e) {
    (void)e;
#if defined(ESP_PLATFORM)
    ESP_LOGI(s_dbg_tag_program_graph,
             "goto_graph pid=%u steps_sel=%u total_s_sel=%lu max_temp_sel=%u name='%s'",
             (unsigned)ui_get_selected_program_id(),
             (unsigned)ui_get_selected_program_steps_total(),
             (unsigned long)ui_get_selected_program_total_time_s(),
             (unsigned)ui_get_selected_program_max_temp_c(),
             ui_get_selected_program_name() ? ui_get_selected_program_name() : "");
#endif
    requestScreen(SCREEN_ID_PROGRAM_GRAPH);
}

void action_start_firing(lv_event_t *e) {
    (void)e;
#if defined(ESP_PLATFORM)
    ESP_LOGI(s_dbg_tag_start_firing, "start_pressed: is_firing=%d sel_id=%u sel_name='%s' steps=%u",
             kiln_ui_get_is_firing(), (unsigned)ui_get_selected_program_id(), ui_get_selected_program_name(),
             (unsigned)ui_get_selected_program_steps_total());
    if (kiln_ui_get_is_firing() != 0) {
        kiln_ui_stop_firing();
        ESP_LOGI(s_dbg_tag_start_firing, "stop_requested");
        toast_show(ui_is_english() ? "Stopped" : "Зупинено");
        requestScreen(SCREEN_ID__1);
        return;
    }
#endif
    start_firing_now();
}

void action_pause_firing(lv_event_t *e) {
    (void)e;
    kiln_ui_pause_firing();
    toast_show(ui_is_english() ? "Paused" : "Пауза");
    requestScreen(SCREEN_ID__1);
}

void action_stop_firing(lv_event_t *e) {
    (void)e;
    kiln_ui_stop_firing();
    toast_show(ui_is_english() ? "Stopped" : "Зупинено");
    requestScreen(SCREEN_ID__1);
}

void action_open_keyboard(lv_event_t *e) {
    lv_obj_t *label = lv_event_get_target(e);
    const intptr_t kind = (intptr_t)lv_event_get_user_data(e);
#if defined(ESP_PLATFORM)
    // #region debug-point kiln-calibration-wdt-open-keyboard
    ESP_LOGI(s_dbg_tag_kb_flow,
             "action_open_keyboard: cur=%d target=%p kind=%ld parent=%p parent_kind=%s nav=%d guard=%d",
             (int)ui_get_current_screen_id(),
             (void *)label,
             (long)kind,
             label ? (void *)lv_obj_get_parent(label) : NULL,
             label ? ui_debug_obj_kind(lv_obj_get_parent(label)) : "null",
             ui_is_navigation_active() ? 1 : 0,
             transient_close_guard_active() ? 1 : 0);
    // #endregion
#endif
    if (!ui_programs_screen_is_active()) {
#if defined(ESP_PLATFORM)
        ESP_LOGI(s_dbg_tag_kb_flow,
                 "action_open_keyboard: skip reason=programs_inactive cur=%d nav=%d guard=%d programs_guard=%d target=%p act=%p programs=%p",
                 (int)ui_get_current_screen_id(),
                 ui_is_navigation_active() ? 1 : 0,
                 transient_close_guard_active() ? 1 : 0,
                 programs_interaction_guard_active() ? 1 : 0,
                 (void *)label,
                 (void *)lv_scr_act(),
                 (void *)objects.programs);
#endif
        return;
    }
    if (kind == KB_KIND_PROGRAM_NAME) {
        keyboard_open_for_label(label, true, LV_KEYBOARD_MODE_TEXT_LOWER, NULL, false);
        return;
    }
    if (kind == KB_KIND_TEMP) {
        keyboard_open_for_label(label, false, LV_KEYBOARD_MODE_USER_2, "0123456789", true);
        return;
    }
    if (kind == KB_KIND_HOLD) {
        keyboard_open_for_label(label, false, LV_KEYBOARD_MODE_USER_1, "0123456789:", true);
        return;
    }
    if (kind == KB_KIND_NUMBER) {
        keyboard_open_for_label(label, false, LV_KEYBOARD_MODE_USER_2, "0123456789", false);
        return;
    }
    if (kind == KB_KIND_SPEED) {
        keyboard_open_for_label(label, false, LV_KEYBOARD_MODE_USER_3, "0123456789.,", true);
        return;
    }
    keyboard_open_for_label(label, false, LV_KEYBOARD_MODE_TEXT_LOWER, NULL, false);
}

void action_programs_open_keyboard_step(lv_event_t *e) {
    lv_obj_t *label = lv_event_get_target(e);
    programs_step_kb_ctx_t *ctx = (programs_step_kb_ctx_t *)lv_event_get_user_data(e);
    if (!ctx) return;

#if defined(ESP_PLATFORM)
    // #region debug-point kiln-calibration-wdt-open-keyboard
    ESP_LOGI(s_dbg_tag_kb_flow,
             "action_programs_open_keyboard_step: cur=%d target=%p step=%u kind=%d parent=%p parent_kind=%s nav=%d guard=%d",
             (int)ui_get_current_screen_id(),
             (void *)label,
             (unsigned)ctx->step,
             (int)ctx->kind,
             label ? (void *)lv_obj_get_parent(label) : NULL,
             label ? ui_debug_obj_kind(lv_obj_get_parent(label)) : "null",
             ui_is_navigation_active() ? 1 : 0,
             transient_close_guard_active() ? 1 : 0);
    // #endregion
#endif
    if (!ui_programs_screen_is_active()) {
#if defined(ESP_PLATFORM)
        ESP_LOGI(s_dbg_tag_kb_flow,
                 "action_programs_open_keyboard_step: skip reason=programs_inactive cur=%d nav=%d guard=%d programs_guard=%d target=%p step=%u kind=%d act=%p programs=%p",
                 (int)ui_get_current_screen_id(),
                 ui_is_navigation_active() ? 1 : 0,
                 transient_close_guard_active() ? 1 : 0,
                 programs_interaction_guard_active() ? 1 : 0,
                 (void *)label,
                 (unsigned)ctx->step,
                 (int)ctx->kind,
                 (void *)lv_scr_act(),
                 (void *)objects.programs);
#endif
        return;
    }

    s_kb_step_active = true;
    s_kb_step_idx = ctx->step;
    s_kb_step_kind = ctx->kind;

    if (ctx->kind == KB_KIND_TEMP) {
        keyboard_open_for_label(label, false, LV_KEYBOARD_MODE_USER_2, "0123456789", true);
        return;
    }
    if (ctx->kind == KB_KIND_HOLD) {
        keyboard_open_for_label(label, false, LV_KEYBOARD_MODE_USER_1, "0123456789:", true);
        return;
    }
    if (ctx->kind == KB_KIND_NUMBER) {
        keyboard_open_for_label(label, false, LV_KEYBOARD_MODE_USER_2, "0123456789", false);
        return;
    }
    if (ctx->kind == KB_KIND_SPEED) {
        keyboard_open_for_label(label, false, LV_KEYBOARD_MODE_USER_3, "0123456789.,", true);
        return;
    }
    keyboard_open_for_label(label, false, LV_KEYBOARD_MODE_TEXT_LOWER, NULL, false);
}

void action_programs_delete_step(lv_event_t *e) {
    programs_step_del_ctx_t *ctx = (programs_step_del_ctx_t *)lv_event_get_user_data(e);
    if (!ctx) return;
    confirm_delete_step(ctx->step);
}

void action_program_graph_start(lv_event_t *e) {
    (void)e;
    toast_show(ui_is_english() ? "Start" : "Старт");
}

void action_program_graph_delete(lv_event_t *e) {
    (void)e;
    confirm_delete_obj(NULL, ui_is_english() ? "Delete this program?" : "Видалити цю програму?");
}

static void action_programs_add_step_async(void *user_data) {
    (void)user_data;
#if defined(ESP_PLATFORM)
    // #region debug-point add-step-async
    s_programs_add_step_async_ms = lv_tick_get();
    ESP_LOGI(s_dbg_tag_add_step,
             "async enter dt_from_press=%lu pending=%d",
             (unsigned long)(s_programs_add_step_press_ms ? (s_programs_add_step_async_ms - s_programs_add_step_press_ms) : 0),
             s_programs_add_step_pending ? 1 : 0);
    // #endregion
#endif
    s_programs_add_step_pending = false;

    const uint8_t pid = ui_get_selected_program_id();
    const uint8_t id = (pid == 255) ? 255 : pid;
    uint16_t cnt = ui_get_program_steps_total(id);
    if (cnt >= 20) {
        s_programs_add_step_queued = 0;
#if defined(ESP_PLATFORM)
        ESP_LOGI(s_dbg_tag_add_step, "async skip reason=max_steps cnt=%u", (unsigned)cnt);
#endif
        return;
    }
    if (!ui_program_add_step(id)) {
        s_programs_add_step_queued = 0;
#if defined(ESP_PLATFORM)
        ESP_LOGI(s_dbg_tag_add_step, "async skip reason=add_failed cnt=%u", (unsigned)cnt);
#endif
        return;
    }

#if defined(ESP_PLATFORM)
    ESP_LOGI(s_dbg_tag_add_step,
             "async after_add cnt_before=%u cnt_after=%u dt_from_press=%lu",
             (unsigned)cnt,
             (unsigned)ui_get_program_steps_total(id),
             (unsigned long)(s_programs_add_step_press_ms ? (lv_tick_get() - s_programs_add_step_press_ms) : 0));
#endif

    screen_programs_refresh_rows();
    screen_programs_scroll_to_last();
    programs_update_info();
#if defined(ESP_PLATFORM)
    ESP_LOGI(s_dbg_tag_add_step,
             "async done total_dt=%lu queued=%u",
             (unsigned long)(s_programs_add_step_press_ms ? (lv_tick_get() - s_programs_add_step_press_ms) : 0),
             (unsigned)s_programs_add_step_queued);
#endif
    if (s_programs_add_step_queued > 0) {
        s_programs_add_step_queued--;
        s_programs_add_step_pending = true;
        action_programs_add_step_async(NULL);
#if defined(ESP_PLATFORM)
        ESP_LOGI(s_dbg_tag_add_step, "async queued_replay remaining=%u", (unsigned)s_programs_add_step_queued);
#endif
    }
}

void action_programs_add_step(lv_event_t *e) {
    if (e) {
        const lv_event_code_t code = lv_event_get_code(e);
        if (code != LV_EVENT_PRESSED && code != LV_EVENT_CLICKED) return;
#if defined(ESP_PLATFORM)
        // #region debug-point add-step-press
        s_programs_add_step_press_ms = lv_tick_get();
        ESP_LOGI(s_dbg_tag_add_step,
                 "press code=%d pending=%d nav=%d sel_id=%u steps=%u",
                 (int)code,
                 s_programs_add_step_pending ? 1 : 0,
                 ui_is_navigation_active() ? 1 : 0,
                 (unsigned)ui_get_selected_program_id(),
                 (unsigned)ui_get_selected_program_steps_total());
        // #endregion
#endif
    }
    if (s_programs_add_step_pending) {
        if (s_programs_add_step_queued < 3) {
            s_programs_add_step_queued++;
        }
#if defined(ESP_PLATFORM)
        ESP_LOGI(s_dbg_tag_add_step, "press queued reason=pending queued=%u", (unsigned)s_programs_add_step_queued);
#endif
        return;
    }
    s_programs_add_step_pending = true;
    action_programs_add_step_async(NULL);
#if defined(ESP_PLATFORM)
    ESP_LOGI(s_dbg_tag_add_step, "press handled_sync");
#endif
}

void action_programs_sort(lv_event_t *e) {
    (void)e;
    toast_show(ui_is_english() ? "Sort" : "Сортувати");
}

void action_programs_delete_last(lv_event_t *e) {
    (void)e;
    const uint8_t pid = ui_get_selected_program_id();
    if (pid == 255) {
        request_fresh_screen(SCREEN_ID_PROGRAMS_LIST);
        return;
    }
    confirm_delete_program(pid);
}

void action_programs_save_as(lv_event_t *e) {
    (void)e;
    toast_show(ui_is_english() ? "Save as" : "Зберегти як");
}

void action_programs_save(lv_event_t *e) {
    (void)e;
    // #region debug-point program-save-time
#if defined(ESP_PLATFORM)
    s_dbg_trace_programs_update = true;
    ESP_LOGI(s_dbg_tag_program_save_time, "SAVE pressed: sel_id=%u name='%s' steps_total=%u",
             (unsigned)ui_get_selected_program_id(), ui_get_selected_program_name(), (unsigned)ui_get_selected_program_steps_total());
#endif
    // #endregion
    programs_update_info();
    uint8_t pid = ui_get_selected_program_id();
    const uint16_t steps = ui_get_selected_program_steps_total();
    if (pid == 255) {
        const char *cur_name = ui_get_selected_program_name();
        if (!cur_name || cur_name[0] == '\0' || program_name_exists(cur_name)) {
            char nm[96];
            make_default_new_program_name(nm, sizeof(nm));
            ui_set_selected_program_name(nm);
        }
        if (ui_is_programs_full()) {
            char msg[64];
            if (ui_is_english()) {
                lv_snprintf(msg, sizeof(msg), "Max %u programs (%u/%u)", (unsigned)ui_get_program_capacity(),
                            (unsigned)ui_get_program_count(), (unsigned)ui_get_program_capacity());
            } else {
                lv_snprintf(msg, sizeof(msg), "Максимум %u програм (%u/%u)", (unsigned)ui_get_program_capacity(),
                            (unsigned)ui_get_program_count(), (unsigned)ui_get_program_capacity());
            }
            toast_show(msg);
            // #region debug-point program-save-time
#if defined(ESP_PLATFORM)
            s_dbg_trace_programs_update = false;
#endif
            // #endregion
            return;
        }
        const uint8_t id = ui_add_program(ui_get_selected_program_name(), steps);
        if (id != 255) {
            programs_capture_selected(id, 255);
            pid = id;
            ui_set_selected_program_id(id);
        }
    }
    if (pid != 255) {
        ui_set_program_name(pid, ui_get_selected_program_name());
        ui_set_program_steps_total(pid, steps);
        programs_capture_selected(pid, pid);

        // #region debug-point program-save-time
#if defined(ESP_PLATFORM)
        ESP_LOGI(s_dbg_tag_program_save_time, "SAVE commit: pid=%u program_count=%u total_time_s=%lu",
                 (unsigned)pid, (unsigned)ui_get_program_count(), (unsigned long)ui_get_program_total_time_s(pid));
#endif
        // #endregion
        ui_programs_persist_save();
    }
    // #region debug-point program-save-time
#if defined(ESP_PLATFORM)
    s_dbg_trace_programs_update = false;
#endif
    // #endregion
    {
        char msg[64];
        if (ui_is_english()) {
            lv_snprintf(msg, sizeof(msg), "Saved (%u programs)", (unsigned)ui_get_program_count());
        } else {
            lv_snprintf(msg, sizeof(msg), "Збережено (%u програм)", (unsigned)ui_get_program_count());
        }
        toast_show(msg);
    }
    screen_programs_refresh_rows();
}

void action_programs_delete_row(lv_event_t *e) {
    (void)e;
}

void action_programs_row_click(lv_event_t *e) {
    (void)e;
}

void action_programs_bind(lv_obj_t *list, lv_obj_t *info_sub) {
    s_programs_ctx.list = list;
    s_programs_ctx.info_sub = info_sub;
    programs_update_info();
}

void action_program_list_new(lv_event_t *e) {
    (void)e;
    if (ui_is_programs_full()) {
        char msg[64];
        if (ui_is_english()) {
            lv_snprintf(msg, sizeof(msg), "Max %u programs (%u/%u)", (unsigned)ui_get_program_capacity(),
                        (unsigned)ui_get_program_count(), (unsigned)ui_get_program_capacity());
        } else {
            lv_snprintf(msg, sizeof(msg), "Максимум %u програм (%u/%u)", (unsigned)ui_get_program_capacity(),
                        (unsigned)ui_get_program_count(), (unsigned)ui_get_program_capacity());
        }
        toast_show(msg);
        return;
    }
    ui_set_selected_program_id(255);
    char nm[96];
    make_default_new_program_name(nm, sizeof(nm));
    ui_set_selected_program_name(nm);
    ui_set_selected_program_steps_total(1);
    request_fresh_screen(SCREEN_ID_PROGRAMS);
}

void action_program_list_sort(lv_event_t *e) {
    (void)e;
    toast_show(ui_is_english() ? "Sort" : "Сортувати");
}

void action_program_list_delete(lv_event_t *e) {
    const uint8_t id = (uint8_t)(intptr_t)lv_event_get_user_data(e);
    confirm_delete_program(id);
}

void action_program_list_start(lv_event_t *e) {
    (void)e;
    toast_show(ui_is_english() ? "Start" : "Старт");
}

void action_program_list_select(lv_event_t *e) {
    const uint8_t id = (uint8_t)(intptr_t)lv_event_get_user_data(e);
    ui_set_selected_program_id(id);
    ui_set_selected_program_name(ui_get_program_name(id));
    ui_set_selected_program_steps_total(ui_get_program_steps_total(id));
    requestScreen(SCREEN_ID__1);
}
