// Generated by PicoPixel.io — https://picopixel.io
#include "ui.h"
#include "screens.h"
#include "images.h"
#include "actions.h"
#include "vars.h"

#include <string.h>
#include <stdio.h>
#include <stdlib.h>
#include <stdarg.h>
#include <unistd.h>
#include "cJSON.h"
#include "fonts/fonts.h"
#include "nvs.h"
#include "esp_err.h"
#include "kiln_config/config.h"
#if defined(ESP_PLATFORM)
#include "sdkconfig.h"
#include "esp_log.h"
#include "esp_heap_caps.h"
#include "esp_timer.h"
#include "esp_task_wdt.h"
#include "freertos/FreeRTOS.h"
#include "freertos/task.h"
#include "drivers/display_driver.h"
#include "net/wifi_connection.h"
#include "lwip/inet.h"
#include "lwip/netdb.h"
#include "lwip/sockets.h"
#endif

static int16_t currentScreen = -1;
static bool s_nav_locked = false;
static lv_timer_t *s_nav_unlock_timer = NULL;
static enum ScreensEnum s_pending_screen = (enum ScreensEnum)0;
static bool s_screen_transition_active = false;
static bool s_programs_persist_deferred = false;
static bool s_is_english = false;
static bool s_pending_lang_toggle = false;
static uint32_t s_last_lang_toggle_ms = 0;
static uint32_t s_last_display_wake_ms = 0;
static uint16_t s_display_sleep_minutes = 5;
static ui_date_format_t s_date_format = UI_DATE_FORMAT_DDMMYYYY;
static ui_time_format_t s_time_format = UI_TIME_FORMAT_24H;
static ui_temp_unit_t s_temp_unit = UI_TEMP_UNIT_C;
#if defined(ESP_PLATFORM)
static bool s_display_sleeping = false;
static uint8_t s_display_sleep_restore_brightness = 0;
static uint32_t s_display_last_user_activity_ms = 0;
#endif
static void loadScreenForce(enum ScreensEnum screenId);
static char s_selected_program_name[96] = "Нова програма 3";
static uint16_t s_selected_program_steps_total = 10;
static uint8_t s_selected_program_id = 0;
static uint8_t s_program_count = 4;
static char s_program_names_storage[UI_MAX_PROGRAMS][96] = {
    "Нова програма 3", "Бісквітний Випал", "Глазурований Випал 1", "На замовлення - Серія A"
};
static uint16_t s_program_steps_total_storage[UI_MAX_PROGRAMS] = { 10, 8, 12, 15 };
static uint32_t s_program_total_time_s_storage[UI_MAX_PROGRAMS] = { 0 };
static int16_t s_program_step_temp_c_storage[UI_MAX_PROGRAMS][UI_MAX_STEPS] = { 0 };
static uint16_t s_program_step_rate_c_per_h_x10_storage[UI_MAX_PROGRAMS][UI_MAX_STEPS] = { 0 };
static uint32_t s_program_step_hold_s_storage[UI_MAX_PROGRAMS][UI_MAX_STEPS] = { 0 };
static int16_t s_draft_step_temp_c_storage[UI_MAX_STEPS] = { 0 };
static uint16_t s_draft_step_rate_c_per_h_x10_storage[UI_MAX_STEPS] = { 0 };
static uint32_t s_draft_step_hold_s_storage[UI_MAX_STEPS] = { 0 };

static char (*s_program_names)[96] = s_program_names_storage;
static uint16_t *s_program_steps_total = s_program_steps_total_storage;
static uint32_t *s_program_total_time_s = s_program_total_time_s_storage;
static int16_t (*s_program_step_temp_c)[UI_MAX_STEPS] = s_program_step_temp_c_storage;
static uint16_t (*s_program_step_rate_c_per_h_x10)[UI_MAX_STEPS] = s_program_step_rate_c_per_h_x10_storage;
static uint32_t (*s_program_step_hold_s)[UI_MAX_STEPS] = s_program_step_hold_s_storage;
static int16_t *s_draft_step_temp_c = s_draft_step_temp_c_storage;
static uint16_t *s_draft_step_rate_c_per_h_x10 = s_draft_step_rate_c_per_h_x10_storage;
static uint32_t *s_draft_step_hold_s = s_draft_step_hold_s_storage;
static uint32_t s_selected_program_total_time_s = 0;
static uint16_t s_selected_program_max_temp_c = 0;
static int16_t s_selected_program_bp_temps[8] = { 0 };
static uint32_t s_selected_program_bp_times[8] = { 0 };
static uint8_t s_selected_program_bp_count = 0;

#if defined(ESP_PLATFORM)
static const char *s_dbg_settings_host = "192.168.0.168";
static const uint16_t s_dbg_settings_port = 7777;
static const char *s_dbg_settings_session = "settings-freeze-wdt";
static uint64_t s_dbg_settings_nav_start_us = 0;
static uint64_t s_dbg_settings_target_load_us = 0;

static void *ui_psram_calloc_fallback(size_t count, size_t size) {
    void *p = heap_caps_calloc(count, size, MALLOC_CAP_SPIRAM | MALLOC_CAP_8BIT);
    if (p) return p;
    return calloc(count, size);
}

static void ui_try_promote_program_storage_to_psram(void) {
    char (*names)[96] = (char (*)[96])ui_psram_calloc_fallback(UI_MAX_PROGRAMS, sizeof(s_program_names_storage[0]));
    uint16_t *steps_total = (uint16_t *)ui_psram_calloc_fallback(UI_MAX_PROGRAMS, sizeof(uint16_t));
    uint32_t *total_time = (uint32_t *)ui_psram_calloc_fallback(UI_MAX_PROGRAMS, sizeof(uint32_t));
    int16_t (*step_temp)[UI_MAX_STEPS] =
        (int16_t (*)[UI_MAX_STEPS])ui_psram_calloc_fallback(UI_MAX_PROGRAMS, sizeof(s_program_step_temp_c_storage[0]));
    uint16_t (*step_rate)[UI_MAX_STEPS] =
        (uint16_t (*)[UI_MAX_STEPS])ui_psram_calloc_fallback(UI_MAX_PROGRAMS, sizeof(s_program_step_rate_c_per_h_x10_storage[0]));
    uint32_t (*step_hold)[UI_MAX_STEPS] =
        (uint32_t (*)[UI_MAX_STEPS])ui_psram_calloc_fallback(UI_MAX_PROGRAMS, sizeof(s_program_step_hold_s_storage[0]));
    int16_t *draft_temp = (int16_t *)ui_psram_calloc_fallback(UI_MAX_STEPS, sizeof(int16_t));
    uint16_t *draft_rate = (uint16_t *)ui_psram_calloc_fallback(UI_MAX_STEPS, sizeof(uint16_t));
    uint32_t *draft_hold = (uint32_t *)ui_psram_calloc_fallback(UI_MAX_STEPS, sizeof(uint32_t));

    if (!names || !steps_total || !total_time || !step_temp || !step_rate || !step_hold || !draft_temp || !draft_rate || !draft_hold) return;

    memcpy(names, s_program_names, sizeof(s_program_names_storage));
    memcpy(steps_total, s_program_steps_total, sizeof(s_program_steps_total_storage));
    memcpy(total_time, s_program_total_time_s, sizeof(s_program_total_time_s_storage));
    memcpy(step_temp, s_program_step_temp_c, sizeof(s_program_step_temp_c_storage));
    memcpy(step_rate, s_program_step_rate_c_per_h_x10, sizeof(s_program_step_rate_c_per_h_x10_storage));
    memcpy(step_hold, s_program_step_hold_s, sizeof(s_program_step_hold_s_storage));
    memcpy(draft_temp, s_draft_step_temp_c, sizeof(s_draft_step_temp_c_storage));
    memcpy(draft_rate, s_draft_step_rate_c_per_h_x10, sizeof(s_draft_step_rate_c_per_h_x10_storage));
    memcpy(draft_hold, s_draft_step_hold_s, sizeof(s_draft_step_hold_s_storage));

    s_program_names = names;
    s_program_steps_total = steps_total;
    s_program_total_time_s = total_time;
    s_program_step_temp_c = step_temp;
    s_program_step_rate_c_per_h_x10 = step_rate;
    s_program_step_hold_s = step_hold;
    s_draft_step_temp_c = draft_temp;
    s_draft_step_rate_c_per_h_x10 = draft_rate;
    s_draft_step_hold_s = draft_hold;
}
#endif

void ui_debug_settings_freeze_reportf(const char *run_id, const char *hypothesis_id, const char *location, const char *fmt, ...) {
#if defined(ESP_PLATFORM)
    if (!hypothesis_id || !location || !fmt) return;
    if (!wifi_is_connected()) return;

    char msg[192];
    va_list ap;
    va_start(ap, fmt);
    vsnprintf(msg, sizeof(msg), fmt, ap);
    va_end(ap);

    int sock = socket(AF_INET, SOCK_STREAM, IPPROTO_IP);
    if (sock < 0) return;

    struct timeval tv = { 0 };
    tv.tv_sec = 0;
    tv.tv_usec = 150000;
    (void)setsockopt(sock, SOL_SOCKET, SO_SNDTIMEO, &tv, sizeof(tv));
    (void)setsockopt(sock, SOL_SOCKET, SO_RCVTIMEO, &tv, sizeof(tv));

    struct sockaddr_in dest = { 0 };
    dest.sin_family = AF_INET;
    dest.sin_port = htons(s_dbg_settings_port);
    dest.sin_addr.s_addr = inet_addr(s_dbg_settings_host);
    if (dest.sin_addr.s_addr == INADDR_NONE) {
        close(sock);
        return;
    }
    if (connect(sock, (struct sockaddr *)&dest, sizeof(dest)) != 0) {
        close(sock);
        return;
    }

    char body[512];
    const int body_len = snprintf(body,
                                  sizeof(body),
                                  "{\"sessionId\":\"%s\",\"runId\":\"%s\",\"hypothesisId\":\"%s\",\"location\":\"%s\",\"msg\":\"[DEBUG] %s\"}",
                                  s_dbg_settings_session,
                                  run_id ? run_id : "pre-fix",
                                  hypothesis_id,
                                  location,
                                  msg);
    if (body_len <= 0 || body_len >= (int)sizeof(body)) {
        close(sock);
        return;
    }

    char req[768];
    const int req_len = snprintf(req,
                                 sizeof(req),
                                 "POST /event HTTP/1.1\r\n"
                                 "Host: %s:%u\r\n"
                                 "Content-Type: application/json\r\n"
                                 "Connection: close\r\n"
                                 "Content-Length: %d\r\n\r\n"
                                 "%.*s",
                                 s_dbg_settings_host,
                                 (unsigned)s_dbg_settings_port,
                                 body_len,
                                 body_len,
                                 body);
    if (req_len > 0 && req_len < (int)sizeof(req)) {
        (void)send(sock, req, (size_t)req_len, 0);
    }
    shutdown(sock, SHUT_RDWR);
    close(sock);
#else
    (void)run_id;
    (void)hypothesis_id;
    (void)location;
    (void)fmt;
#endif
}

bool ui_is_navigation_active(void) {
    return s_screen_transition_active || s_pending_screen != (enum ScreensEnum)0 || s_nav_locked;
}

enum ScreensEnum ui_get_current_screen_id(void) {
    if (currentScreen < 0) return (enum ScreensEnum)0;
    return (enum ScreensEnum)(currentScreen + 1);
}
#if defined(ESP_PLATFORM)
static const char *s_dbg_tag_nav = "UI_NAV_DBG";
#endif

static void ui_check_draw_buffer_memory_phase(const char *phase, enum ScreensEnum target) {
#if defined(ESP_PLATFORM)
    const bool ok = ui_lvgl_draw_buffer_memory_check(phase);
    ESP_LOGI(s_dbg_tag_nav,
             "draw_buf_guard: phase=%s target=%d current=%d pending=%d ok=%d",
             phase ? phase : "unspecified",
             (int)target,
             (int)(currentScreen + 1),
             (int)s_pending_screen,
             ok ? 1 : 0);
    if (!ok) {
        ui_debug_settings_freeze_reportf("mem-guard", "draw-buffer-memory", phase ? phase : "unspecified",
                                         "target=%d current=%d pending=%d", (int)target, (int)(currentScreen + 1),
                                         (int)s_pending_screen);
    }
#else
    (void)phase;
    (void)target;
#endif
}

static void ui_indev_quiesce(void) {
    lv_indev_t *i = lv_indev_get_next(NULL);
    while (i) {
        lv_indev_stop_processing(i);
        lv_indev_wait_release(i);
        i = lv_indev_get_next(i);
    }
    lv_indev_reset(NULL, NULL);
}

static const lv_font_t *const s_ui_fonts[] = {
    &font_4305a60a491c803d80080d00155e1160,
    &font_4305a60a491c803d80080d008712449e,
    &font_4305a60a491c803d80080d011b20aec8,
    &font_4305a60a491c803d80080d015637c7d0,
    &font_4305a60a491c803d80080d0276f8a0f7,
    &font_4305a60a491c803d80080d0337447350,
    &font_4305a60a491c803d80080d05cbb3cac2,
    &font_4305a60a491c803d80080d08108ddeb9,
    &font_4305a60a491c803d80080d0941ee88b1,
};

static bool ui_is_custom_font(const lv_font_t *font) {
    if (!font) return false;
    for (size_t i = 0; i < (sizeof(s_ui_fonts) / sizeof(s_ui_fonts[0])); i++) {
        if (s_ui_fonts[i] == font) return true;
    }
    return false;
}

static const lv_font_t *ui_pick_scaled_font(const lv_font_t *orig, int32_t zoom_256) {
    if (!orig) return orig;
    if (!ui_is_custom_font(orig)) return orig;
    if (zoom_256 <= 0) return orig;
    if (zoom_256 >= 256) return orig;

    const int32_t target = ((int32_t)orig->line_height * zoom_256) / 256;
    const lv_font_t *best = orig;
    int32_t best_delta = 0x7FFFFFFF;

    for (size_t i = 0; i < (sizeof(s_ui_fonts) / sizeof(s_ui_fonts[0])); i++) {
        const lv_font_t *cand = s_ui_fonts[i];
        if (!cand) continue;
        const int32_t h = (int32_t)cand->line_height;
        if (h <= 0) continue;
        if (h > target + 1) continue;
        const int32_t delta = (target - h);
        if (delta < best_delta) {
            best_delta = delta;
            best = cand;
        }
    }

    if (best != orig) return best;

    const lv_font_t *smallest = s_ui_fonts[0];
    for (size_t i = 0; i < (sizeof(s_ui_fonts) / sizeof(s_ui_fonts[0])); i++) {
        const lv_font_t *cand = s_ui_fonts[i];
        if (!cand) continue;
        if (!smallest || cand->line_height < smallest->line_height) smallest = cand;
    }
    return smallest ? smallest : orig;
}

static void ui_copy_utf8_trunc(char *dst, size_t dst_sz, const char *src) {
    if (!dst || dst_sz == 0) return;
    if (!src) src = "";
    size_t n = 0;
    while (src[n] != '\0' && n + 1 < dst_sz) {
        dst[n] = src[n];
        n++;
    }
    dst[n] = '\0';
    if (n == 0) return;

    size_t start = n;
    while (start > 0 && (((unsigned char)dst[start - 1] & 0xC0U) == 0x80U)) {
        start--;
    }
    if (start == n) return;

    const unsigned char lead = (unsigned char)dst[start];
    size_t need = 1;
    if ((lead & 0x80U) == 0x00U) need = 1;
    else if ((lead & 0xE0U) == 0xC0U) need = 2;
    else if ((lead & 0xF0U) == 0xE0U) need = 3;
    else if ((lead & 0xF8U) == 0xF0U) need = 4;
    else {
        dst[start] = '\0';
        return;
    }
    if (n - start < need) dst[start] = '\0';
}

static void ui_copy_utf8_sanitized(char *dst, size_t dst_sz, const char *src) {
    if (!dst || dst_sz == 0) return;
    if (!src) src = "";

    size_t di = 0;
    size_t si = 0;
    while (src[si] != '\0' && di + 1 < dst_sz) {
        const unsigned char c = (unsigned char)src[si];
        if (c < 0x80U) {
            if (c >= 0x20U || c == '\t' || c == ' ') dst[di++] = (char)c;
            else dst[di++] = '?';
            si++;
            continue;
        }

        size_t need = 0;
        if ((c & 0xE0U) == 0xC0U) need = 2;
        else if ((c & 0xF0U) == 0xE0U) need = 3;
        else if ((c & 0xF8U) == 0xF0U) need = 4;
        else {
            dst[di++] = '?';
            si++;
            continue;
        }

        bool ok = true;
        for (size_t j = 1; j < need; j++) {
            const unsigned char cc = (unsigned char)src[si + j];
            if (cc == 0 || (cc & 0xC0U) != 0x80U) {
                ok = false;
                break;
            }
        }
        if (!ok || di + need >= dst_sz) {
            dst[di++] = '?';
            si++;
            continue;
        }

        for (size_t j = 0; j < need; j++) dst[di++] = src[si + j];
        si += need;
    }
    dst[di] = '\0';
}

static void disable_scrolling(lv_obj_t *obj) {
    if (!obj) return;
    lv_obj_remove_flag(obj, LV_OBJ_FLAG_SCROLLABLE);
    lv_obj_set_scroll_dir(obj, LV_DIR_NONE);
    lv_obj_set_scrollbar_mode(obj, LV_SCROLLBAR_MODE_OFF);
}

static void disable_scrolling_recursive(lv_obj_t *obj) {
    if (!obj) return;
    disable_scrolling(obj);
    uint32_t i = 0;
    while (true) {
        lv_obj_t *child = lv_obj_get_child(obj, i);
        if (!child) break;
        disable_scrolling_recursive(child);
        i++;
    }
}

static lv_coord_t mul_zoom(lv_coord_t v, int32_t zoom_256) {
    return (lv_coord_t)(((int64_t)v * (int64_t)zoom_256) / 256);
}

static void ui_rescale_yield() {
#if defined(ESP_PLATFORM)
    (void)esp_task_wdt_reset();
    taskYIELD();
#endif
}

static void rescale_obj_tree(lv_obj_t *obj, int32_t zoom_256, lv_coord_t add_x, lv_coord_t add_y) {
    if (!obj) return;

    static uint32_t s_nodes = 0;
    s_nodes++;
    if ((s_nodes & 0x07u) == 0) {
        ui_rescale_yield();
    }

    if (lv_obj_check_type(obj, &lv_label_class)) {
        const lv_font_t *font = lv_obj_get_style_text_font(obj, LV_PART_MAIN);
        const lv_font_t *scaled = ui_pick_scaled_font(font, zoom_256);
        if (scaled && scaled != font) {
            lv_obj_set_style_text_font(obj, scaled, LV_PART_MAIN | LV_STATE_DEFAULT);
        }
    }

    const lv_coord_t old_x = lv_obj_get_x(obj);
    const lv_coord_t old_y = lv_obj_get_y(obj);
    lv_obj_set_pos(obj, (lv_coord_t)(add_x + mul_zoom(old_x, zoom_256)), (lv_coord_t)(add_y + mul_zoom(old_y, zoom_256)));

    const bool is_label = lv_obj_check_type(obj, &lv_label_class);
    if (!is_label) {
        const lv_coord_t w = lv_obj_get_width(obj);
        const lv_coord_t h = lv_obj_get_height(obj);
        if (w > 0) lv_obj_set_width(obj, (lv_coord_t)LV_MAX(1, mul_zoom(w, zoom_256)));
        if (h > 0) lv_obj_set_height(obj, (lv_coord_t)LV_MAX(1, mul_zoom(h, zoom_256)));
    }

    if (lv_obj_check_type(obj, &lv_image_class)) {
        const uint16_t z = lv_img_get_zoom(obj);
        const uint16_t nz = (uint16_t)LV_MAX(1, ((uint32_t)z * (uint32_t)zoom_256) / 256u);
        lv_img_set_zoom(obj, nz);
    }

    uint32_t i = 0;
    while (true) {
        lv_obj_t *child = lv_obj_get_child(obj, i);
        if (!child) break;
        rescale_obj_tree(child, zoom_256, 0, 0);
        i++;
    }
}

static void ui_fit_screen_to_display(lv_obj_t *screen) {
    if (!screen) return;
    if (lv_obj_has_flag(screen, LV_OBJ_FLAG_USER_4)) return;

#if defined(ESP_PLATFORM) && defined(CONFIG_IDF_TARGET_ESP32P4)
    return;
#endif

    lv_disp_t *disp = lv_disp_get_default();
    if (!disp) return;

    const int32_t hor = (int32_t)lv_disp_get_hor_res(disp);
    const int32_t ver = (int32_t)lv_disp_get_ver_res(disp);
    if (hor <= 0 || ver <= 0) return;

    const int32_t design_w = 800;
    const int32_t design_h = 480;

    disable_scrolling(screen);
    lv_obj_set_pos(screen, 0, 0);
    lv_obj_set_size(screen, hor, ver);

    const int32_t zoom_w = (hor * 256) / design_w;
    const int32_t zoom_h = (ver * 256) / design_h;
    const int32_t zoom = (zoom_w < zoom_h) ? zoom_w : zoom_h;

    if (zoom > 0 && zoom < 256) {
        const int32_t scaled_w = (design_w * zoom) / 256;
        const int32_t scaled_h = (design_h * zoom) / 256;
        const int32_t x_off = (hor - scaled_w) / 2;
        const int32_t y_off = (ver - scaled_h) / 2;

        uint32_t i = 0;
        while (true) {
            lv_obj_t *child = lv_obj_get_child(screen, i);
            if (!child) break;
            rescale_obj_tree(child, zoom, (lv_coord_t)x_off, (lv_coord_t)y_off);
            i++;
        }
    }

    lv_obj_update_layout(screen);
    if (screen == objects._1) {
        disable_scrolling_recursive(screen);
    } else {
        disable_scrolling(screen);
    }
    lv_obj_add_flag(screen, LV_OBJ_FLAG_USER_4);
}

// #region debug-point program-delete-freeze
#if defined(ESP_PLATFORM)
static const char *s_dbg_tag_program_delete_freeze_ui = "UI_DEL_DBG";
#endif
// #endregion

typedef struct {
    uint32_t magic;
    uint16_t version;
    uint8_t program_count;
    uint8_t selected_id;
    char program_names[UI_MAX_PROGRAMS][96];
    uint16_t program_steps_total[UI_MAX_PROGRAMS];
    uint32_t program_total_time_s[UI_MAX_PROGRAMS];
    int16_t program_step_temp_c[UI_MAX_PROGRAMS][UI_MAX_STEPS];
    uint16_t program_step_rate_c_per_h_x10[UI_MAX_PROGRAMS][UI_MAX_STEPS];
    uint32_t program_step_hold_s[UI_MAX_PROGRAMS][UI_MAX_STEPS];
} ui_program_store_t;

static bool ui_programs_apply_store(const ui_program_store_t *st) {
    if (!st) return false;
    if (st->magic != 0x54524145U) return false;
    if (st->version != 2) return false;
    if (st->program_count > UI_MAX_PROGRAMS) return false;

    s_program_count = st->program_count;
    memcpy(s_program_names, st->program_names, sizeof(s_program_names));
    memcpy(s_program_steps_total, st->program_steps_total, sizeof(s_program_steps_total));
    memcpy(s_program_total_time_s, st->program_total_time_s, sizeof(s_program_total_time_s));
    memcpy(s_program_step_temp_c, st->program_step_temp_c, sizeof(s_program_step_temp_c));
    memcpy(s_program_step_rate_c_per_h_x10, st->program_step_rate_c_per_h_x10, sizeof(s_program_step_rate_c_per_h_x10));
    memcpy(s_program_step_hold_s, st->program_step_hold_s, sizeof(s_program_step_hold_s));

    for (uint8_t i = 0; i < UI_MAX_PROGRAMS; i++) {
        char clean[sizeof(s_program_names[i])];
        ui_copy_utf8_sanitized(clean, sizeof(clean), s_program_names[i]);
        memcpy(s_program_names[i], clean, sizeof(s_program_names[i]));
        if (s_program_steps_total[i] == 0) s_program_steps_total[i] = 1;
        if (s_program_steps_total[i] > UI_MAX_STEPS) s_program_steps_total[i] = UI_MAX_STEPS;
    }

    if (s_program_count == 0) {
        s_selected_program_id = 255;
        ui_set_selected_program_name("");
        ui_set_selected_program_steps_total(1);
        return true;
    }

    s_selected_program_id = (st->selected_id < s_program_count) ? st->selected_id : 0;
    ui_set_selected_program_name(ui_get_program_name(s_selected_program_id));
    ui_set_selected_program_steps_total(ui_get_program_steps_total(s_selected_program_id));
    return true;
}

static bool ui_programs_load_from_config_json(void) {
    FILE *f = fopen(CONFIG_FILE, "r");
    if (!f) return false;
    if (fseek(f, 0, SEEK_END) != 0) {
        fclose(f);
        return false;
    }
    const long size = ftell(f);
    if (size <= 0 || fseek(f, 0, SEEK_SET) != 0) {
        fclose(f);
        return false;
    }

    char *buf = (char *)malloc((size_t)size + 1U);
    if (!buf) {
        fclose(f);
        return false;
    }
    const size_t read_sz = fread(buf, 1, (size_t)size, f);
    fclose(f);
    buf[read_sz] = '\0';

    cJSON *root = cJSON_ParseWithLength(buf, read_sz);
    free(buf);
    if (!root || !cJSON_IsObject(root)) {
        if (root) cJSON_Delete(root);
        return false;
    }

    const cJSON *ui_programs = cJSON_GetObjectItemCaseSensitive(root, "ui_programs");
    const cJSON *programs = ui_programs ? cJSON_GetObjectItemCaseSensitive(ui_programs, "programs") : NULL;
    if (!cJSON_IsObject(ui_programs) || !cJSON_IsArray(programs)) {
        cJSON_Delete(root);
        return false;
    }

    ui_program_store_t st;
    memset(&st, 0, sizeof(st));
    st.magic = 0x54524145U;
    st.version = 2;

    const int arr_count = cJSON_GetArraySize(programs);
    if (arr_count < 0) {
        cJSON_Delete(root);
        return false;
    }
    st.program_count = (uint8_t)((arr_count > UI_MAX_PROGRAMS) ? UI_MAX_PROGRAMS : arr_count);

    const cJSON *selected_id = cJSON_GetObjectItemCaseSensitive(ui_programs, "selected_id");
    if (cJSON_IsNumber(selected_id) && selected_id->valuedouble >= 0.0) {
        st.selected_id = (uint8_t)selected_id->valueint;
    } else {
        st.selected_id = 0;
    }

    for (uint8_t i = 0; i < st.program_count; i++) {
        const cJSON *prog = cJSON_GetArrayItem(programs, i);
        if (!cJSON_IsObject(prog)) continue;

        const cJSON *name = cJSON_GetObjectItemCaseSensitive(prog, "name");
        if (cJSON_IsString(name) && name->valuestring) {
            ui_copy_utf8_trunc(st.program_names[i], sizeof(st.program_names[i]), name->valuestring);
        }

        uint16_t steps_total = 1;
        const cJSON *steps_total_item = cJSON_GetObjectItemCaseSensitive(prog, "steps_total");
        if (cJSON_IsNumber(steps_total_item) && steps_total_item->valuedouble > 0.0) {
            steps_total = (uint16_t)steps_total_item->valueint;
        }
        if (steps_total > UI_MAX_STEPS) steps_total = UI_MAX_STEPS;
        st.program_steps_total[i] = steps_total;

        const cJSON *total_time_s = cJSON_GetObjectItemCaseSensitive(prog, "total_time_s");
        if (cJSON_IsNumber(total_time_s) && total_time_s->valuedouble >= 0.0) {
            st.program_total_time_s[i] = (uint32_t)total_time_s->valuedouble;
        }

        const cJSON *steps = cJSON_GetObjectItemCaseSensitive(prog, "steps");
        if (!cJSON_IsArray(steps)) continue;
        const int steps_count = cJSON_GetArraySize(steps);
        const int capped_steps = (steps_count > steps_total) ? steps_total : steps_count;
        for (int j = 0; j < capped_steps; j++) {
            const cJSON *step = cJSON_GetArrayItem(steps, j);
            if (!cJSON_IsObject(step)) continue;
            const cJSON *temp_c = cJSON_GetObjectItemCaseSensitive(step, "temp_c");
            const cJSON *rate_x10 = cJSON_GetObjectItemCaseSensitive(step, "rate_c_per_h_x10");
            const cJSON *hold_s = cJSON_GetObjectItemCaseSensitive(step, "hold_s");
            if (cJSON_IsNumber(temp_c)) st.program_step_temp_c[i][j] = (int16_t)temp_c->valueint;
            if (cJSON_IsNumber(rate_x10) && rate_x10->valuedouble >= 0.0) {
                st.program_step_rate_c_per_h_x10[i][j] = (uint16_t)rate_x10->valueint;
            }
            if (cJSON_IsNumber(hold_s) && hold_s->valuedouble >= 0.0) {
                st.program_step_hold_s[i][j] = (uint32_t)hold_s->valuedouble;
            }
        }
    }

    cJSON_Delete(root);
    return ui_programs_apply_store(&st);
}

static bool ui_programs_save_to_config_json(void) {
    cJSON *root = NULL;
    FILE *f = fopen(CONFIG_FILE, "r");
    if (f) {
        if (fseek(f, 0, SEEK_END) == 0) {
            const long size = ftell(f);
            if (size > 0 && fseek(f, 0, SEEK_SET) == 0) {
                char *buf = (char *)malloc((size_t)size + 1U);
                if (buf) {
                    const size_t read_sz = fread(buf, 1, (size_t)size, f);
                    buf[read_sz] = '\0';
                    root = cJSON_ParseWithLength(buf, read_sz);
                    free(buf);
                }
            }
        }
        fclose(f);
    }
    if (!root || !cJSON_IsObject(root)) {
        if (root) cJSON_Delete(root);
        root = cJSON_CreateObject();
    }
    if (!root) return false;

    cJSON_DeleteItemFromObject(root, "ui_programs");
    cJSON *ui_programs = cJSON_AddObjectToObject(root, "ui_programs");
    cJSON_AddNumberToObject(ui_programs, "version", 2);
    cJSON_AddNumberToObject(ui_programs, "selected_id", s_selected_program_id);
    cJSON *programs = cJSON_AddArrayToObject(ui_programs, "programs");
    for (uint8_t i = 0; i < s_program_count; i++) {
        cJSON *prog = cJSON_CreateObject();
        cJSON_AddStringToObject(prog, "name", s_program_names[i]);
        cJSON_AddNumberToObject(prog, "steps_total", s_program_steps_total[i]);
        cJSON_AddNumberToObject(prog, "total_time_s", (double)s_program_total_time_s[i]);
        cJSON *steps = cJSON_AddArrayToObject(prog, "steps");
        const uint16_t total = ui_get_program_steps_total(i);
        for (uint16_t j = 0; j < total; j++) {
            cJSON *step = cJSON_CreateObject();
            cJSON_AddNumberToObject(step, "temp_c", s_program_step_temp_c[i][j]);
            cJSON_AddNumberToObject(step, "rate_c_per_h_x10", s_program_step_rate_c_per_h_x10[i][j]);
            cJSON_AddNumberToObject(step, "hold_s", (double)s_program_step_hold_s[i][j]);
            cJSON_AddItemToArray(steps, step);
        }
        cJSON_AddItemToArray(programs, prog);
    }

    char *rendered = cJSON_PrintUnformatted(root);
    cJSON_Delete(root);
    if (!rendered) return false;

    const char *tmp_path = CONFIG_FILE ".tmp";
    FILE *out = fopen(tmp_path, "w");
    if (!out) {
        free(rendered);
        return false;
    }
    const size_t len = strlen(rendered);
    const size_t written = fwrite(rendered, 1, len, out);
    fflush(out);
    fclose(out);
    free(rendered);
    if (written != len) {
        (void)remove(tmp_path);
        return false;
    }
    if (rename(tmp_path, CONFIG_FILE) != 0) {
        (void)remove(CONFIG_FILE);
        if (rename(tmp_path, CONFIG_FILE) != 0) {
            (void)remove(tmp_path);
            return false;
        }
    }
    return true;
}

void ui_set_selected_program_name(const char *name);
void ui_set_selected_program_steps_total(uint16_t steps);
const char *ui_get_program_name(uint8_t id);
uint16_t ui_get_program_steps_total(uint8_t id);

static void ui_programs_persist_load() {
    if (ui_programs_load_from_config_json()) return;

    nvs_handle_t h = 0;
    if (nvs_open("ui", NVS_READONLY, &h) != ESP_OK) return;
    ui_program_store_t st = { 0 };
    size_t sz = sizeof(st);
    const esp_err_t err = nvs_get_blob(h, "programs_v2", &st, &sz);
    nvs_close(h);
    if (err != ESP_OK) return;
    if (ui_programs_apply_store(&st)) {
        (void)ui_programs_save_to_config_json();
    }
}

static void ui_display_persist_load() {
    nvs_handle_t h = 0;
    if (nvs_open("ui", NVS_READONLY, &h) != ESP_OK) return;
    uint16_t sleep_min = 0;
    if (nvs_get_u16(h, "sleep_min", &sleep_min) == ESP_OK) {
        s_display_sleep_minutes = sleep_min;
    }
    uint8_t v = 0;
    if (nvs_get_u8(h, "date_fmt", &v) == ESP_OK && v <= (uint8_t)UI_DATE_FORMAT_YYYYMMDD) {
        s_date_format = (ui_date_format_t)v;
    }
    if (nvs_get_u8(h, "time_fmt", &v) == ESP_OK && v <= (uint8_t)UI_TIME_FORMAT_12H) {
        s_time_format = (ui_time_format_t)v;
    }
    if (nvs_get_u8(h, "temp_unit", &v) == ESP_OK && v <= (uint8_t)UI_TEMP_UNIT_F) {
        s_temp_unit = (ui_temp_unit_t)v;
    }
    if (nvs_get_u8(h, "lang_en", &v) == ESP_OK) {
        s_is_english = (v != 0);
    }
    nvs_close(h);
}

static void ui_display_persist_save() {
    nvs_handle_t h = 0;
    if (nvs_open("ui", NVS_READWRITE, &h) != ESP_OK) return;
    (void)nvs_set_u16(h, "sleep_min", s_display_sleep_minutes);
    (void)nvs_set_u8(h, "date_fmt", (uint8_t)s_date_format);
    (void)nvs_set_u8(h, "time_fmt", (uint8_t)s_time_format);
    (void)nvs_set_u8(h, "temp_unit", (uint8_t)s_temp_unit);
    (void)nvs_set_u8(h, "lang_en", s_is_english ? 1U : 0U);
    (void)nvs_commit(h);
    nvs_close(h);
}

uint16_t ui_get_display_sleep_minutes() {
    return s_display_sleep_minutes;
}

void ui_set_display_sleep_minutes(uint16_t minutes) {
    s_display_sleep_minutes = minutes;
    ui_display_persist_save();
}

ui_date_format_t ui_get_date_format() {
    return s_date_format;
}

void ui_set_date_format(ui_date_format_t fmt) {
    if (fmt > UI_DATE_FORMAT_YYYYMMDD) return;
    s_date_format = fmt;
    ui_display_persist_save();
}

ui_time_format_t ui_get_time_format() {
    return s_time_format;
}

void ui_set_time_format(ui_time_format_t fmt) {
    if (fmt > UI_TIME_FORMAT_12H) return;
    s_time_format = fmt;
    ui_display_persist_save();
}

ui_temp_unit_t ui_get_temp_unit() {
    return s_temp_unit;
}

void ui_set_temp_unit(ui_temp_unit_t unit) {
    if (unit > UI_TEMP_UNIT_F) return;
    s_temp_unit = unit;
    ui_display_persist_save();
}

void ui_notify_user_activity() {
#if defined(ESP_PLATFORM)
    lv_disp_trig_activity(NULL);
    s_display_last_user_activity_ms = lv_tick_get();
    if (s_display_sleeping) {
        display_driver_set_backlight_percent_forced(s_display_sleep_restore_brightness);
        s_display_sleeping = false;
    }
#endif
}

static void ui_programs_persist_save_impl() {
    (void)ui_programs_save_to_config_json();

    nvs_handle_t h = 0;
    if (nvs_open("ui", NVS_READWRITE, &h) != ESP_OK) return;
    ui_program_store_t st = { 0 };
    st.magic = 0x54524145U;
    st.version = 2;
    st.program_count = s_program_count;
    st.selected_id = s_selected_program_id;
    memcpy(st.program_names, s_program_names, sizeof(st.program_names));
    memcpy(st.program_steps_total, s_program_steps_total, sizeof(st.program_steps_total));
    memcpy(st.program_total_time_s, s_program_total_time_s, sizeof(st.program_total_time_s));
    memcpy(st.program_step_temp_c, s_program_step_temp_c, sizeof(st.program_step_temp_c));
    memcpy(st.program_step_rate_c_per_h_x10, s_program_step_rate_c_per_h_x10, sizeof(st.program_step_rate_c_per_h_x10));
    memcpy(st.program_step_hold_s, s_program_step_hold_s, sizeof(st.program_step_hold_s));

    if (nvs_set_blob(h, "programs_v2", &st, sizeof(st)) == ESP_OK) {
        (void)nvs_commit(h);
    }
    nvs_close(h);
}

static void nav_unlock_cb(lv_timer_t *t) {
    s_nav_locked = false;
    if (t) lv_timer_del(t);
    s_nav_unlock_timer = NULL;
}

static enum ScreensEnum ui_pick_temp_screen(enum ScreensEnum target) {
    return (target == SCREEN_ID__2) ? SCREEN_ID__1 : SCREEN_ID__2;
}

static void ui_finish_load_screen_fresh_async(void *user_data) {
    const enum ScreensEnum target = (enum ScreensEnum)(uintptr_t)user_data;
    ui_indev_quiesce();
#if defined(ESP_PLATFORM)
    if (target == SCREEN_ID_SETTINGS) {
        const uint32_t since_request_ms = s_dbg_settings_nav_start_us == 0 ? 0U
            : (uint32_t)((esp_timer_get_time() - s_dbg_settings_nav_start_us) / 1000ULL);
        ESP_LOGI(s_dbg_tag_nav, "settings_nav: async_target_load current=%d pending=%d since_request_ms=%" PRIu32,
                 (int)(currentScreen + 1), (int)s_pending_screen, since_request_ms);
        s_dbg_settings_target_load_us = esp_timer_get_time();
    }
#endif
    loadScreenForce(target);
    ui_rescale_yield();
    if (target == SCREEN_ID_SETTINGS) {
#if defined(ESP_PLATFORM)
        const uint32_t load_ms = s_dbg_settings_target_load_us == 0 ? 0U
            : (uint32_t)((esp_timer_get_time() - s_dbg_settings_target_load_us) / 1000ULL);
        const uint32_t total_ms = s_dbg_settings_nav_start_us == 0 ? 0U
            : (uint32_t)((esp_timer_get_time() - s_dbg_settings_nav_start_us) / 1000ULL);
        ESP_LOGI(s_dbg_tag_nav,
                 "settings_nav: async_done load_ms=%" PRIu32 " total_ms=%" PRIu32 " current=%d",
                 load_ms, total_ms, (int)(currentScreen + 1));
#endif
    }
    s_screen_transition_active = false;
    s_nav_locked = true;
    if (s_nav_unlock_timer) lv_timer_del(s_nav_unlock_timer);
    s_nav_unlock_timer = lv_timer_create(nav_unlock_cb, 250, NULL);
}

static void ui_delete_all_screens_except(enum ScreensEnum keep_screen) {
    for (enum ScreensEnum id = SCREEN_ID__2; id <= SCREEN_ID_PROGRAM_GRAPH; id = (enum ScreensEnum)(id + 1)) {
        if (id == keep_screen) continue;
#if defined(ESP_PLATFORM)
        ESP_LOGI(s_dbg_tag_nav, "delete_except: begin id=%d keep=%d current=%d", (int)id, (int)keep_screen, (int)(currentScreen + 1));
#endif
        delete_screen_by_id(id);
        ui_rescale_yield();
#if defined(ESP_PLATFORM)
        ESP_LOGI(s_dbg_tag_nav, "delete_except: done id=%d keep=%d current=%d", (int)id, (int)keep_screen, (int)(currentScreen + 1));
#endif
    }
}

static void ui_load_screen_fresh(enum ScreensEnum target) {
    s_screen_transition_active = true;
    s_nav_locked = false;
    if (s_nav_unlock_timer) lv_timer_del(s_nav_unlock_timer);
    s_nav_unlock_timer = NULL;

    if (target == SCREEN_ID_SETTINGS) {
        ui_indev_quiesce();
        ui_delete_all_screens_except((enum ScreensEnum)0);
        ui_rescale_yield();
#if defined(ESP_PLATFORM)
        if (s_dbg_settings_nav_start_us != 0) {
            const uint32_t after_delete_ms = (uint32_t)((esp_timer_get_time() - s_dbg_settings_nav_start_us) / 1000ULL);
            ESP_LOGI(s_dbg_tag_nav, "settings_nav: direct_after_delete elapsed_ms=%" PRIu32, after_delete_ms);
        }
        s_dbg_settings_target_load_us = esp_timer_get_time();
#endif
        loadScreenForce(target);
        ui_rescale_yield();
        if (target == SCREEN_ID_SETTINGS) {
#if defined(ESP_PLATFORM)
            const uint32_t load_ms = s_dbg_settings_target_load_us == 0 ? 0U
                : (uint32_t)((esp_timer_get_time() - s_dbg_settings_target_load_us) / 1000ULL);
            const uint32_t total_ms = s_dbg_settings_nav_start_us == 0 ? 0U
                : (uint32_t)((esp_timer_get_time() - s_dbg_settings_nav_start_us) / 1000ULL);
            ESP_LOGI(s_dbg_tag_nav,
                     "settings_nav: direct_done load_ms=%" PRIu32 " total_ms=%" PRIu32 " current=%d",
                     load_ms, total_ms, (int)(currentScreen + 1));
#endif
        }
        s_screen_transition_active = false;
        s_nav_locked = true;
        s_nav_unlock_timer = lv_timer_create(nav_unlock_cb, 250, NULL);
        return;
    }

    const enum ScreensEnum temp = ui_pick_temp_screen(target);
    ui_indev_quiesce();
    loadScreenForce(temp);
    ui_rescale_yield();
#if defined(ESP_PLATFORM)
    if (target == SCREEN_ID_SETTINGS) {
        const uint32_t after_temp_ms = s_dbg_settings_nav_start_us == 0 ? 0U
            : (uint32_t)((esp_timer_get_time() - s_dbg_settings_nav_start_us) / 1000ULL);
        ESP_LOGI(s_dbg_tag_nav, "settings_nav: after_temp_load temp=%d elapsed_ms=%" PRIu32, (int)temp, after_temp_ms);
    }
#endif
    ui_indev_quiesce();
    ui_delete_all_screens_except(temp);
    ui_rescale_yield();
#if defined(ESP_PLATFORM)
    if (target == SCREEN_ID_SETTINGS) {
        ESP_LOGI(s_dbg_tag_nav, "settings_nav: after_delete current=%d pending=%d", (int)(currentScreen + 1), (int)s_pending_screen);
    }
#endif
    ui_indev_quiesce();
#if defined(ESP_PLATFORM)
    if (target == SCREEN_ID_SETTINGS) {
        ESP_LOGI(s_dbg_tag_nav, "settings_nav: before_target_load current=%d pending=%d", (int)(currentScreen + 1), (int)s_pending_screen);
    }
#endif
    if (target == SCREEN_ID_SETTINGS) {
        (void)lv_async_call(ui_finish_load_screen_fresh_async, (void *)(uintptr_t)target);
        return;
    }
    loadScreenForce(target);
    ui_rescale_yield();
    s_screen_transition_active = false;

    s_nav_locked = true;
    s_nav_unlock_timer = lv_timer_create(nav_unlock_cb, 250, NULL);
}

static lv_obj_t *getLvglObjectFromIndex(int32_t index) {
    if (index == -1) {
        return 0;
    }
    return ((lv_obj_t **)&objects)[index];
}

static void ensureScreenCreated(enum ScreensEnum screenId) {
    switch (screenId) {
        case SCREEN_ID__2:
            if (objects._2 == NULL) {
                create_screen__2();
                ui_rescale_yield();
            }
            ui_fit_screen_to_display(objects._2);
            ui_rescale_yield();
            ui_s3_post_scale(screenId);
            break;
        case SCREEN_ID__1:
            if (objects._1 == NULL) {
                create_screen__1();
                ui_rescale_yield();
            }
            ui_fit_screen_to_display(objects._1);
            ui_rescale_yield();
            ui_s3_post_scale(screenId);
            break;
        case SCREEN_ID_PROGRAMS_LIST:
            if (objects.programs_list == NULL) {
                create_screen_programs_list();
                ui_rescale_yield();
            }
            ui_fit_screen_to_display(objects.programs_list);
            ui_rescale_yield();
            ui_s3_post_scale(screenId);
            break;
        case SCREEN_ID_PROGRAMS:
            if (objects.programs == NULL) {
                create_screen_programs();
                ui_rescale_yield();
            }
            ui_fit_screen_to_display(objects.programs);
            ui_rescale_yield();
            ui_s3_post_scale(screenId);
            break;
        case SCREEN_ID_SETTINGS:
            if (objects.settings == NULL) {
                create_screen_settings();
                ui_rescale_yield();
            }
            ui_fit_screen_to_display(objects.settings);
            ui_rescale_yield();
            ui_s3_post_scale(screenId);
            break;
        case SCREEN_ID_WIFI_SETTINGS:
            if (objects.wifi_settings == NULL) {
                create_screen_wifi_settings();
                ui_rescale_yield();
            }
            ui_fit_screen_to_display(objects.wifi_settings);
            ui_rescale_yield();
            ui_s3_post_scale(screenId);
            break;
        case SCREEN_ID_PROGRAM_GRAPH:
            if (objects.program_graph == NULL) {
                create_screen_program_graph();
                ui_rescale_yield();
            }
            ui_fit_screen_to_display(objects.program_graph);
            ui_rescale_yield();
            ui_s3_post_scale(screenId);
            break;
        default:
            break;
    }
}

static void loadScreenForce(enum ScreensEnum screenId) {
    ui_check_draw_buffer_memory_phase("before_screen_create", screenId);
    ensureScreenCreated(screenId);
    ui_check_draw_buffer_memory_phase("after_screen_create", screenId);
    currentScreen = screenId - 1;
    lv_obj_t *screen = getLvglObjectFromIndex(currentScreen);
#if defined(ESP_PLATFORM)
    ESP_LOGI(s_dbg_tag_nav, "loadScreenForce: screen=%d current=%d pending=%d nav_locked=%d",
             (int)screenId, (int)(currentScreen + 1), (int)s_pending_screen, s_nav_locked ? 1 : 0);
#endif
    lv_scr_load_anim(screen, LV_SCR_LOAD_ANIM_NONE, 0, 0, false);
    ui_check_draw_buffer_memory_phase("after_screen_load", screenId);
}

void loadScreen(enum ScreensEnum screenId) {
    if (s_nav_locked) return;
#if defined(ESP_PLATFORM)
    ESP_LOGI(s_dbg_tag_nav, "loadScreen: requested=%d current=%d pending=%d",
             (int)screenId, (int)(currentScreen + 1), (int)s_pending_screen);
#endif
    loadScreenForce(screenId);
    s_nav_locked = true;
    if (s_nav_unlock_timer) lv_timer_del(s_nav_unlock_timer);
    s_nav_unlock_timer = lv_timer_create(nav_unlock_cb, 250, NULL);
}

void requestScreen(enum ScreensEnum screenId) {
#if defined(ESP_PLATFORM)
    if (screenId == SCREEN_ID_SETTINGS) {
        s_dbg_settings_nav_start_us = esp_timer_get_time();
        s_dbg_settings_target_load_us = 0;
    }
    ESP_LOGI(s_dbg_tag_nav, "requestScreen: requested=%d current=%d old_pending=%d nav_locked=%d sel_id=%u sel_name='%s'",
             (int)screenId, (int)(currentScreen + 1), (int)s_pending_screen, s_nav_locked ? 1 : 0,
             (unsigned)s_selected_program_id, s_selected_program_name);
#endif
    s_pending_screen = screenId;
}

bool ui_is_english() {
    return s_is_english;
}

void ui_request_toggle_language() {
    const uint32_t now_ms = lv_tick_get();
#if defined(ESP_PLATFORM)
    if (s_display_sleeping) return;
    if ((uint32_t)(now_ms - s_last_display_wake_ms) < 1500U) return;
#endif
    if ((uint32_t)(now_ms - s_last_lang_toggle_ms) < 600U) return;
    s_pending_lang_toggle = true;
    s_last_lang_toggle_ms = now_ms;
}

void ui_set_selected_program_name(const char *name) {
    if (!name) name = "";
    ui_copy_utf8_trunc(s_selected_program_name, sizeof(s_selected_program_name), name);
}

const char *ui_get_selected_program_name() {
    return s_selected_program_name;
}

void ui_set_selected_program_steps_total(uint16_t steps) {
    if (steps == 0) steps = 1;
    s_selected_program_steps_total = steps;
}

uint16_t ui_get_selected_program_steps_total() {
    if (s_selected_program_steps_total == 0) return 1;
    return s_selected_program_steps_total;
}

void ui_set_selected_program_id(uint8_t id) {
    s_selected_program_id = id;
    if (id == 255) {
        for (uint16_t i = 0; i < UI_MAX_STEPS; i++) {
            s_draft_step_temp_c[i] = 0;
            s_draft_step_rate_c_per_h_x10[i] = 0;
            s_draft_step_hold_s[i] = 0;
        }
    }
}

uint8_t ui_get_selected_program_id() {
    return s_selected_program_id;
}

void ui_set_program_steps_total(uint8_t id, uint16_t steps) {
    if (id == 255) {
        ui_set_selected_program_steps_total(steps);
        return;
    }
    if (id >= UI_MAX_PROGRAMS) return;
    if (steps == 0) steps = 1;
    s_program_steps_total[id] = steps;
}

uint16_t ui_get_program_steps_total(uint8_t id) {
    if (id >= UI_MAX_PROGRAMS) return ui_get_selected_program_steps_total();
    if (s_program_steps_total[id] == 0) return 1;
    return s_program_steps_total[id];
}

uint8_t ui_get_program_count() {
    return s_program_count;
}

uint8_t ui_get_program_capacity() {
    return UI_MAX_PROGRAMS;
}

bool ui_is_programs_full() {
    return s_program_count >= UI_MAX_PROGRAMS;
}

bool ui_delete_program(uint8_t id) {
    if (id >= s_program_count) return false;
    // #region debug-point program-delete-freeze
#if defined(ESP_PLATFORM)
    ESP_LOGI(s_dbg_tag_program_delete_freeze_ui, "ui_delete_program enter: id=%u count=%u sel=%u",
             (unsigned)id, (unsigned)s_program_count, (unsigned)s_selected_program_id);
#endif
    // #endregion
    const uint8_t last = s_program_count - 1;
    for (uint8_t i = id; i < last; i++) {
        memcpy(s_program_names[i], s_program_names[i + 1], sizeof(s_program_names[i]));
        s_program_steps_total[i] = s_program_steps_total[i + 1];
        s_program_total_time_s[i] = s_program_total_time_s[i + 1];
        memcpy(s_program_step_temp_c[i], s_program_step_temp_c[i + 1], sizeof(s_program_step_temp_c[i]));
        memcpy(s_program_step_rate_c_per_h_x10[i], s_program_step_rate_c_per_h_x10[i + 1], sizeof(s_program_step_rate_c_per_h_x10[i]));
        memcpy(s_program_step_hold_s[i], s_program_step_hold_s[i + 1], sizeof(s_program_step_hold_s[i]));
    }

    if (s_program_count > 0) s_program_count--;

    if (s_program_count == 0) {
        s_selected_program_id = 255;
        ui_set_selected_program_name("");
        ui_set_selected_program_steps_total(1);
        return true;
    }

    if (s_selected_program_id == id) {
        if (id >= s_program_count) s_selected_program_id = (uint8_t)(s_program_count - 1);
        ui_set_selected_program_name(ui_get_program_name(s_selected_program_id));
        ui_set_selected_program_steps_total(ui_get_program_steps_total(s_selected_program_id));
    } else if (s_selected_program_id != 255 && s_selected_program_id > id) {
        s_selected_program_id--;
    }

    // #region debug-point program-delete-freeze
#if defined(ESP_PLATFORM)
    ESP_LOGI(s_dbg_tag_program_delete_freeze_ui, "ui_delete_program exit: count=%u sel=%u",
             (unsigned)s_program_count, (unsigned)s_selected_program_id);
#endif
    // #endregion
    return true;
}

const char *ui_get_program_name(uint8_t id) {
    if (id >= s_program_count) return "";
    return s_program_names[id];
}

void ui_set_program_name(uint8_t id, const char *name) {
    if (id >= UI_MAX_PROGRAMS) return;
    if (!name) name = "";
    ui_copy_utf8_trunc(s_program_names[id], sizeof(s_program_names[id]), name);
    if (id < s_program_count && id == s_selected_program_id) {
        ui_set_selected_program_name(s_program_names[id]);
    }
}

uint8_t ui_add_program(const char *name, uint16_t steps_total) {
    if (s_program_count >= UI_MAX_PROGRAMS) return 255;
    const uint8_t id = s_program_count;
    s_program_count++;
    ui_set_program_name(id, name);
    ui_set_program_steps_total(id, steps_total);
    s_program_total_time_s[id] = 0;
    for (uint16_t i = 0; i < UI_MAX_STEPS; i++) {
        s_program_step_temp_c[id][i] = 0;
        s_program_step_rate_c_per_h_x10[id][i] = 0;
        s_program_step_hold_s[id][i] = 0;
    }
    return id;
}

void ui_programs_persist_save() {
    if (s_screen_transition_active || s_pending_screen != (enum ScreensEnum)0) {
        s_programs_persist_deferred = true;
        return;
    }
    ui_programs_persist_save_impl();
}

void ui_set_program_total_time_s(uint8_t id, uint32_t sec) {
    if (id >= UI_MAX_PROGRAMS) return;
    s_program_total_time_s[id] = sec;
}

uint32_t ui_get_program_total_time_s(uint8_t id) {
    if (id >= UI_MAX_PROGRAMS) return 0;
    return s_program_total_time_s[id];
}

void ui_get_program_steps_batch(uint8_t id, ui_step_t *out_steps, uint16_t max_count) {
    if (!out_steps || max_count == 0) return;
    
    uint16_t total = ui_get_program_steps_total(id);
    if (total > max_count) total = max_count;
    if (total > UI_MAX_STEPS) total = UI_MAX_STEPS;

    for (uint16_t i = 0; i < total; i++) {
        if (id == 255) {
            out_steps[i].temp_c = s_draft_step_temp_c[i];
            out_steps[i].rate_c_per_h_x10 = s_draft_step_rate_c_per_h_x10[i];
            out_steps[i].hold_s = s_draft_step_hold_s[i];
        } else if (id < UI_MAX_PROGRAMS) {
            out_steps[i].temp_c = s_program_step_temp_c[id][i];
            out_steps[i].rate_c_per_h_x10 = s_program_step_rate_c_per_h_x10[id][i];
            out_steps[i].hold_s = s_program_step_hold_s[id][i];
        } else {
            out_steps[i].temp_c = 0;
            out_steps[i].rate_c_per_h_x10 = 0;
            out_steps[i].hold_s = 0;
        }
    }
}

void ui_get_programs_batch(ui_program_info_t *out_programs, uint8_t max_count) {
    if (!out_programs || max_count == 0) return;
    uint8_t total = s_program_count;
    if (total > max_count) total = max_count;
    if (total > UI_MAX_PROGRAMS) total = UI_MAX_PROGRAMS;

    for (uint8_t i = 0; i < total; i++) {
        ui_copy_utf8_sanitized(out_programs[i].name, sizeof(out_programs[i].name), s_program_names[i]);
        out_programs[i].steps_total = s_program_steps_total[i];
        out_programs[i].total_time_s = s_program_total_time_s[i];
    }
}

void ui_set_program_step(uint8_t id, uint16_t step_idx, int16_t temp_c, uint16_t rate_c_per_h_x10, uint32_t hold_s) {
    if (step_idx >= UI_MAX_STEPS) return;
    if (id == 255) {
        s_draft_step_temp_c[step_idx] = temp_c;
        s_draft_step_rate_c_per_h_x10[step_idx] = rate_c_per_h_x10;
        s_draft_step_hold_s[step_idx] = hold_s;
        return;
    }
    if (id >= UI_MAX_PROGRAMS) return;
    s_program_step_temp_c[id][step_idx] = temp_c;
    s_program_step_rate_c_per_h_x10[id][step_idx] = rate_c_per_h_x10;
    s_program_step_hold_s[id][step_idx] = hold_s;
}

int16_t ui_get_program_step_temp(uint8_t id, uint16_t step_idx) {
    if (step_idx >= UI_MAX_STEPS) return 0;
    if (id == 255) return s_draft_step_temp_c[step_idx];
    if (id >= UI_MAX_PROGRAMS) return 0;
    return s_program_step_temp_c[id][step_idx];
}

uint16_t ui_get_program_step_rate_c_per_h_x10(uint8_t id, uint16_t step_idx) {
    if (step_idx >= UI_MAX_STEPS) return 0;
    if (id == 255) return s_draft_step_rate_c_per_h_x10[step_idx];
    if (id >= UI_MAX_PROGRAMS) return 0;
    return s_program_step_rate_c_per_h_x10[id][step_idx];
}

uint32_t ui_get_program_step_hold_s(uint8_t id, uint16_t step_idx) {
    if (step_idx >= UI_MAX_STEPS) return 0;
    if (id == 255) return s_draft_step_hold_s[step_idx];
    if (id >= UI_MAX_PROGRAMS) return 0;
    return s_program_step_hold_s[id][step_idx];
}

bool ui_program_add_step(uint8_t id) {
    uint16_t cnt = ui_get_program_steps_total(id);
    if (cnt >= UI_MAX_STEPS) return false;
    cnt++;
    ui_set_program_steps_total(id, cnt);
    ui_set_program_step(id, (uint16_t)(cnt - 1), 0, 0, 0);
    return true;
}

bool ui_program_delete_step(uint8_t id, uint16_t step_idx) {
    uint16_t cnt = ui_get_program_steps_total(id);
    if (cnt <= 1) return false;
    if (step_idx >= cnt) return false;

    for (uint16_t i = step_idx; i + 1 < cnt; i++) {
        ui_set_program_step(id,
                            i,
                            ui_get_program_step_temp(id, (uint16_t)(i + 1)),
                            ui_get_program_step_rate_c_per_h_x10(id, (uint16_t)(i + 1)),
                            ui_get_program_step_hold_s(id, (uint16_t)(i + 1)));
    }
    ui_set_program_step(id, (uint16_t)(cnt - 1), 0, 0, 0);

    cnt--;
    ui_set_program_steps_total(id, cnt);
    return true;
}

void ui_set_selected_program_total_time_s(uint32_t sec) {
    s_selected_program_total_time_s = sec;
}

uint32_t ui_get_selected_program_total_time_s() {
    return s_selected_program_total_time_s;
}

void ui_set_selected_program_max_temp_c(uint16_t temp) {
    s_selected_program_max_temp_c = temp;
}

uint16_t ui_get_selected_program_max_temp_c() {
    return s_selected_program_max_temp_c;
}

void ui_set_selected_program_breakpoints(const int16_t *temps, const uint32_t *times, uint8_t count) {
    if (count > 8) count = 8;
    s_selected_program_bp_count = count;
    for (uint8_t i = 0; i < 8; i++) {
        if (i < count) {
            s_selected_program_bp_temps[i] = temps ? temps[i] : 0;
            s_selected_program_bp_times[i] = times ? times[i] : 0;
        } else {
            s_selected_program_bp_temps[i] = 0;
            s_selected_program_bp_times[i] = 0;
        }
    }
}

uint8_t ui_get_selected_program_breakpoint_count() {
    return s_selected_program_bp_count;
}

int16_t ui_get_selected_program_breakpoint_temp(uint8_t idx) {
    if (idx >= s_selected_program_bp_count) return 0;
    return s_selected_program_bp_temps[idx];
}

uint32_t ui_get_selected_program_breakpoint_time_s(uint8_t idx) {
    if (idx >= s_selected_program_bp_count) return 0;
    return s_selected_program_bp_times[idx];
}

void ui_init() {
#if defined(ESP_PLATFORM)
    ui_try_promote_program_storage_to_psram();
#endif
    ui_programs_persist_load();
    ui_display_persist_load();
    create_screens();
    loadScreen(SCREEN_ID__1);
#if defined(ESP_PLATFORM)
    s_display_last_user_activity_ms = lv_tick_get();
#endif
}

void ui_tick() {
    if (s_pending_lang_toggle) {
        s_pending_lang_toggle = false;
        s_is_english = !s_is_english;
        ui_display_persist_save();

        enum ScreensEnum target = (enum ScreensEnum)(currentScreen + 1);
        if (target == (enum ScreensEnum)0) target = SCREEN_ID__1;
        ui_load_screen_fresh(target);
    }

    if (s_pending_screen != (enum ScreensEnum)0) {
        const enum ScreensEnum id = s_pending_screen;
        s_pending_screen = (enum ScreensEnum)0;
#if defined(ESP_PLATFORM)
        ESP_LOGI(s_dbg_tag_nav, "ui_tick: consume pending screen=%d current=%d sel_id=%u sel_name='%s' steps=%u",
                 (int)id, (int)(currentScreen + 1), (unsigned)s_selected_program_id, s_selected_program_name,
                 (unsigned)s_selected_program_steps_total);
#endif
        ui_load_screen_fresh(id);
    }

    if (s_programs_persist_deferred && !s_screen_transition_active && s_pending_screen == (enum ScreensEnum)0) {
        s_programs_persist_deferred = false;
        ui_programs_persist_save_impl();
    }

#if defined(ESP_PLATFORM)
    static uint32_t s_last_screen_tick_ms = 0;
    const uint32_t now_ms = lv_tick_get();
#else
    static uint32_t s_last_screen_tick_ms = 0;
    const uint32_t now_ms = lv_tick_get();
#endif

#if defined(ESP_PLATFORM)
    const uint32_t inactive_ms = lv_disp_get_inactive_time(NULL);

    if (s_display_sleep_minutes == 0) {
        if (s_display_sleeping) {
            display_driver_set_backlight_percent_forced(s_display_sleep_restore_brightness);
            s_display_sleeping = false;
            s_last_display_wake_ms = now_ms;
            ui_indev_quiesce();
        }
    } else {
        const uint32_t threshold_ms = (uint32_t)s_display_sleep_minutes * 60u * 1000u;
        if (now_ms < 5000) {
            if (s_display_sleeping) {
                display_driver_set_backlight_percent_forced(s_display_sleep_restore_brightness);
                s_display_sleeping = false;
                s_last_display_wake_ms = now_ms;
                ui_indev_quiesce();
            }
        } else if (!s_display_sleeping && inactive_ms >= threshold_ms) {
            s_display_sleep_restore_brightness = display_driver_get_backlight_percent();
            if (s_display_sleep_restore_brightness > 0) {
                display_driver_set_backlight_percent_forced(0);
            }
            s_display_sleeping = true;
            ui_indev_quiesce();
        } else if (s_display_sleeping && inactive_ms < 2000) {
            display_driver_set_backlight_percent_forced(s_display_sleep_restore_brightness);
            s_display_sleeping = false;
            s_last_display_wake_ms = now_ms;
            ui_indev_quiesce();
        }
    }
#endif

    if ((uint32_t)(now_ms - s_last_screen_tick_ms) >= 50) {
        s_last_screen_tick_ms = now_ms;
        tick_screen(currentScreen);
    }
}
